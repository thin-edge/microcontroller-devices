## CMakeLists.txt
```
# SPDX-License-Identifier: Apache-2.0
cmake_minimum_required(VERSION 3.20.0)

find_package(Zephyr REQUIRED HINTS $ENV{ZEPHYR_BASE})
project(opcua_server_firmware C)

target_sources(app PRIVATE src/main.c)

# Networking / connectivity management (Wi-Fi on hardware, host backend on
# native_sim) and mDNS/DNS-SD advertisement.
target_sources(app PRIVATE src/net.c)

# NSOS (native_sim offloaded sockets) link shim — provides zsock_getnameinfo(),
# which Zephyr omits under CONFIG_NET_SOCKETS_OFFLOAD. Not built on hardware.
target_sources_ifdef(CONFIG_NET_SOCKETS_OFFLOAD app PRIVATE src/nsos_compat.c)

# Optional TFT status display (no-op when CONFIG_APP_DISPLAY_STATUS is off).
target_sources(app PRIVATE src/display.c)

# OPC-UA server, address space and data source. Compiled only when the
# OPC-UA server is enabled so the base skeleton builds standalone.
target_sources_ifdef(CONFIG_APP_OPCUA_SERVER app PRIVATE
  src/opcua_server.c
  src/address_space.c
  src/data_source.c
)

# open62541 OPC-UA stack, vendored as a pre-generated amalgamation
# (third_party/open62541/open62541.{c,h}); see scripts/regen-open62541.sh for
# how it was produced (minimal, read-only, POSIX-architecture profile).
if(CONFIG_APP_OPCUA_SERVER)
  target_include_directories(app PRIVATE third_party/open62541)
  target_sources(app PRIVATE third_party/open62541/open62541.c)

  # The amalgamation is generated code; don't subject it to our warning flags.
  set_source_files_properties(third_party/open62541/open62541.c
    PROPERTIES COMPILE_OPTIONS "-w")
endif()
```

## Kconfig
```
# SPDX-License-Identifier: Apache-2.0
#
# Application configuration. Board-independent tunables live here with
# sensible defaults; board specifics live in boards/<board>.conf and overlays.

mainmenu "OPC-UA Server Firmware"

menu "OPC-UA server firmware options"

config APP_DEVICE_NAME
	string "Device / OPC-UA application name"
	default "tedge-opcua-device"
	help
	  Human-readable name advertised as the OPC-UA application/server name
	  and used to derive the default mDNS hostname.

config APP_FIRMWARE_NAME
	string "Firmware name"
	default "zephyr-opcua-server"
	help
	  Identifies the firmware image/application (as opposed to the device).
	  Exposed as the OPC-UA node ns=1;s=FirmwareName and paired with
	  FirmwareVersion so a collector can tell which firmware a device runs
	  (e.g. distinct names for Phase-2 protocol variants). Maps naturally to
	  a Cumulocity firmware "name".

config APP_MDNS_HOSTNAME
	string "mDNS hostname (advertised as <hostname>.local)"
	default "tedge-opcua"
	help
	  Hostname advertised over mDNS. The device becomes reachable as
	  "<hostname>.local" on the local network.

config APP_OPCUA_PORT
	int "OPC-UA server TCP port (opc.tcp)"
	default 4840
	range 1 65535
	help
	  TCP port the OPC-UA server listens on.

config APP_SAMPLE_INTERVAL_MS
	int "Data source sampling interval (ms)"
	default 1000
	range 50 3600000
	help
	  Interval at which the data source is sampled and OPC-UA variable
	  node values are refreshed.

config APP_OPCUA_MAX_SUBSCRIPTIONS
	int "Max concurrent OPC-UA subscriptions"
	default 2
	range 0 16
	help
	  Cap on concurrent subscriptions, to bound RAM on constrained boards.

config APP_OPCUA_MAX_MONITORED_ITEMS
	int "Max monitored items per subscription"
	default 8
	range 0 64
	help
	  Cap on monitored items per subscription.

config APP_SETPOINT_MIN
	int "Writable Setpoint minimum"
	default -1000

config APP_SETPOINT_MAX
	int "Writable Setpoint maximum"
	default 1000

config APP_SETPOINT_DEFAULT
	int "Writable Setpoint initial value"
	default 0

config APP_RUNNING_DEFAULT
	bool "Writable 'Running' flag initial value"
	default n

config APP_DISPLAY_STATUS
	bool "Show connectivity status on a TFT display"
	default n
	help
	  On boards with a TFT (e.g. Adafruit Feather ESP32-S2 TFT), show a
	  colour-coded connectivity stage and the device's IPv4 address as large
	  digits. Useful to relay status when no serial console is available.

config APP_OPCUA_SERVER
	bool "Enable the OPC-UA server (compiles the vendored open62541 stack)"
	default y
	help
	  When enabled, the OPC-UA server, address space and data-source
	  modules are compiled and started. Disable to build the bare
	  connectivity skeleton (useful for bring-up).

menu "Wi-Fi (station mode) — hardware targets"

config APP_WIFI
	bool "Connect to Wi-Fi in station mode"
	default y if WIFI
	default n
	help
	  Join a Wi-Fi network on boot. On native_sim this is not used; the
	  host network backend provides connectivity instead.

config APP_PING_TARGET
	string "On-device ping target for the data-path diagnostic"
	default "192.168.68.1"
	depends on APP_WIFI
	help
	  IPv4 address the firmware periodically pings to test whether its
	  Wi-Fi data path passes traffic. Result shown on the display as GWPING.

config APP_STATIC_IP
	bool "Use a static IPv4 address instead of DHCP"
	default n
	help
	  Assign a fixed IPv4 address on Wi-Fi association instead of using
	  DHCP. Also set CONFIG_ESP32_WIFI_STA_AUTO_DHCPV4=n on ESP32 boards so
	  DHCP does not override it (see overlay-static-ip.conf.example).

config APP_STATIC_IP_ADDR
	string "Static IPv4 address"
	default "192.168.68.200"
	depends on APP_STATIC_IP

config APP_STATIC_NETMASK
	string "Static IPv4 netmask"
	default "255.255.252.0"
	depends on APP_STATIC_IP

config APP_STATIC_GW
	string "Static IPv4 gateway"
	default "192.168.68.1"
	depends on APP_STATIC_IP

config APP_WIFI_MAC
	string "Override Wi-Fi station MAC (AA:BB:CC:DD:EE:FF; empty = factory MAC)"
	default ""
	depends on APP_WIFI
	help
	  If non-empty, set the Wi-Fi station MAC to this address before
	  connecting (ESP32 only). Use a locally-administered unicast address
	  (second-least-significant bit of the first octet set, e.g. 02:...).
	  Useful to test whether the router is blocking the factory MAC.

config APP_WIFI_SSID
	string "Wi-Fi SSID"
	default ""
	depends on APP_WIFI
	help
	  Wi-Fi network name. Provide via a git-ignored local overlay
	  (see overlay-wifi-credentials.conf.example) rather than committing it.

config APP_WIFI_PSK
	string "Wi-Fi password (PSK)"
	default ""
	depends on APP_WIFI
	help
	  Wi-Fi pre-shared key. Provide via a git-ignored local overlay; do not
	  commit real credentials to the repository.

endmenu # Wi-Fi

endmenu # OPC-UA server firmware options

source "Kconfig.zephyr"
```

## west.yml
```
# West manifest for the OPC-UA server firmware (T2 "workspace application" topology).
#
# First-time setup (inside the Zephyr build container or a host Zephyr install):
#   west init -l .          # this repo is the manifest repo
#   west update             # clones Zephyr + modules + open62541 as siblings
#   west zephyr-export
#
# See README.md for the macOS/Docker workflow.
manifest:
  version: "1.2"

  remotes:
    - name: zephyrproject-rtos
      url-base: https://github.com/zephyrproject-rtos
    - name: open62541
      url-base: https://github.com/open62541
    - name: thin-edge
      url-base: https://github.com/thin-edge

  projects:
    # Upstream Zephyr. Pinned to v4.4.2, which targets Zephyr SDK 1.0.x and
    # supports all our boards (native_sim, ESP32, ESP32-S2, Pico W).
    - name: zephyr
      remote: zephyrproject-rtos
      revision: v4.4.2
      import:
        # Bring in the HAL/modules our boards and the OPC-UA stack need.
        # Trimmed from the full set to keep `west update` smaller/faster.
        name-allowlist:
          - cmsis                 # Cortex-M (Pico W)
          - cmsis_6               # Cortex-M core headers (cmsis_core.h) since Zephyr 4.x
          - hal_espressif         # ESP32 / ESP32-S2 SoC + Wi-Fi
          - hal_infineon          # CYW43 Wi-Fi (Pico W)
          - hal_rpi_pico          # RP2040
          - mcuboot               # bootloader: A/B OTA slots + provisioning partition
          - mbedtls               # crypto (pulled in by ESP32 Wi-Fi; future TLS)
          - tf-psa-crypto         # mbedtls 4.x PSA crypto backend
          - picolibc              # default C library
          - segger                # RTT logging (optional)

    # OPC-UA stack. Integrated via the in-repo Zephyr module wrapper under
    # modules/open62541 (see that directory's CMakeLists.txt / Kconfig).
    - name: open62541
      remote: open62541
      revision: v1.4.0
      path: modules/lib/open62541
      submodules: true

    # thin-edge.io device-management client. A Zephyr module (`tedge`): west
    # adds it to every build, and it compiles nothing unless an image sets
    # CONFIG_TEDGE=y. Pin a release tag; move the pin to pick up a new one.
    - name: tiny-edge
      remote: thin-edge
      revision: v0.5.0
      path: modules/lib/tiny-edge

  self:
    path: app
```

## prj.conf
```kconfig
# SPDX-License-Identifier: Apache-2.0
#
# Board-agnostic application configuration. Networking stack specifics and
# Wi-Fi live in boards/<board>.conf; secrets live in a git-ignored overlay
# (see overlay-wifi-credentials.conf.example).

# --- Logging ---
CONFIG_LOG=y
CONFIG_LOG_DEFAULT_LEVEL=3

# --- Runtime / memory ---
CONFIG_MAIN_STACK_SIZE=8192
CONFIG_HEAP_MEM_POOL_SIZE=131072
CONFIG_POSIX_API=y

# --- Networking (BSD sockets API; stack specifics per board) ---
CONFIG_NETWORKING=y
CONFIG_NET_SOCKETS=y
CONFIG_NET_LOG=y
```

## overlay-diag.conf
```kconfig
# SPDX-License-Identifier: Apache-2.0
#
# Diagnostic overlay for stall investigations (not for deployed builds).
# Add it with -DEXTRA_CONF_FILE="overlay-wifi-credentials.conf;overlay-diag.conf"
# and read the output as described in the README's troubleshooting section.

# Periodic HEALTH line, STALE reports and thread dumps (lib/common/diag.c).
CONFIG_APP_DIAG=y
CONFIG_APP_DIAG_PERIOD_S=10

# Write every log message out as it is logged, so what was printed just before
# a stall reaches the console even if the log thread never runs again.
CONFIG_LOG_MODE_IMMEDIATE=y

# Immediate logging formats every message on the caller's stack, so the
# threads that log need more room than in a release build.
CONFIG_SYSTEM_WORKQUEUE_STACK_SIZE=2048
CONFIG_APP_NET_WORKQ_STACK_SIZE=4096

# Free-count sources for the HEALTH line.
CONFIG_NET_BUF_POOL_USAGE=y
CONFIG_SYS_HEAP_RUNTIME_STATS=y

# Per-thread stack headroom in thread dumps, plus the thread analyzer for an
# on-demand report.
CONFIG_INIT_STACKS=y
CONFIG_THREAD_STACK_INFO=y
CONFIG_THREAD_ANALYZER=y
CONFIG_THREAD_ANALYZER_USE_LOG=y

# Backtraces on a fatal exception: on ESP32 (Xtensa) that is
# CONFIG_XTENSA_ENABLE_BACKTRACE, already on by default. The generic
# CONFIG_EXCEPTION_STACK_TRACE needs ARCH_STACKWALK, which Xtensa lacks.
```

## boards/adafruit_feather_esp32s2_tft_esp32s2.conf
```kconfig
# SPDX-License-Identifier: Apache-2.0
#
# Adafruit Feather ESP32-S2 TFT (co-primary target): single-core Xtensa LX7
# Wi-Fi with 2 MB PSRAM. Build target: adafruit_feather_esp32s2_tft/esp32s2.

# --- Wi-Fi driver ---
CONFIG_WIFI=y
CONFIG_WIFI_ESP32=y
CONFIG_APP_WIFI=y

CONFIG_NET_MGMT=y
CONFIG_NET_MGMT_EVENT=y
CONFIG_NET_MGMT_EVENT_INFO=y
CONFIG_NET_CONNECTION_MANAGER=y

# open62541 uses the libc malloc arena (sized "all remaining RAM"); keep the
# separate k_heap small so it does not steal from that arena. The S2's 320 KB
# internal SRAM is ample for the tuned open62541 build, so PSRAM is not required
# here. (Enabling CONFIG_ESP_SPIRAM needs extra linker-region config; left off.)
CONFIG_HEAP_MEM_POOL_SIZE=16384

# --- IP stack ---
CONFIG_NET_L2_ETHERNET=y
CONFIG_NET_IPV4=y
CONFIG_NET_IPV6=n
CONFIG_NET_UDP=y
CONFIG_NET_TCP=y
CONFIG_NET_DHCPV4=y

# --- mDNS / DNS-SD advertisement ---
CONFIG_NET_HOSTNAME_ENABLE=y
CONFIG_NET_HOSTNAME="tedge-opcua"
CONFIG_NET_HOSTNAME_UNIQUE=y
CONFIG_MDNS_RESPONDER=y
CONFIG_DNS_SD=y

# --- Built-in TFT status display (ST7789 over MIPI-DBI SPI) ---
CONFIG_APP_DISPLAY_STATUS=y
CONFIG_DISPLAY=y
CONFIG_MIPI_DBI=y
CONFIG_ST7789V=y
CONFIG_ST7789V_RGB565=y
CONFIG_SPI=y
CONFIG_GPIO=y
CONFIG_POWER_DOMAIN=y

# Socket / net buffer budget.
CONFIG_NET_MAX_CONTEXTS=8
CONFIG_NET_MAX_CONN=6
CONFIG_ZVFS_OPEN_MAX=12
CONFIG_NET_PKT_RX_COUNT=6
CONFIG_NET_PKT_TX_COUNT=6
CONFIG_NET_BUF_RX_COUNT=16
CONFIG_NET_BUF_TX_COUNT=16

# Wi-Fi robustness on mesh networks: auto-reconnect on drop, and scan all APs
# to pick the strongest (not just the first found — important with multiple
# mesh nodes sharing one SSID).
CONFIG_ESP32_WIFI_STA_RECONNECT=y
CONFIG_ESP32_WIFI_STA_SCAN_ALL=y
```

## boards/esp32_devkitc_esp32_procpu.conf
```kconfig
# SPDX-License-Identifier: Apache-2.0
#
# ESP32-WROOM-32 (co-primary target): Wi-Fi station + native IP stack + mDNS.

# Allow running on older ESP32 silicon (e.g. WROOM-32 chip revision v1.0),
# which the v4.4 bootloader otherwise refuses to boot.
CONFIG_ESP32_USE_UNSUPPORTED_REVISION=y

# --- Wi-Fi driver ---
CONFIG_WIFI=y
CONFIG_WIFI_ESP32=y
CONFIG_APP_WIFI=y

# open62541 allocates via libc malloc, whose arena is "all remaining RAM"
# (CONFIG_COMMON_LIBC_MALLOC_ARENA_SIZE=-1). Keep the separate k_heap small so
# it does not steal RAM from that arena; the net/Wi-Fi stacks use net_buf pools
# and the Espressif blob's own heap, not this k_heap.
CONFIG_HEAP_MEM_POOL_SIZE=16384
CONFIG_NET_MGMT=y
CONFIG_NET_MGMT_EVENT=y
CONFIG_NET_MGMT_EVENT_INFO=y
CONFIG_NET_CONNECTION_MANAGER=y

# --- IP stack ---
CONFIG_NET_L2_ETHERNET=y
CONFIG_NET_IPV4=y
CONFIG_NET_IPV6=n
CONFIG_NET_UDP=y
CONFIG_NET_TCP=y
CONFIG_NET_DHCPV4=y

# --- mDNS / DNS-SD advertisement ---
CONFIG_NET_HOSTNAME_ENABLE=y
CONFIG_NET_HOSTNAME="tedge-opcua"
CONFIG_NET_HOSTNAME_UNIQUE=y
CONFIG_MDNS_RESPONDER=y
CONFIG_DNS_SD=y

# Socket / connection headroom for the OPC-UA server. Sized with margin so a
# burst of client (re)connections does not exhaust contexts/file descriptors —
# which would make the event loop's select() fail with ENOMEM and wedge the
# whole network stack (see the connection-churn stress test).
CONFIG_NET_MAX_CONTEXTS=12
CONFIG_NET_MAX_CONN=10
CONFIG_ZVFS_OPEN_MAX=16

# Free closed TCP connections quickly (default 1500 ms). A collector that
# reconnects frequently otherwise leaves many contexts pinned in TIME_WAIT.
CONFIG_NET_TCP_TIME_WAIT_DELAY=250

# --- RAM budget tuning (WROOM-32 has no PSRAM) ---
# The Wi-Fi stack and open62541 share ~300 KB of SRAM. These pools must be deep
# enough that a burst of client (re)connections does not starve the Wi-Fi driver
# of RX net buffers ("esp32_wifi: Failed to allocate net buffer"), which would
# otherwise wedge the network path. Sized with margin (verified via the
# connection-churn stress test) while still leaving heap for open62541.
CONFIG_NET_PKT_RX_COUNT=10
CONFIG_NET_PKT_TX_COUNT=10
CONFIG_NET_BUF_RX_COUNT=40
CONFIG_NET_BUF_TX_COUNT=32
```

## boards/esp32s2_saola.conf
```kconfig
# SPDX-License-Identifier: Apache-2.0
#
# ESP32-S2 (co-primary target; representative board for the Feather ESP32-S2
# TFT). Single-core Wi-Fi with 2 MB PSRAM used to give the OPC-UA stack heap
# headroom. If your exact board differs, copy this to boards/<your-board>.conf.

# --- Wi-Fi driver ---
CONFIG_WIFI=y
CONFIG_WIFI_ESP32=y
CONFIG_APP_WIFI=y

CONFIG_NET_MGMT=y
CONFIG_NET_MGMT_EVENT=y
CONFIG_NET_MGMT_EVENT_INFO=y
CONFIG_NET_CONNECTION_MANAGER=y

# --- External PSRAM (2 MB) — the practical memory enabler on this part ---
CONFIG_ESP_SPIRAM=y
CONFIG_ESP_SPIRAM_HEAP_SIZE=262144
# Route the system heap into PSRAM so open62541's dynamic allocations have room.
CONFIG_HEAP_MEM_POOL_SIZE=262144

# --- IP stack ---
CONFIG_NET_L2_ETHERNET=y
CONFIG_NET_IPV4=y
CONFIG_NET_IPV6=n
CONFIG_NET_UDP=y
CONFIG_NET_TCP=y
CONFIG_NET_DHCPV4=y

# --- mDNS / DNS-SD advertisement ---
CONFIG_NET_HOSTNAME_ENABLE=y
CONFIG_NET_HOSTNAME="tedge-opcua"
CONFIG_MDNS_RESPONDER=y
CONFIG_DNS_SD=y

CONFIG_NET_MAX_CONTEXTS=16
CONFIG_NET_MAX_CONN=8
CONFIG_ZVFS_OPEN_MAX=16
```

## boards/native_sim_native_64.conf
```kconfig
# SPDX-License-Identifier: Apache-2.0
#
# native_sim networking via NSOS (Native Simulator Offloaded Sockets): Zephyr
# BSD socket calls are routed straight to the host OS. A real OPC-UA client on
# the host/container can then connect to the server's port without setting up a
# zeth TAP interface (no root/CAP_NET_ADMIN needed) — ideal for automated tests.
#
# Note: the Zephyr-native IP stack, DHCP and mDNS responder are bypassed in this
# mode, so those features are validated on hardware, not here.
CONFIG_ETH_NATIVE_TAP=n
CONFIG_NET_DRIVERS=y
CONFIG_NET_SOCKETS=y
CONFIG_NET_SOCKETS_OFFLOAD=y
CONFIG_NET_NATIVE_OFFLOADED_SOCKETS=y
CONFIG_NET_IPV6_DAD=n

# open62541 allocates via libc malloc; the default 16 KB arena is far too small
# for the OPC-UA stack. The host has ample RAM, so give native_sim a large arena.
CONFIG_COMMON_LIBC_MALLOC_ARENA_SIZE=4194304
```

## boards/rpi_pico.conf
```kconfig
# SPDX-License-Identifier: Apache-2.0
#
# Raspberry Pi Pico W (RP2040 + CYW43 Wi-Fi) — additional/stretch target.
# Build for the Pico W target (e.g. `-b rpi_pico/rp2040/w` or `rpi_pico_w`,
# depending on your Zephyr version). RP2040 has only ~264 KB SRAM shared with
# the Wi-Fi stack, so this is the tightest target and may be descoped if
# open62541 does not fit. Zephyr's CYW43 Wi-Fi support is less mature than
# ESP32's — bring up a raw TCP socket before layering OPC-UA on top.

# --- Wi-Fi driver (CYW43 via Infineon HAL) ---
CONFIG_WIFI=y
CONFIG_APP_WIFI=y

CONFIG_NET_MGMT=y
CONFIG_NET_MGMT_EVENT=y
CONFIG_NET_MGMT_EVENT_INFO=y
CONFIG_NET_CONNECTION_MANAGER=y

# --- IP stack ---
CONFIG_NET_L2_ETHERNET=y
CONFIG_NET_IPV4=y
CONFIG_NET_IPV6=n
CONFIG_NET_UDP=y
CONFIG_NET_TCP=y
CONFIG_NET_DHCPV4=y

# --- mDNS / DNS-SD advertisement ---
CONFIG_NET_HOSTNAME_ENABLE=y
CONFIG_NET_HOSTNAME="tedge-opcua"
CONFIG_MDNS_RESPONDER=y
CONFIG_DNS_SD=y

# Keep memory usage tight on RP2040.
CONFIG_NET_MAX_CONTEXTS=8
CONFIG_NET_MAX_CONN=4
CONFIG_ZVFS_OPEN_MAX=12
```

## boards/adafruit_feather_esp32s2_tft_esp32s2.overlay
```dts
/* SPDX-License-Identifier: Apache-2.0
 *
 * The Adafruit Feather ESP32-S2 board devicetree leaves the Wi-Fi node
 * disabled. Enable it so CONFIG_WIFI_ESP32 (which depends on
 * DT_HAS_ESPRESSIF_ESP32_WIFI_ENABLED) can be selected.
 */
&wifi {
	status = "okay";
};
```

## src/main.c
```c
/* SPDX-License-Identifier: Apache-2.0
 *
 * OPC-UA server firmware entry point.
 *
 * Boot sequence:
 *   1. Bring up connectivity (Wi-Fi station on hardware; host networking on
 *      native_sim) and wait until the network is usable.
 *   2. Start the OPC-UA server (when CONFIG_APP_OPCUA_SERVER is enabled).
 */

#include <zephyr/kernel.h>
#include <zephyr/logging/log.h>

#include "net.h"

#if defined(CONFIG_APP_OPCUA_SERVER)
#include "opcua_server.h"
#endif

LOG_MODULE_REGISTER(main, CONFIG_LOG_DEFAULT_LEVEL);

int main(void)
{
	int ret;

	LOG_INF("OPC-UA server firmware starting: device \"%s\"",
		CONFIG_APP_DEVICE_NAME);

	ret = app_net_init();
	if (ret) {
		LOG_ERR("Connectivity init failed (%d)", ret);
		return 0;
	}

	LOG_INF("Waiting for network...");
	ret = app_net_wait_connected(K_SECONDS(60));
	if (ret) {
		LOG_ERR("Network did not come up in time (%d)", ret);
		return 0;
	}

#if defined(CONFIG_APP_OPCUA_SERVER)
	ret = opcua_server_start();
	if (ret) {
		LOG_ERR("Failed to start OPC-UA server (%d)", ret);
		return 0;
	}
	LOG_INF("OPC-UA server running on port %d", CONFIG_APP_OPCUA_PORT);
#else
	LOG_INF("OPC-UA server disabled (CONFIG_APP_OPCUA_SERVER=n) — "
		"connectivity skeleton only");
#endif

	return 0;
}
```

## src/address_space.c
```c
/* SPDX-License-Identifier: Apache-2.0 */

#include "address_space.h"
#include "data_source.h"
#include "net.h"

#include <zephyr/kernel.h>
#include <zephyr/logging/log.h>
#include <app_version.h> /* APP_VERSION_STRING, generated from the VERSION file */

#include <open62541.h>

LOG_MODULE_REGISTER(app_addrspace, CONFIG_LOG_DEFAULT_LEVEL);

/* Application namespace index (namespace 0 is the OPC-UA standard space). */
#define APP_NS 1

/* Node id of the Device object; measurement variables hang off it. */
static UA_NodeId device_node_id;

/* One string node id per measurement, so update() can write values back. */
#define MAX_MEASUREMENTS 16
static UA_NodeId measurement_ids[MAX_MEASUREMENTS];
static size_t measurement_count;

/* Writable control points (in-RAM, not persisted), exposed in the application
 * namespace (ns=1) alongside the device identity and measurements. */
static int32_t g_setpoint = CONFIG_APP_SETPOINT_DEFAULT;
static bool g_running = IS_ENABLED(CONFIG_APP_RUNNING_DEFAULT);
static bool writing_back; /* guards value-callback recursion on clamp write-back */

int32_t address_space_setpoint(void)
{
	return g_setpoint;
}

bool address_space_running(void)
{
	return g_running;
}

static UA_StatusCode add_device_object(UA_Server *server)
{
	UA_ObjectAttributes oAttr = UA_ObjectAttributes_default;
	/* Display the unique per-device hostname so devices are distinguishable
	 * when browsing; keep the browse name stable for predictable navigation. */
	oAttr.displayName = UA_LOCALIZEDTEXT("en-US", (char *)app_net_hostname());
	oAttr.description = UA_LOCALIZEDTEXT("en-US",
					    "Zephyr OPC-UA device (Phase 1)");

	device_node_id = UA_NODEID_STRING_ALLOC(APP_NS, "Device");

	return UA_Server_addObjectNode(
		server, device_node_id,
		UA_NODEID_NUMERIC(0, UA_NS0ID_OBJECTSFOLDER),
		UA_NODEID_NUMERIC(0, UA_NS0ID_ORGANIZES),
		UA_QUALIFIEDNAME(APP_NS, (char *)CONFIG_APP_DEVICE_NAME),
		UA_NODEID_NUMERIC(0, UA_NS0ID_BASEOBJECTTYPE),
		oAttr, NULL, NULL);
}

static UA_StatusCode add_measurement_variable(UA_Server *server, size_t index)
{
	const struct data_measurement *m = data_source_descriptor(index);

	if (m == NULL) {
		return UA_STATUSCODE_BADOUTOFRANGE;
	}

	UA_VariableAttributes vAttr = UA_VariableAttributes_default;
	UA_Double initial = data_source_sample(index);
	UA_Variant_setScalar(&vAttr.value, &initial, &UA_TYPES[UA_TYPES_DOUBLE]);
	vAttr.displayName = UA_LOCALIZEDTEXT("en-US", (char *)m->name);
	vAttr.description = UA_LOCALIZEDTEXT("en-US", (char *)m->unit);
	vAttr.dataType = UA_TYPES[UA_TYPES_DOUBLE].typeId;
	vAttr.accessLevel = UA_ACCESSLEVELMASK_READ;

	measurement_ids[index] = UA_NODEID_STRING_ALLOC(APP_NS, (char *)m->name);

	return UA_Server_addVariableNode(
		server, measurement_ids[index],
		device_node_id,
		UA_NODEID_NUMERIC(0, UA_NS0ID_HASCOMPONENT),
		UA_QUALIFIEDNAME(APP_NS, (char *)m->name),
		UA_NODEID_NUMERIC(0, UA_NS0ID_BASEDATAVARIABLETYPE),
		vAttr, NULL, NULL);
}

/* Add a read-only string node under Device. `value` must point at storage that
 * outlives the server (a static buffer or string literal): UA_STRING does not
 * copy, so the node references it directly. */
static UA_StatusCode add_readonly_string(UA_Server *server, const char *id,
					 const char *description,
					 const char *value)
{
	UA_VariableAttributes vAttr = UA_VariableAttributes_default;
	UA_String s = UA_STRING((char *)value);

	UA_Variant_setScalar(&vAttr.value, &s, &UA_TYPES[UA_TYPES_STRING]);
	vAttr.displayName = UA_LOCALIZEDTEXT("en-US", (char *)id);
	vAttr.description = UA_LOCALIZEDTEXT("en-US", (char *)description);
	vAttr.dataType = UA_TYPES[UA_TYPES_STRING].typeId;
	vAttr.accessLevel = UA_ACCESSLEVELMASK_READ;

	return UA_Server_addVariableNode(
		server, UA_NODEID_STRING(APP_NS, (char *)id),
		device_node_id,
		UA_NODEID_NUMERIC(0, UA_NS0ID_HASCOMPONENT),
		UA_QUALIFIEDNAME(APP_NS, (char *)id),
		UA_NODEID_NUMERIC(0, UA_NS0ID_BASEDATAVARIABLETYPE),
		vAttr, NULL, NULL);
}

/* Read-only identity/build nodes: which physical device this is, and which
 * firmware it is running (so an operator/collector can tell at a glance whether
 * a device needs reflashing). The hostname buffer and the version/build-time
 * literals all have static lifetime, so add_readonly_string may reference them. */
static void add_info_nodes(UA_Server *server)
{
	(void)add_readonly_string(server, "DeviceId",
		"Unique device id (hostname incl. MAC suffix)",
		app_net_hostname());
	(void)add_readonly_string(server, "FirmwareName",
		"Firmware image/application name",
		CONFIG_APP_FIRMWARE_NAME);
	(void)add_readonly_string(server, "FirmwareVersion",
		"Application firmware version (from the VERSION file)",
		APP_VERSION_STRING);
	(void)add_readonly_string(server, "BuildTimestamp",
		"Firmware build date/time (compiler __DATE__ __TIME__)",
		__DATE__ " " __TIME__);
}

/* Value-callback invoked after a client writes the setpoint node. Clamp to the
 * configured range, store, log, and (if clamped) write the corrected value back. */
static void on_setpoint_write(UA_Server *server, const UA_NodeId *sid,
			      void *sctx, const UA_NodeId *nodeId, void *nctx,
			      const UA_NumericRange *range,
			      const UA_DataValue *data)
{
	ARG_UNUSED(sid); ARG_UNUSED(sctx); ARG_UNUSED(nctx); ARG_UNUSED(range);

	if (writing_back || !data->hasValue ||
	    !UA_Variant_hasScalarType(&data->value, &UA_TYPES[UA_TYPES_INT32])) {
		return;
	}

	int32_t v = *(UA_Int32 *)data->value.data;
	int32_t clamped = v;

	if (clamped < CONFIG_APP_SETPOINT_MIN) {
		clamped = CONFIG_APP_SETPOINT_MIN;
	}
	if (clamped > CONFIG_APP_SETPOINT_MAX) {
		clamped = CONFIG_APP_SETPOINT_MAX;
	}
	g_setpoint = clamped;
	LOG_INF("Setpoint written: %d (raw %d)", clamped, v);

	if (clamped != v) {
		UA_Variant val;

		UA_Variant_setScalar(&val, &clamped, &UA_TYPES[UA_TYPES_INT32]);
		writing_back = true;
		UA_Server_writeValue(server, *nodeId, val);
		writing_back = false;
	}
}

static void on_running_write(UA_Server *server, const UA_NodeId *sid,
			     void *sctx, const UA_NodeId *nodeId, void *nctx,
			     const UA_NumericRange *range,
			     const UA_DataValue *data)
{
	ARG_UNUSED(server); ARG_UNUSED(sid); ARG_UNUSED(sctx);
	ARG_UNUSED(nodeId); ARG_UNUSED(nctx); ARG_UNUSED(range);

	if (!data->hasValue ||
	    !UA_Variant_hasScalarType(&data->value, &UA_TYPES[UA_TYPES_BOOLEAN])) {
		return;
	}
	g_running = *(UA_Boolean *)data->value.data;
	LOG_INF("Running written: %s", g_running ? "true" : "false");
}

/* Add a writable scalar node under Device (in the application namespace) and
 * register its write callback. `id` is both the string node id and browse name. */
static UA_StatusCode add_writable(UA_Server *server, const char *id,
				  const char *description,
				  const UA_DataType *type, void *initial,
				  UA_ValueCallback cb)
{
	UA_VariableAttributes vAttr = UA_VariableAttributes_default;

	UA_Variant_setScalar(&vAttr.value, initial, type);
	vAttr.displayName = UA_LOCALIZEDTEXT("en-US", (char *)id);
	vAttr.description = UA_LOCALIZEDTEXT("en-US", (char *)description);
	vAttr.dataType = type->typeId;
	vAttr.accessLevel = UA_ACCESSLEVELMASK_READ | UA_ACCESSLEVELMASK_WRITE;

	UA_StatusCode rc = UA_Server_addVariableNode(
		server, UA_NODEID_STRING(APP_NS, (char *)id),
		device_node_id,
		UA_NODEID_NUMERIC(0, UA_NS0ID_HASCOMPONENT),
		UA_QUALIFIEDNAME(APP_NS, (char *)id),
		UA_NODEID_NUMERIC(0, UA_NS0ID_BASEDATAVARIABLETYPE),
		vAttr, NULL, NULL);
	if (rc != UA_STATUSCODE_GOOD) {
		return rc;
	}

	return UA_Server_setVariableNode_valueCallback(
		server, UA_NODEID_STRING(APP_NS, (char *)id), cb);
}

static void add_control_nodes(UA_Server *server)
{
	UA_Int32 sp = g_setpoint;
	UA_Boolean run = g_running;
	UA_ValueCallback sp_cb = { .onRead = NULL, .onWrite = on_setpoint_write };
	UA_ValueCallback run_cb = { .onRead = NULL, .onWrite = on_running_write };

	if (add_writable(server, "Setpoint", "Operator-settable target value",
			 &UA_TYPES[UA_TYPES_INT32], &sp, sp_cb) != UA_STATUSCODE_GOOD) {
		LOG_WRN("Failed to add writable Setpoint node");
	}
	if (add_writable(server, "Running", "Whether the simulated process is running",
			 &UA_TYPES[UA_TYPES_BOOLEAN], &run, run_cb) != UA_STATUSCODE_GOOD) {
		LOG_WRN("Failed to add writable Running node");
	}
}

UA_StatusCode address_space_setup(UA_Server *server)
{
	UA_StatusCode rc;

	data_source_init();

	rc = add_device_object(server);
	if (rc != UA_STATUSCODE_GOOD) {
		LOG_ERR("Failed to add Device object: %s",
			UA_StatusCode_name(rc));
		return rc;
	}

	add_info_nodes(server); /* DeviceId + FirmwareVersion + BuildTimestamp */

	measurement_count = data_source_count();
	if (measurement_count > MAX_MEASUREMENTS) {
		LOG_WRN("Clamping measurements %zu -> %d",
			measurement_count, MAX_MEASUREMENTS);
		measurement_count = MAX_MEASUREMENTS;
	}

	for (size_t i = 0; i < measurement_count; i++) {
		rc = add_measurement_variable(server, i);
		if (rc != UA_STATUSCODE_GOOD) {
			LOG_ERR("Failed to add measurement %zu: %s", i,
				UA_StatusCode_name(rc));
			return rc;
		}
	}

	add_control_nodes(server); /* writable setpoint + enabled */

	LOG_INF("Address space ready: Device + %zu measurement(s) + controls",
		measurement_count);
	return UA_STATUSCODE_GOOD;
}

void address_space_update(UA_Server *server)
{
	for (size_t i = 0; i < measurement_count; i++) {
		UA_Double value = data_source_sample(i);
		UA_Variant v;
		UA_Variant_init(&v);
		UA_Variant_setScalar(&v, &value, &UA_TYPES[UA_TYPES_DOUBLE]);
		UA_Server_writeValue(server, measurement_ids[i], v);
	}
}
```

## src/address_space.h
```c
/* SPDX-License-Identifier: Apache-2.0
 *
 * Builds and maintains the OPC-UA address space from the data source. Kept
 * separate from server lifecycle so the node layout is easy to reason about.
 */
#ifndef APP_ADDRESS_SPACE_H_
#define APP_ADDRESS_SPACE_H_

#include <open62541.h>

/**
 * Populate the server's address space: a Device object carrying identity
 * metadata plus one Variable node per data-source measurement.
 *
 * @param server the OPC-UA server to add nodes to.
 * @return UA_STATUSCODE_GOOD on success, an error status otherwise.
 */
UA_StatusCode address_space_setup(UA_Server *server);

/**
 * Sample every measurement from the data source and write the current values
 * into their variable nodes. Intended to be called periodically from the
 * server's own context (e.g. a repeated callback).
 *
 * @param server the OPC-UA server whose nodes should be updated.
 */
void address_space_update(UA_Server *server);

/** @return the current value of the writable `Setpoint` control node. */
int32_t address_space_setpoint(void);

/** @return the current value of the writable `Running` control node. */
bool address_space_running(void);

#endif /* APP_ADDRESS_SPACE_H_ */
```

## src/data_source.c
```c
/* SPDX-License-Identifier: Apache-2.0
 *
 * Simulated data source: produces changing, in-range synthetic values so the
 * OPC-UA server has something meaningful to serve before real sensors are
 * wired in. Values vary smoothly over time (deterministically, from the system
 * uptime) so a client polling the same node sees it change.
 */

#include "data_source.h"

#include <math.h>
#include <zephyr/kernel.h>

/* Each measurement oscillates as base + amplitude * sin(2*pi*t / period). */
struct sim_signal {
	struct data_measurement desc;
	double base;
	double amplitude;
	double period_s;
};

static const struct sim_signal signals[] = {
	{ .desc = { .name = "temperature", .unit = "Cel" },
	  .base = 22.0, .amplitude = 3.0,  .period_s = 60.0 },
	{ .desc = { .name = "humidity",    .unit = "%RH" },
	  .base = 45.0, .amplitude = 10.0, .period_s = 120.0 },
	{ .desc = { .name = "pressure",    .unit = "hPa" },
	  .base = 1013.0, .amplitude = 5.0, .period_s = 300.0 },
};

#define SIM_COUNT ARRAY_SIZE(signals)

void data_source_init(void)
{
	/* Nothing to initialise for the simulated source. */
}

size_t data_source_count(void)
{
	return SIM_COUNT;
}

const struct data_measurement *data_source_descriptor(size_t index)
{
	if (index >= SIM_COUNT) {
		return NULL;
	}
	return &signals[index].desc;
}

double data_source_sample(size_t index)
{
	if (index >= SIM_COUNT) {
		return 0.0;
	}

	const struct sim_signal *s = &signals[index];
	double t = (double)k_uptime_get() / 1000.0; /* seconds */
	double phase = 2.0 * 3.14159265358979323846 * t / s->period_s;

	return s->base + s->amplitude * sin(phase);
}
```

## src/data_source.h
```c
/* SPDX-License-Identifier: Apache-2.0
 *
 * Data source abstraction — decoupled from the OPC-UA layer.
 *
 * The OPC-UA address space asks this module "how many measurements are there,
 * what are they called, and what is the current value?". A real sensor backend
 * can replace the simulated implementation without any change to the OPC-UA
 * code, as long as it satisfies this interface.
 */
#ifndef APP_DATA_SOURCE_H_
#define APP_DATA_SOURCE_H_

#include <stddef.h>

/** A measurement descriptor. */
struct data_measurement {
	const char *name; /**< Stable identifier / browse name, e.g. "temperature". */
	const char *unit; /**< Engineering unit, e.g. "Cel". */
};

/** Initialise the data source (called once at startup). */
void data_source_init(void);

/** @return number of measurements this source provides. */
size_t data_source_count(void);

/**
 * @param index measurement index in [0, data_source_count()).
 * @return the measurement's static descriptor, or NULL if out of range.
 */
const struct data_measurement *data_source_descriptor(size_t index);

/**
 * Sample the current value for a measurement.
 *
 * @param index measurement index in [0, data_source_count()).
 * @return current value; 0.0 if index is out of range.
 */
double data_source_sample(size_t index);

#endif /* APP_DATA_SOURCE_H_ */
```

## src/display.c
```c
/* SPDX-License-Identifier: Apache-2.0 */

#include "display.h"

#include <zephyr/kernel.h>
#include <zephyr/logging/log.h>

LOG_MODULE_REGISTER(app_display, CONFIG_LOG_DEFAULT_LEVEL);

#if defined(CONFIG_APP_DISPLAY_STATUS) && DT_HAS_CHOSEN(zephyr_display)

#include <zephyr/device.h>
#include <zephyr/drivers/display.h>
#include <zephyr/sys/byteorder.h>
#include <string.h>

#include "font8x8.inc"

#define DISP_W 135
#define DISP_H 240

/* RGB565 colours (drawn big-endian to match the ST7789). */
#define C_RED    0xF800
#define C_BLUE   0x001F
#define C_GREEN  0x07E0
#define C_TEAL   0x0410
#define C_ORANGE 0xFC00
#define C_BLACK  0x0000
#define C_WHITE  0xFFFF

static const struct device *disp;
static bool ready;

/* One 8px-tall fill strip (135x8 RGB565). */
static uint16_t strip[DISP_W * 8];
/* Scratch buffer for one text line at scale 1 (135 wide x 8 tall). */
static uint16_t linebuf[DISP_W * 8];

static void fill(uint16_t color)
{
	uint16_t be = sys_cpu_to_be16(color);

	for (int i = 0; i < DISP_W * 8; i++) {
		strip[i] = be;
	}
	struct display_buffer_descriptor d = { .width = DISP_W, .pitch = DISP_W };

	for (int y = 0; y < DISP_H; y += 8) {
		int h = (y + 8 <= DISP_H) ? 8 : (DISP_H - y);

		d.height = h;
		d.buf_size = (uint32_t)DISP_W * h * 2;
		display_write(disp, 0, y, &d, strip);
	}
}

/* Render one line of text (scale 1, 8px tall) into linebuf and blit at row y. */
static void draw_line(int y, const char *s, uint16_t fg, uint16_t bg)
{
	uint16_t fbe = sys_cpu_to_be16(fg), bbe = sys_cpu_to_be16(bg);

	for (int i = 0; i < DISP_W * 8; i++) {
		linebuf[i] = bbe;
	}
	for (int col = 0; s[col] != '\0'; col++) {
		int x = col * 8;

		if (x + 8 > DISP_W) {
			break; /* clip lines wider than the screen */
		}
		char c = s[col];
		const uint8_t *g = (c >= 0x20 && c < 0x7F) ? font8x8[c - 0x20]
							   : font8x8[0];
		for (int row = 0; row < 8; row++) {
			for (int bit = 0; bit < 8; bit++) {
				if (g[row] & (0x80 >> bit)) {
					linebuf[row * DISP_W + x + bit] = fbe;
				}
			}
		}
	}

	struct display_buffer_descriptor d = {
		.buf_size = (uint32_t)DISP_W * 8 * 2,
		.width = DISP_W, .height = 8, .pitch = DISP_W,
	};
	display_write(disp, 0, y, &d, linebuf);
}

static uint16_t stage_color(enum display_stage stage)
{
	switch (stage) {
	case DISPLAY_STAGE_BOOT:            return C_RED;
	case DISPLAY_STAGE_WIFI_CONNECTING: return C_BLUE;
	case DISPLAY_STAGE_CONNECTED:       return C_GREEN;
	case DISPLAY_STAGE_SERVING:         return C_TEAL;
	default:                            return C_ORANGE;
	}
}

void display_status_init(void)
{
	disp = DEVICE_DT_GET(DT_CHOSEN(zephyr_display));
	if (!device_is_ready(disp)) {
		LOG_WRN("Display not ready; status screen disabled");
		disp = NULL;
		return;
	}
	display_blanking_off(disp);
	ready = true;
	fill(C_RED);
	LOG_INF("Status display initialised (%dx%d)", DISP_W, DISP_H);
}

void display_status_stage(enum display_stage stage)
{
	if (ready) {
		fill(stage_color(stage));
	}
}

void display_status_lines(enum display_stage stage, const char *const *lines,
			  size_t n)
{
	if (!ready) {
		return;
	}

	uint16_t bg = stage_color(stage);

	fill(bg);
	for (size_t i = 0; i < n; i++) {
		if (lines[i] == NULL) {
			continue;
		}
		int y = 4 + (int)i * 11; /* 8px glyph + 3px gap */

		if (y + 8 > DISP_H) {
			break;
		}
		draw_line(y, lines[i], C_WHITE, bg);
	}
}

#else /* no display configured */

void display_status_init(void) {}
void display_status_stage(enum display_stage stage) { ARG_UNUSED(stage); }
void display_status_lines(enum display_stage stage, const char *const *lines,
			  size_t n)
{
	ARG_UNUSED(stage); ARG_UNUSED(lines); ARG_UNUSED(n);
}

#endif
```

## src/display.h
```c
/* SPDX-License-Identifier: Apache-2.0
 *
 * Optional status display for boards with a TFT (e.g. Adafruit Feather
 * ESP32-S2 TFT). Used to relay connectivity state when no serial console is
 * available: a colour-coded background shows the stage, and the device's IPv4
 * address is drawn as large digits so it can be read off the screen.
 *
 * All functions are no-ops when CONFIG_APP_DISPLAY_STATUS is disabled or no
 * display is present, so callers need no guards.
 */
#ifndef APP_DISPLAY_H_
#define APP_DISPLAY_H_

#include <stdint.h>

/** Initialise the display. Safe to call when no display is configured. */
void display_status_init(void);

/** Stage indicator (background colour). */
enum display_stage {
	DISPLAY_STAGE_BOOT,		/* red    */
	DISPLAY_STAGE_WIFI_CONNECTING,	/* blue   */
	DISPLAY_STAGE_CONNECTED,	/* green  */
	DISPLAY_STAGE_SERVING,		/* teal   */
	DISPLAY_STAGE_ERROR,		/* orange */
};

/** Set the background colour for a stage (no address shown). */
void display_status_stage(enum display_stage stage);

/**
 * Show a stage plus an IPv4 address, drawn as four large octets stacked
 * vertically (e.g. 192 / 168 / 68 / 74) so it is easy to read back.
 *
 * @param stage background colour.
 * @param ipv4  address in network byte order (as from a struct in_addr).
 */
void display_status_ipv4(enum display_stage stage, uint32_t ipv4_be);

/**
 * Show a decimal number (e.g. a Wi-Fi status/reason code) as large centered
 * digits on a stage-coloured background. Useful for on-screen diagnostics.
 */
void display_status_code(enum display_stage stage, uint32_t code);

#endif /* APP_DISPLAY_H_ */
```

## src/net.h
```c
/* SPDX-License-Identifier: Apache-2.0
 *
 * Connectivity management: Wi-Fi station mode on hardware, host networking on
 * native_sim. Provides a simple "bring the network up and tell me when it's
 * ready" interface plus reconnect handling.
 */
#ifndef APP_NET_H_
#define APP_NET_H_

#include <zephyr/kernel.h>
#include "display.h"

/**
 * Start connectivity. On Wi-Fi targets this begins station-mode association
 * using the configured credentials and installs reconnect handling. On
 * native_sim (host-offloaded sockets) connectivity is provided by the host,
 * so this is effectively a no-op that reports "connected".
 *
 * @return 0 on success, negative errno on failure to start.
 */
int app_net_init(void);

/**
 * Block until the network is connected (usable for opening sockets) or the
 * timeout elapses.
 *
 * @param timeout how long to wait (K_FOREVER to wait indefinitely).
 * @return 0 if connected, -ETIMEDOUT on timeout.
 */
int app_net_wait_connected(k_timeout_t timeout);

/**
 * @return true if the network is currently considered connected.
 */
bool app_net_is_connected(void);

/**
 * @return the device's current IPv4 address in network byte order, or 0 if
 *         none is assigned (e.g. on native_sim offloaded sockets).
 */
uint32_t app_net_ipv4(void);

/**
 * @return the device's unique network hostname (base name plus a MAC-derived
 *         suffix when CONFIG_NET_HOSTNAME_UNIQUE is enabled). Stable per chip;
 *         used as the OPC-UA application name and mDNS/DNS-SD identity.
 */
const char *app_net_hostname(void);

/**
 * Render the current network diagnostics (IP, gateway, netmask, Wi-Fi RSSI/
 * state, last disconnect reason, hostname) on the status display for the given
 * stage. No-op when no display is present.
 */
void app_net_show_status(enum display_stage stage);

#endif /* APP_NET_H_ */
```

## src/opcua_server.c
```c
/* SPDX-License-Identifier: Apache-2.0 */

#include "opcua_server.h"
#include "address_space.h"
#include "net.h"
#include "display.h"

#include <zephyr/kernel.h>
#include <zephyr/logging/log.h>

#include <open62541.h>

LOG_MODULE_REGISTER(app_opcua, CONFIG_LOG_DEFAULT_LEVEL);

/* Called by the vendored open62541 event loop (Zephyr patch #9) when select()
 * fails — e.g. a transient ENOMEM from the socket layer under connection churn.
 * Yield briefly so the retry does not spin at ~100 Hz and starve the Wi-Fi/net
 * threads (which otherwise makes the whole device fall off the network). */
void ua_zephyr_backoff(void)
{
	k_msleep(50);
}

/* The open62541 encoders/decoders are stack-hungry; give the server thread
 * plenty of headroom. */
#define OPCUA_THREAD_STACK_SIZE 16384
#define OPCUA_THREAD_PRIORITY   5

K_THREAD_STACK_DEFINE(opcua_stack, OPCUA_THREAD_STACK_SIZE);
static struct k_thread opcua_thread;

static UA_Server *server;
static volatile bool running;

static void configure_server(UA_Server *srv)
{
	UA_ServerConfig *config = UA_Server_getConfig(srv);

	/* Identify the application/server by the unique per-device hostname so
	 * multiple devices on the network are individually distinguishable. */
	UA_LocalizedText_clear(&config->applicationDescription.applicationName);
	config->applicationDescription.applicationName =
		UA_LOCALIZEDTEXT_ALLOC("en-US", (char *)app_net_hostname());

	/* Bound resources for a constrained device: cap sessions and channels
	 * so excess client connections are rejected rather than exhausting
	 * memory. Keep secure channels >= sessions (open62541 requirement). */
	config->maxSessions = 4;
	config->maxSecureChannels = 6;
	/* Reclaim abandoned sessions quickly. A client that disconnects without a
	 * clean CloseSession (common with a polling collector or after a Wi-Fi
	 * blip) otherwise pins session resources for the full timeout; under
	 * repeated reconnects that starves the device. 10 s is ample for a healthy
	 * client to stay alive with keep-alives. */
	config->maxSessionTimeout = 10000.0; /* ms */

	/* Small per-connection send/recv buffers (8 kB) to fit constrained RAM.
	 * OPC-UA's minimum is 8192 bytes; our reads are tiny. */
	config->tcpBufSize = 8192;

#ifdef UA_ENABLE_SUBSCRIPTIONS
	/* Cap subscription resources so a client cannot exhaust device RAM. */
	config->maxSubscriptions = CONFIG_APP_OPCUA_MAX_SUBSCRIPTIONS;
	config->maxMonitoredItemsPerSubscription =
		CONFIG_APP_OPCUA_MAX_MONITORED_ITEMS;
#endif
}

static void opcua_thread_fn(void *a, void *b, void *c)
{
	ARG_UNUSED(a);
	ARG_UNUSED(b);
	ARG_UNUSED(c);

	UA_StatusCode rc;
	static UA_ServerConfig config;

	memset(&config, 0, sizeof(config));
	rc = UA_ServerConfig_setMinimal(&config, CONFIG_APP_OPCUA_PORT, NULL);
	if (rc != UA_STATUSCODE_GOOD) {
		LOG_ERR("Server config failed: %s (0x%08x)",
			UA_StatusCode_name(rc), rc);
		return;
	}

	server = UA_Server_newWithConfig(&config);
	if (server == NULL) {
		LOG_ERR("UA_Server_newWithConfig() failed");
		return;
	}

	configure_server(server);

	rc = address_space_setup(server);
	if (rc != UA_STATUSCODE_GOOD) {
		goto cleanup;
	}

	rc = UA_Server_run_startup(server);
	if (rc != UA_STATUSCODE_GOOD) {
		LOG_ERR("Server startup failed: %s", UA_StatusCode_name(rc));
		goto cleanup;
	}

	LOG_INF("OPC-UA server listening on opc.tcp://<device>:%d",
		CONFIG_APP_OPCUA_PORT);
	app_net_show_status(DISPLAY_STAGE_SERVING);

	/* Drive the server loop and sampling ourselves. We poll rather than let
	 * open62541 block in select() internally (more robust across Zephyr's
	 * socket backends), and we sample from the data source on Zephyr's
	 * monotonic clock (k_uptime_get) rather than open62541's repeated
	 * callbacks, whose POSIX timer clock does not advance under Zephyr. */
	int64_t last_sample = 0;
	while (running) {
		UA_Server_run_iterate(server, false);

		int64_t now = k_uptime_get();
		if (now - last_sample >= CONFIG_APP_SAMPLE_INTERVAL_MS) {
			address_space_update(server);
			last_sample = now;
		}
		k_msleep(10);
	}

	UA_Server_run_shutdown(server);

cleanup:
	UA_Server_delete(server);
	server = NULL;
}

int opcua_server_start(void)
{
	if (running) {
		return -EALREADY;
	}
	running = true;

	k_thread_create(&opcua_thread, opcua_stack,
			K_THREAD_STACK_SIZEOF(opcua_stack),
			opcua_thread_fn, NULL, NULL, NULL,
			OPCUA_THREAD_PRIORITY, 0, K_NO_WAIT);
	k_thread_name_set(&opcua_thread, "opcua");
	return 0;
}

void opcua_server_stop(void)
{
	running = false;
	k_thread_join(&opcua_thread, K_SECONDS(5));
}
```

## src/opcua_server.h
```c
/* SPDX-License-Identifier: Apache-2.0
 *
 * OPC-UA server lifecycle. The server runs in its own thread; it builds the
 * address space from the data source and serves read/browse requests until
 * stopped.
 */
#ifndef APP_OPCUA_SERVER_H_
#define APP_OPCUA_SERVER_H_

/**
 * Start the OPC-UA server. Spawns the server thread which sets up the address
 * space, binds the configured opc.tcp port and runs the event loop.
 *
 * @return 0 on success, negative errno on failure.
 */
int opcua_server_start(void);

/** Request the OPC-UA server to stop and join its thread. */
void opcua_server_stop(void);

#endif /* APP_OPCUA_SERVER_H_ */
```
