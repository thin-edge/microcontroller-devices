## CMakeLists.txt
```
# SPDX-License-Identifier: Apache-2.0
#
# Throwaway spike firmware for the c8y-direct-spikes change: measures TLS/MQTT
# to Cumulocity, OTA into slot1, Cumulocity CA enrollment and remote access.
# It stands in for a user application: lib/common brings Wi-Fi, identity and
# the data model, and tedge-zephyr is included the way any app would.
# Build with:
#   west build -b <board> apps/c8y-spike --sysbuild
cmake_minimum_required(VERSION 3.20.0)

list(APPEND ZEPHYR_EXTRA_MODULES
  ${CMAKE_CURRENT_SOURCE_DIR}/../../lib/common
  ${CMAKE_CURRENT_SOURCE_DIR}/../../tedge-zephyr
)

find_package(Zephyr REQUIRED HINTS $ENV{ZEPHYR_BASE})
project(c8y_spike_firmware C)

target_sources(app PRIVATE src/main.c)

if(CONFIG_SPIKE_TLS_MQTT)
  target_sources(app PRIVATE src/spike_time.c src/spike_mqtt.c)
  target_sources_ifdef(CONFIG_SPIKE_OTA app PRIVATE src/spike_ota.c)
  target_sources_ifdef(CONFIG_SPIKE_AUTH_ENROLLED app PRIVATE src/spike_enroll.c)
  target_sources_ifdef(CONFIG_SPIKE_REMOTE_ACCESS app PRIVATE src/spike_ra.c)

  # Credentials are embedded as NUL-terminated PEM. The server trust anchor
  # is public and committed; device credentials live in the git-ignored
  # credentials/ directory.
  set(gen_dir ${ZEPHYR_BINARY_DIR}/include/generated/spike)
  generate_inc_file_for_target(app certs/godaddy-root-g2.pem
    ${gen_dir}/server_ca.pem.inc)

  if(CONFIG_SPIKE_OTA_EXTRA_CAS)
    generate_inc_file_for_target(app certs/usertrust-ecc.pem
      ${gen_dir}/usertrust_ecc.pem.inc)
    generate_inc_file_for_target(app certs/isrg-root-x1.pem
      ${gen_dir}/isrg_root_x1.pem.inc)
  endif()

  if(CONFIG_SPIKE_AUTH_CERT)
    set(id ${CONFIG_SPIKE_DEVICE_ID})
    foreach(ext crt key)
      set(f ${CMAKE_CURRENT_SOURCE_DIR}/credentials/${id}.${ext})
      if(NOT EXISTS ${f})
        message(FATAL_ERROR "Missing ${f}: issue a certificate for ${id} "
          "first (see credentials/README.md)")
      endif()
      generate_inc_file_for_target(app ${f} ${gen_dir}/device.${ext}.inc)
    endforeach()
  endif()
endif()
```

## Kconfig
```
# SPDX-License-Identifier: Apache-2.0
#
# c8y-direct-spikes firmware. Each spike is switched on separately, so its cost
# can be measured on its own (see the change's design.md, D1).

mainmenu "c8y-direct spike firmware"

menu "Spikes"

config SPIKE_TLS_MQTT
	bool "Spike A: MQTTS to Cumulocity (MQTT Service / Core MQTT)"
	help
	  Enable with overlay-spike-a.conf, which also brings in the MQTT,
	  TLS, SNTP and DNS options this spike needs.

if SPIKE_TLS_MQTT

config SPIKE_C8Y_HOST
	string "Cumulocity tenant host"
	help
	  e.g. "example.cumulocity.com". Set it in a git-ignored overlay
	  (c8y-spike.local.conf).

choice SPIKE_ENDPOINT
	prompt "Cumulocity MQTT endpoint"
	default SPIKE_ENDPOINT_MQTT_SERVICE

config SPIKE_ENDPOINT_MQTT_SERVICE
	bool "MQTT Service (9883): SmartREST + free-form telemetry"

config SPIKE_ENDPOINT_CORE
	bool "Core MQTT (8883): SmartREST only"

endchoice

config SPIKE_C8Y_PORT
	int
	default 9883 if SPIKE_ENDPOINT_MQTT_SERVICE
	default 8883

choice SPIKE_AUTH
	prompt "Authentication"
	default SPIKE_AUTH_CERT

config SPIKE_AUTH_CERT
	bool "Mutual TLS (credentials/<device id>.crt and .key)"

config SPIKE_AUTH_BASIC
	bool "Basic auth (Core MQTT only)"

config SPIKE_AUTH_BOOTSTRAP
	bool "Basic auth from the bootstrap user (Spike C, task 5.7; Core MQTT)"
	help
	  Connects as the bootstrap user, polls s/ucr until the device is
	  accepted in the device registration UI, stores the credentials from
	  s/dcr ("70,<tenant>,<user>,<password>") and reconnects as that
	  device user.

config SPIKE_AUTH_ENROLLED
	bool "Mutual TLS with a certificate enrolled on the device (Spike C)"
	help
	  The device generates its key, one-time password and CSR, and
	  enrolls with the Cumulocity CA (overlay-spike-c.conf).

endchoice

config SPIKE_ENROLL_DEVICE_ID
	string "External ID for enrollment (empty: tedge-<MAC>)"
	depends on SPIKE_AUTH_ENROLLED
	default ""

config SPIKE_DEVICE_ID
	string "External ID / MQTT client ID"
	default "tedge-spike-c6"
	help
	  With certificate authentication this must match the certificate's
	  CN, and credentials/<id>.crt and credentials/<id>.key must exist.

config SPIKE_BOOTSTRAP_USER
	string "Bootstrap user (<tenant>/<user>)"
	depends on SPIKE_AUTH_BOOTSTRAP

config SPIKE_BOOTSTRAP_PASSWORD
	string "Bootstrap password"
	depends on SPIKE_AUTH_BOOTSTRAP

config SPIKE_BASIC_USER
	string "Basic auth user (<tenant>/device_<id>)"
	depends on SPIKE_AUTH_BASIC

config SPIKE_BASIC_PASSWORD
	string "Basic auth password"
	depends on SPIKE_AUTH_BASIC

config SPIKE_SNTP_SERVER
	string "SNTP server"
	default "pool.ntp.org"

config SPIKE_TELEMETRY_INTERVAL_S
	int "Telemetry interval (s)"
	default 10

config SPIKE_CONNECT_CYCLES
	int "Measurement: connect/disconnect cycles before normal operation"
	default 0
	help
	  Task 3.5: connect and disconnect this many times, logging the
	  handshake time and mbedTLS heap use of each, before the normal
	  connection starts.

config SPIKE_MQTT_STACK_SIZE
	int "MQTT thread stack size"
	default 10240

endif # SPIKE_TLS_MQTT

config SPIKE_OTA
	bool "Spike B: stream an image into slot1 and test-boot it"
	depends on SPIKE_TLS_MQTT
	help
	  Enable with overlay-spike-b.conf (shell, HTTP client, DFU).

if SPIKE_OTA

config SPIKE_OTA_AUTO_CONFIRM
	bool "Confirm a test-booted image once it reaches Cumulocity"
	default y
	help
	  With this off, the image stays unconfirmed until `spike ota
	  confirm`, and any reset makes MCUboot revert it (tasks 4.2/4.3).

config SPIKE_OTA_MAX_REDIRECTS
	int "HTTP redirects to follow"
	default 3

config SPIKE_OTA_EXTRA_CAS
	bool "Trust GitHub's roots too (task 4.6)"
	help
	  Adds USERTrust ECC (github.com, via Sectigo E46) and ISRG Root X1
	  (release-assets.githubusercontent.com), so a GitHub release asset
	  can be downloaded. github.com's chain needs P-384 and SHA-384; see
	  overlay-github.conf.

config SPIKE_BUILD_TAG
	string "Label printed at boot, to tell test images apart"
	default "A"

endif # SPIKE_OTA

config SPIKE_REMOTE_ACCESS
	bool "Spike F: remote-access tunnel to a LAN host"
	depends on SPIKE_TLS_MQTT
	help
	  Enable with overlay-spike-f.conf.

if SPIKE_REMOTE_ACCESS

choice SPIKE_RA_POLICY
	prompt "Allowed targets"
	default SPIKE_RA_POLICY_LAN

config SPIKE_RA_POLICY_LAN
	bool "The device, or hosts on its IPv4 subnets"

config SPIKE_RA_POLICY_LIST
	bool "Only host:port entries in the allow-list"

config SPIKE_RA_POLICY_LOCAL
	bool "Only the device itself"

endchoice

config SPIKE_RA_ALLOW_LIST
	string "Allow-list (host:port,host:port; used by the allow-list policy)"
	default ""

choice SPIKE_RA_AUTH
	prompt "WebSocket authentication"
	default SPIKE_RA_AUTH_JWT

config SPIKE_RA_AUTH_JWT
	bool "Authorization: Bearer <JWT from s/dat>"

config SPIKE_RA_AUTH_MTLS
	bool "Client certificate only (task 6.3: does it work?)"

endchoice

config SPIKE_RA_TELNET_NEGOTIATE
	bool "Offer WILL ECHO / WILL SGA to the client on port-23 tunnels"
	help
	  So a browser telnet terminal switches to character mode and the
	  device's shell echoes what is typed.

config SPIKE_RA_BUF_SIZE
	int "Bridge buffer per direction (bytes)"
	default 2048

config SPIKE_RA_IDLE_TIMEOUT_S
	int "Close an idle tunnel after (s, 0 = never)"
	default 900

config SPIKE_RA_MAX_SESSIONS
	int "Concurrent sessions"
	default 1
	range 1 1

config SPIKE_RA_TWIN_SESSIONS
	bool "List the open session's target in the tedge_RemoteAccess twin"
	default y
	help
	  Task 6.9 / D10. The session count, limit and policy are always sent;
	  the target (an internal address) and start time only with this.

endif # SPIKE_REMOTE_ACCESS

endmenu

source "Kconfig.zephyr"
```

## prj.conf
```kconfig
# SPDX-License-Identifier: Apache-2.0
#
# Board-agnostic configuration for the c8y-direct spike firmware. Wi-Fi and
# stack specifics live in boards/<board>.conf; secrets in git-ignored overlays
# at the repo root (overlay-wifi-credentials.conf, c8y.local.conf).

# --- Firmware identity + simulation (feeds the spike's telemetry) ---
CONFIG_APP_FIRMWARE_NAME="zephyr-c8y-spike"
CONFIG_APP_SIM_ENVIRONMENT=y

# --- DNS-SD: the spike serves nothing; this only keeps <hostname>.local ---
# --- resolvable and names the firmware in the provisioner hand-off.      ---
CONFIG_APP_DNSSD_SERVICE_TYPE="_tedge-spike"
CONFIG_APP_DNSSD_PORT=9

# --- tedge-zephyr: only the skeleton exists; spike code lives in src/ ---
CONFIG_TEDGE=y
CONFIG_TEDGE_EXPERIMENTAL_FEATURES=y

# --- Logging ---
CONFIG_LOG=y
CONFIG_LOG_DEFAULT_LEVEL=3

# --- Runtime / memory ---
CONFIG_MAIN_STACK_SIZE=8192
CONFIG_HEAP_MEM_POOL_SIZE=16384
CONFIG_POSIX_API=y

# --- Networking (BSD sockets API; stack specifics per board) ---
CONFIG_NETWORKING=y
CONFIG_NET_SOCKETS=y
CONFIG_NET_LOG=y
```

## overlay-core-mqtt.conf
```kconfig
# Task 3.7: Core MQTT (8883). Keep 16 KB TLS buffers: its CertificateRequest
# carries 166 CA names (12,919 B).
CONFIG_SPIKE_ENDPOINT_CORE=y
```

## overlay-enabler-wroom.conf
```kconfig
# SPDX-License-Identifier: Apache-2.0
#
# ESP32-WROOM-32 as a "thin-edge.io light" remote-access enabler: no protocol
# app, no OTA, no shell. Use last, on top of -a (+ -c) + -f. Trims the
# spike's measuring headroom back to what one MQTT session plus one tunnel
# needs.

# One TLS record buffer of 8 KB each way (8 KB is the smallest that
# completes the 9883 handshake, section 3) and a TLS heap for MQTT plus one
# tunnel: with 8 KB records MQTT holds 18.5 KB connected and the tunnel's
# handshake peaks at 35.4 KB (section 3), 54 KB together.
CONFIG_MBEDTLS_SSL_MAX_CONTENT_LEN=8192
CONFIG_MBEDTLS_HEAP_SIZE=57344

# No shell: a smaller log buffer is enough.
CONFIG_LOG_BUFFER_SIZE=4096

# The MQTT thread peaks at 2.6–3.0 KB (MEAS stack, Spikes A and C, including
# the mTLS handshake). 6 KB keeps 2× headroom; the first-boot CSR/enroll path
# on this thread is unmeasured, so check "MEAS stack" on the first boot.
CONFIG_SPIKE_MQTT_STACK_SIZE=6144

# Net buffers: at the board's 32 RX / 24 TX (128 B each), bursts of SSH through
# the tunnel exhausted the TX pool ("Data buffer allocation failed", "TCP
# failed to allocate buffer in retransmission"): the tunnel stalled and the
# MQTT session dropped. The pools live in SRAM1 .noinit
# (CONFIG_ESP32_REGION_1_NOINIT), not in the dram0 that bounds the TLS heap.
CONFIG_NET_BUF_RX_COUNT=64
CONFIG_NET_BUF_TX_COUNT=64
CONFIG_NET_PKT_RX_COUNT=16
CONFIG_NET_PKT_TX_COUNT=16

# dram0 is what bounds the TLS heap here, and 51 KB of it is the system heap
# the ESP32 Wi-Fi driver reserves (HEAP_MEM_POOL_ADD_SIZE_ESP_WIFI, not
# settable). Without this, A+C+F overflows dram0 by 8.5 KB. Fewer dynamic
# Wi-Fi buffers let the heap shrink to 44 KB; throughput with them is poor
# (P13), so this trade is still open.
CONFIG_HEAP_MEM_POOL_IGNORE_MIN=y
CONFIG_HEAP_MEM_POOL_SIZE=45056
CONFIG_ESP32_WIFI_DYNAMIC_RX_BUFFER_NUM=16
CONFIG_ESP32_WIFI_DYNAMIC_TX_BUFFER_NUM=16
```

## overlay-github.conf
```kconfig
# Task 4.6: download a GitHub release asset (one 302 to another host).
# github.com's chain: ECDSA leaf (P-256) <- Sectigo E36 <- Sectigo E46
# (P-384, cross-signed by USERTrust ECC with ecdsa-with-SHA384).
# The asset host: RSA chain to ISRG Root X1.
CONFIG_SPIKE_OTA_EXTRA_CAS=y
CONFIG_PSA_WANT_ECC_SECP_R1_384=y
CONFIG_PSA_WANT_ALG_SHA_384=y
CONFIG_TLS_MAX_CREDENTIALS_NUMBER=6
# ECDSA P-384 in software takes ~11 s for github.com's chain on the C6;
# Zephyr's default 10 s TLS connect timeout cuts the handshake off.
CONFIG_NET_SOCKETS_TLS_CONNECT_TIMEOUT=30000
```

## overlay-measure-cycles.conf
```kconfig
# Task 3.5: time 10 connect/disconnect cycles before normal operation.
CONFIG_SPIKE_CONNECT_CYCLES=10
```

## overlay-psram-s3.conf
```kconfig
# SPDX-License-Identifier: Apache-2.0
#
# ESP32-S3-DevKitC-1 N16R8 only: use the 8 MB octal PSRAM (task 8.x follow-up).
#
# Internal DRAM runs out from +C on the S3 (section 8). The S3 linker script
# already places `.mbedtls_heap` in PSRAM (`.ext_ram.data`), so moving the
# static mbedTLS heap out of internal RAM only takes the custom section.
CONFIG_ESP_SPIRAM=y
CONFIG_SPIRAM_MODE_OCT=y
CONFIG_SPIRAM_TYPE_ESPPSRAM64=y
CONFIG_MBEDTLS_HEAP_CUSTOM_SECTION=y
```

## overlay-ra-mtls.conf
```kconfig
# Task 6.3: open the remote-access WebSocket with the client certificate only
# (no Authorization header).
CONFIG_SPIKE_RA_AUTH_MTLS=y
```

## boards/esp32c6_devkitc_esp32c6_hpcore.overlay
```dts
/* SPDX-License-Identifier: Apache-2.0
 *
 * ESP32-C6 (QIQIAZI board, ESP32-C6-WROOM-1-N4 module) — console + flash size.
 *
 * 1. Console. The board devicetree chooses `uart0`, which is the separate UART
 *    port. This board is connected through its native USB-Serial-JTAG port, so
 *    enable that peripheral and re-choose the console onto it. Without this
 *    there is no console on the port in use.
 *
 *    A USB-Serial-JTAG console re-enumerates on reset, so the earliest boot
 *    output is lost. For early-boot debugging, drop this block and use the
 *    board's UART port with the stock `uart0` console.
 *
 * 2. Flash size and layout. The board devicetree includes
 *    `esp32c6_wroom_n8.dtsi`, which declares an 8 MB part. The module in hand is an **N4**: `esptool flash-id`
 *    reports 4 MB (manufacturer 0x68, device 0x4016) on the ESP32-C6 rev v0.2
 *    with MAC e8:f6:0a:fc:32:0c. Correct the declaration so nothing reasons
 *    from 2 MB of flash that does not exist.
 *
 *    The shared layout (lib/common/dts/layout-esp32c6-4M.dtsi) declares the
 *    4 MB part and replaces the upstream partitions with the MCUboot +
 *    Wi-Fi provisioner layout, which MCUboot and the provisioner are built
 *    with too. A plain build (no --sysbuild) still boots from 0x0 and only
 *    uses its storage partition.
 *
 * No `&wifi` node is enabled here: the ESP32-C6 board devicetree already sets
 * the Wi-Fi node to "okay".
 */

&usb_serial {
	status = "okay";
};

/ {
	chosen {
		zephyr,console = &usb_serial;
		zephyr,shell-uart = &usb_serial;
	};
};

#include "../../../lib/common/dts/layout-esp32c6-4M.dtsi"

/* Status LED: the WS2812 RGB LED on GPIO8. */
#include "../../../lib/common/dts/rgb-led-esp32c6-gpio8.dtsi"
```

## boards/esp32s3_devkitc_esp32s3_procpu.overlay
```dts
/* SPDX-License-Identifier: Apache-2.0
 *
 * ESP32-S3-DevKitC-1 — flash size and layout.
 *
 * Console: **left as the board devicetree sets it**, i.e. `uart0` on the
 * board's UART port (the one marked UART, not the one marked USB). That port
 * carries a USB-serial bridge with DTR/RTS wired to EN/BOOT, so esptool can
 * reset the board into download mode on its own — no BOOT/RESET button press
 * to flash, and no losing the first lines of boot output to a USB re-enumeration.
 * That makes it the better default for this board, so this overlay deliberately
 * does *not* re-route the console onto USB-Serial-JTAG the way the ESP32-C6
 * overlay does.
 *
 * If you would rather use the native USB port, add:
 *
 *     &usb_serial { status = "okay"; };
 *     &usb_otg    { status = "disabled"; };   // shares GPIO19/20 with the above
 *     / { chosen {
 *             zephyr,console   = &usb_serial;
 *             zephyr,shell-uart = &usb_serial;
 *     }; };
 *
 * and be aware that a board running unrelated factory firmware on that port may
 * refuse every esptool reset strategy until you hold BOOT and tap RESET once.
 *
 * Flash size: the board devicetree includes `esp32s3_wroom_n8.dtsi`, which
 * declares an 8 MB part. The board in hand is an **N16R8** — `esptool flash-id`
 * reports 16 MB (manufacturer 0x1c, device 0x7118) on an ESP32-S3 rev v0.2 with
 * MAC 7c:0c:5f:5a:6e:b8, plus 8 MB of octal PSRAM that this firmware does not
 * use. The shared layout (lib/common/dts/layout-esp32s3-16M.dtsi) declares the
 * real size and replaces the upstream AMP partitions with the MCUboot + Wi-Fi
 * provisioner layout, which MCUboot and the provisioner are built with too. A
 * plain build (no --sysbuild) still boots from 0x0. It needs a 16 MB part.
 *
 * No `&wifi` node is enabled here: unlike the QT Py S3 and the S2 Feather, the
 * ESP32-S3-DevKitC board devicetree already sets it to "okay".
 */

#include "../../../lib/common/dts/layout-esp32s3-16M.dtsi"

/* Status LED: the WS2812 RGB LED. */
#include "../../../lib/common/dts/rgb-led-esp32s3-devkitc.dtsi"

/* The board's 8 MB octal PSRAM. Declaring it does not enable it: that takes
 * CONFIG_ESP_SPIRAM (overlay-psram-s3.conf). */
&psram0 {
	size = <DT_SIZE_M(8)>;
};
```

## src/main.c
```c
/* SPDX-License-Identifier: Apache-2.0
 *
 * c8y-direct spike firmware entry point.
 *
 * Plays the part of a user application that includes tedge-zephyr: it owns
 * connectivity (lib/common) and runs whichever spikes are enabled once the
 * network is up.
 */

#include <zephyr/kernel.h>
#include <zephyr/logging/log.h>

#include <tedge/tedge.h>

#include "net.h"
#include "spike.h"

LOG_MODULE_REGISTER(main, CONFIG_LOG_DEFAULT_LEVEL);

int main(void)
{
	int ret;

	LOG_INF("c8y spike firmware starting: tedge-zephyr %s", tedge_version());
	LOG_INF("spikes: tls_mqtt=%d ota=%d enroll=%d remote_access=%d",
		IS_ENABLED(CONFIG_SPIKE_TLS_MQTT), IS_ENABLED(CONFIG_SPIKE_OTA),
		IS_ENABLED(CONFIG_SPIKE_AUTH_ENROLLED),
		IS_ENABLED(CONFIG_SPIKE_REMOTE_ACCESS));

#if defined(CONFIG_SPIKE_OTA)
	spike_ota_log_boot();
#endif

	ret = app_net_init();
	if (ret) {
		LOG_ERR("Connectivity init failed (%d)", ret);
		return 0;
	}

	LOG_INF("Waiting for network...");
	ret = app_net_wait_connected(K_SECONDS(60));
	if (ret) {
		LOG_ERR("Network did not come up in time (%d)", ret);
		return 0;
	}

	LOG_INF("Network up");

	if (IS_ENABLED(CONFIG_SPIKE_TLS_MQTT)) {
		spike_mqtt_start();
	}
	return 0;
}
```

## src/spike.h
```c
/* SPDX-License-Identifier: Apache-2.0
 *
 * Spike entry points (c8y-direct-spikes). Throwaway measurement code.
 */
#ifndef SPIKE_H_
#define SPIKE_H_

#include <stddef.h>

/**
 * Set the realtime clock from SNTP. Blocks, retrying, until it succeeds:
 * certificates can't be validated without the time (task 3.1).
 */
void spike_time_sync(void);

/** Start Spike A: the MQTTS thread to Cumulocity (tasks 3.2-3.8). */
void spike_mqtt_start(void);

/** TLS credential tag of the server trust anchor (added by spike_mqtt.c). */
#define SPIKE_TAG_SERVER_CA 0x5A10
/** TLS credential tag of the device certificate and key. */
#define SPIKE_TAG_DEVICE 0x5A11

/** The latest JWT from s/dat, or an empty string. */
const char *spike_mqtt_jwt(void);

/**
 * Spike C: make sure the device has a key and a Cumulocity CA certificate
 * (enrolling if needed, which blocks until an operator registers it), and
 * register them as TLS credentials. Writes the external ID to @p id_out.
 */
int spike_enroll_run(char *id_out, size_t id_len);

/**
 * Spike B: download @p url into slot1 (HTTP or HTTPS, following redirects).
 * @p bearer is a JWT sent to the first host only, or NULL.
 */
int spike_ota_download(const char *url, const char *bearer);

/** Request a test boot of slot1 and do a full-system reset. */
int spike_ota_request_test_and_reboot(void);

/** Log the running image's version and whether it is confirmed. */
void spike_ota_log_boot(void);

/** Write the running image's "major.minor.revision" into @p buf. */
int spike_ota_running_version(char *buf, size_t len);

/* Spike F: remote access. */
enum spike_ra_event_type {
	SPIKE_RA_UP,     /* tunnel established: report the operation SUCCESSFUL */
	SPIKE_RA_FAILED, /* before the tunnel was up: report FAILED with text */
	SPIKE_RA_CLOSED, /* an established tunnel ended: publish an event */
};

struct spike_ra_event {
	enum spike_ra_event_type type;
	char text[128];
};

/**
 * Handle a "530,<serial>,<host>,<port>,<key>" message: start the bridge
 * thread, or return a negative errno with @p reason (malformed, busy).
 */
int spike_ra_request(const char *msg, char *reason, size_t rlen);

/**
 * Task 6.9: the tedge_RemoteAccess twin value (session limit, active and free
 * sessions, target policy, and with CONFIG_SPIKE_RA_TWIN_SESSIONS the open
 * session's target and start time) as JSON.
 */
int spike_ra_twin(char *buf, size_t len);

/** Next result from the bridge thread; 0 if @p ev was filled. */
int spike_ra_poll_event(struct spike_ra_event *ev);

#endif /* SPIKE_H_ */
```

## src/spike_enroll.c
```c
/* SPDX-License-Identifier: Apache-2.0
 *
 * Spike C (c8y-direct-spikes, tasks 5.1-5.6): Cumulocity CA enrollment on the
 * device. Throwaway measurement code; the production feature goes into
 * tedge-zephyr.
 *
 * - A persistent P-256 key in PSA ITS (secure storage over settings).
 * - A 32-character one-time password and the pre-filled registration URL.
 * - A PKCS#10 CSR (CN = external ID) signed with the PSA key, which never
 *   leaves PSA for this.
 * - POST /.well-known/est/simpleenroll with Basic <id>:<otp>, polled until
 *   200; the base64 PKCS#7 (certs-only) reply is unwrapped to the DER
 *   certificate and stored.
 * - The TLS credentials for mutual TLS: the certificate, and the key exported
 *   into a RAM buffer (Zephyr's tls_credentials take no PSA key ID).
 * - `spike enroll reenroll`: simplereenroll with mTLS only, then with a
 *   Bearer JWT (task 5.6).
 */

#include <errno.h>
#include <stdio.h>
#include <string.h>

#include <zephyr/kernel.h>
#include <zephyr/logging/log.h>
#include <zephyr/net/http/client.h>
#include <zephyr/net/net_if.h>
#include <zephyr/net/socket.h>
#include <zephyr/net/tls_credentials.h>
#include <zephyr/settings/settings.h>
#include <zephyr/shell/shell.h>

#include <psa/crypto.h>
#include <mbedtls/asn1.h>
#include <mbedtls/base64.h>
#include <mbedtls/memory_buffer_alloc.h>
#include <mbedtls/pk.h>
#include <mbedtls/x509_csr.h>

#include "spike.h"

LOG_MODULE_REGISTER(spike_enroll, LOG_LEVEL_INF);

/* In the application range, PSA_KEY_ID_USER_MIN..PSA_KEY_ID_USER_MAX
 * (1..0x3FFFFFFF); IDs above it are for the vendor. */
#define KEY_ID ((psa_key_id_t)0x0007E571)

static char device_id[48];
static char otp[33];
static uint8_t cert_der[1024];
static size_t cert_der_len;
/* The private key as DER, for tls_credentials. It stays in RAM for as long
 * as the credential is registered (U9).
 */
static uint8_t key_der_buf[160];
static const uint8_t *key_der;
static size_t key_der_len;

static char csr_body[1024];
static char resp[4096];
static size_t resp_len;
static uint16_t resp_status;
static uint8_t http_rx[1024];

/* ------------------------------------------------------------------------ */
/* Settings                                                                  */
/* ------------------------------------------------------------------------ */

struct blob {
	void *buf;
	size_t cap;
	size_t len;
};

static int load_cb(const char *key, size_t len, settings_read_cb read_cb,
		   void *cb_arg, void *param)
{
	struct blob *b = param;

	ARG_UNUSED(key);
	if (len <= b->cap) {
		b->len = read_cb(cb_arg, b->buf, len);
	}
	return 0;
}

static size_t settings_get(const char *key, void *buf, size_t cap)
{
	struct blob b = {.buf = buf, .cap = cap};

	settings_load_subtree_direct(key, load_cb, &b);
	return b.len;
}

/* ------------------------------------------------------------------------ */
/* Identity, key, one-time password                                          */
/* ------------------------------------------------------------------------ */

static void make_device_id(void)
{
	struct net_if *iface = net_if_get_default();
	struct net_linkaddr *ll = iface ? net_if_get_link_addr(iface) : NULL;
	size_t off;

	if (CONFIG_SPIKE_ENROLL_DEVICE_ID[0]) {
		snprintk(device_id, sizeof(device_id), "%s",
			 CONFIG_SPIKE_ENROLL_DEVICE_ID);
		return;
	}
	off = snprintk(device_id, sizeof(device_id), "tedge-");
	for (size_t i = 0; ll && i < ll->len && off + 2 < sizeof(device_id); i++) {
		off += snprintk(device_id + off, sizeof(device_id) - off, "%02x",
				ll->addr[i]);
	}
}

static int ensure_key(void)
{
	psa_key_attributes_t attr = PSA_KEY_ATTRIBUTES_INIT;
	psa_key_id_t id;
	int64_t t0 = k_uptime_get();
	psa_status_t st;

	st = psa_get_key_attributes(KEY_ID, &attr);
	psa_reset_key_attributes(&attr);
	if (st == PSA_SUCCESS) {
		LOG_INF("key: persistent P-256 key 0x%08x found in PSA ITS",
			(unsigned int)KEY_ID);
		return 0;
	}

	psa_set_key_id(&attr, KEY_ID);
	psa_set_key_lifetime(&attr, PSA_KEY_LIFETIME_PERSISTENT);
	psa_set_key_type(&attr, PSA_KEY_TYPE_ECC_KEY_PAIR(PSA_ECC_FAMILY_SECP_R1));
	psa_set_key_bits(&attr, 256);
	psa_set_key_usage_flags(&attr, PSA_KEY_USAGE_SIGN_HASH |
					       PSA_KEY_USAGE_SIGN_MESSAGE |
					       PSA_KEY_USAGE_EXPORT);
	psa_set_key_algorithm(&attr, PSA_ALG_ECDSA(PSA_ALG_SHA_256));
	st = psa_generate_key(&attr, &id);
	psa_reset_key_attributes(&attr);
	if (st != PSA_SUCCESS) {
		LOG_ERR("psa_generate_key failed: %d", st);
		return -EIO;
	}
	LOG_INF("MEAS key: generated persistent P-256 key 0x%08x in %lld ms",
		(unsigned int)id, k_uptime_get() - t0);
	return 0;
}

static void ensure_otp(void)
{
	static const char alphabet[] =
		"ABCDEFGHIJKLMNOPQRSTUVWXYZabcdefghijklmnopqrstuvwxyz0123456789";
	uint8_t rnd[32];

	if (settings_get("spike/enroll/otp", otp, sizeof(otp) - 1) == 32) {
		otp[32] = '\0';
		return;
	}
	psa_generate_random(rnd, sizeof(rnd));
	for (size_t i = 0; i < 32; i++) {
		/* 62 symbols; the tiny modulo bias is fine for a one-time use. */
		otp[i] = alphabet[rnd[i] % (sizeof(alphabet) - 1)];
	}
	otp[32] = '\0';
	settings_save_one("spike/enroll/otp", otp, 32);
}

static void print_registration_url(void)
{
	LOG_INF("REGISTER https://%s/apps/devicemanagement/index.html#/"
		"deviceregistration?externalId=%s&one-time-password=%s",
		CONFIG_SPIKE_C8Y_HOST, device_id, otp);
}

/* ------------------------------------------------------------------------ */
/* CSR                                                                       */
/* ------------------------------------------------------------------------ */

static int make_csr(void)
{
	mbedtls_x509write_csr csr;
	mbedtls_pk_context pk;
	static unsigned char pem[1200];
	char subject[64];
	int64_t t0 = k_uptime_get();
	int ret;

	mbedtls_x509write_csr_init(&csr);
	mbedtls_pk_init(&pk);

	ret = mbedtls_pk_wrap_psa(&pk, KEY_ID);
	if (ret) {
		LOG_ERR("mbedtls_pk_wrap_psa: -0x%04x", -ret);
		goto out;
	}
	snprintk(subject, sizeof(subject), "CN=%s", device_id);
	mbedtls_x509write_csr_set_md_alg(&csr, MBEDTLS_MD_SHA256);
	mbedtls_x509write_csr_set_key(&csr, &pk);
	ret = mbedtls_x509write_csr_set_subject_name(&csr, subject);
	if (ret) {
		LOG_ERR("CSR subject: -0x%04x", -ret);
		goto out;
	}
	ret = mbedtls_x509write_csr_pem(&csr, pem, sizeof(pem));
	if (ret) {
		LOG_ERR("CSR write: -0x%04x", -ret);
		goto out;
	}

	/* EST wants the base64 body without the armour lines (as tedge sends). */
	{
		const char *b = strstr((char *)pem, "-----\n");
		const char *e = strstr((char *)pem, "-----END");

		if (!b || !e) {
			ret = -EINVAL;
			goto out;
		}
		b += 6;
		snprintk(csr_body, sizeof(csr_body), "%.*s", (int)(e - b), b);
	}
	LOG_INF("MEAS csr: %zu-byte body (CN=%s) signed in %lld ms",
		strlen(csr_body), device_id, k_uptime_get() - t0);
	/* One line per 64 characters, to copy into `openssl req -verify`. */
	LOG_INF("CSR PEM follows:");
	for (const char *p = (const char *)pem; *p;) {
		const char *nl = strchr(p, '\n');
		int n = nl ? (int)(nl - p) : (int)strlen(p);

		LOG_INF("CSR| %.*s", n, p);
		k_msleep(5); /* pace the burst so the log buffer keeps up */
		p += n + (nl ? 1 : 0);
	}
out:
	mbedtls_pk_free(&pk);
	mbedtls_x509write_csr_free(&csr);
	return ret;
}

/* ------------------------------------------------------------------------ */
/* HTTPS POST                                                                */
/* ------------------------------------------------------------------------ */

static int on_body(struct http_parser *parser, const char *at, size_t length)
{
	ARG_UNUSED(parser);
	size_t n = MIN(length, sizeof(resp) - 1 - resp_len);

	memcpy(resp + resp_len, at, n);
	resp_len += n;
	resp[resp_len] = '\0';
	return 0;
}

static const struct http_parser_settings parser_cb = {.on_body = on_body};

static int on_response(struct http_response *rsp, enum http_final_call final,
		       void *user_data)
{
	resp_status = rsp->http_status_code;
	return 0;
}

/**
 * POST @p body to https://<tenant>@p path. @p auth is a full header line
 * ("Authorization: ...\r\n") or NULL. With @p mtls, the device certificate is
 * offered in the handshake.
 */
static int https_post(const char *path, const char *auth, bool mtls,
		      const char *body)
{
	struct zsock_addrinfo hints = {.ai_family = AF_INET,
				       .ai_socktype = SOCK_STREAM};
	struct zsock_addrinfo *res;
	const char *headers[] = {auth, NULL};
	sec_tag_t tags[2] = {SPIKE_TAG_SERVER_CA, SPIKE_TAG_DEVICE};
	struct http_request req = {0};
	int fd, ret;

	ret = zsock_getaddrinfo(CONFIG_SPIKE_C8Y_HOST, "443", &hints, &res);
	if (ret) {
		return -EHOSTUNREACH;
	}
	fd = zsock_socket(AF_INET, SOCK_STREAM, IPPROTO_TLS_1_2);
	if (fd < 0) {
		zsock_freeaddrinfo(res);
		return -errno;
	}
	zsock_setsockopt(fd, ZSOCK_SOL_TLS, ZSOCK_TLS_SEC_TAG_LIST, tags,
			 (mtls ? 2 : 1) * sizeof(sec_tag_t));
	zsock_setsockopt(fd, ZSOCK_SOL_TLS, ZSOCK_TLS_HOSTNAME,
			 CONFIG_SPIKE_C8Y_HOST, sizeof(CONFIG_SPIKE_C8Y_HOST));
	ret = zsock_connect(fd, res->ai_addr, res->ai_addrlen);
	zsock_freeaddrinfo(res);
	if (ret) {
		ret = -errno;
		zsock_close(fd);
		return ret;
	}

	resp_len = 0;
	resp[0] = '\0';
	resp_status = 0;
	req.method = HTTP_POST;
	req.url = path;
	req.host = CONFIG_SPIKE_C8Y_HOST;
	req.protocol = "HTTP/1.1";
	req.content_type_value = "application/pkcs10";
	req.payload = body;
	req.payload_len = strlen(body);
	req.header_fields = auth ? headers : NULL;
	req.response = on_response;
	req.http_cb = &parser_cb;
	req.recv_buf = http_rx;
	req.recv_buf_len = sizeof(http_rx);
	ret = http_client_req(fd, &req, 30000, NULL);
	zsock_close(fd);
	return ret < 0 ? ret : 0;
}

/* ------------------------------------------------------------------------ */
/* PKCS#7 certs-only -> DER certificate                                      */
/* ------------------------------------------------------------------------ */

static int unwrap_pkcs7(const char *b64, uint8_t *out, size_t cap, size_t *out_len)
{
	static uint8_t der[1536];
	static char clean[2048];
	size_t n = 0, der_len;
	unsigned char *p, *end, *cert;
	size_t len;
	int ret;

	for (const char *s = b64; *s && n < sizeof(clean) - 1; s++) {
		if (*s != '\r' && *s != '\n' && *s != ' ') {
			clean[n++] = *s;
		}
	}
	clean[n] = '\0';
	ret = mbedtls_base64_decode(der, sizeof(der), &der_len,
				    (const unsigned char *)clean, n);
	if (ret) {
		return -EINVAL;
	}

	p = der;
	end = der + der_len;
#define STEP(tag) do { ret = mbedtls_asn1_get_tag(&p, end, &len, (tag)); \
		if (ret) { return -EBADMSG; } } while (0)
	/* ContentInfo ::= SEQUENCE { contentType OID, [0] EXPLICIT content } */
	STEP(MBEDTLS_ASN1_CONSTRUCTED | MBEDTLS_ASN1_SEQUENCE);
	STEP(MBEDTLS_ASN1_OID);
	p += len;
	STEP(MBEDTLS_ASN1_CONTEXT_SPECIFIC | MBEDTLS_ASN1_CONSTRUCTED | 0);
	/* SignedData ::= SEQUENCE { version, digestAlgorithms SET,
	 *   encapContentInfo SEQUENCE, certificates [0] IMPLICIT ... }
	 */
	STEP(MBEDTLS_ASN1_CONSTRUCTED | MBEDTLS_ASN1_SEQUENCE);
	STEP(MBEDTLS_ASN1_INTEGER);
	p += len;
	STEP(MBEDTLS_ASN1_CONSTRUCTED | MBEDTLS_ASN1_SET);
	p += len;
	STEP(MBEDTLS_ASN1_CONSTRUCTED | MBEDTLS_ASN1_SEQUENCE);
	p += len;
	STEP(MBEDTLS_ASN1_CONTEXT_SPECIFIC | MBEDTLS_ASN1_CONSTRUCTED | 0);
	/* The first Certificate ::= SEQUENCE, header included. */
	cert = p;
	STEP(MBEDTLS_ASN1_CONSTRUCTED | MBEDTLS_ASN1_SEQUENCE);
#undef STEP
	len += p - cert;
	if (len > cap) {
		return -ENOMEM;
	}
	memcpy(out, cert, len);
	*out_len = len;
	return 0;
}

/* ------------------------------------------------------------------------ */
/* TLS credentials                                                           */
/* ------------------------------------------------------------------------ */

static int register_credentials(void)
{
	mbedtls_pk_context pk;
	int ret;

	mbedtls_pk_init(&pk);
	ret = mbedtls_pk_copy_from_psa(KEY_ID, &pk);
	if (ret == 0) {
		ret = mbedtls_pk_write_key_der(&pk, key_der_buf, sizeof(key_der_buf));
	}
	mbedtls_pk_free(&pk);
	if (ret <= 0) {
		LOG_ERR("exporting the key failed: -0x%04x", -ret);
		return -EIO;
	}
	/* pk_write_key_der writes at the end of the buffer. */
	key_der_len = ret;
	key_der = key_der_buf + sizeof(key_der_buf) - key_der_len;

	tls_credential_delete(SPIKE_TAG_DEVICE, TLS_CREDENTIAL_PUBLIC_CERTIFICATE);
	tls_credential_delete(SPIKE_TAG_DEVICE, TLS_CREDENTIAL_PRIVATE_KEY);
	ret = tls_credential_add(SPIKE_TAG_DEVICE, TLS_CREDENTIAL_PUBLIC_CERTIFICATE,
				 cert_der, cert_der_len);
	ret = ret ?: tls_credential_add(SPIKE_TAG_DEVICE, TLS_CREDENTIAL_PRIVATE_KEY,
					key_der, key_der_len);
	LOG_INF("MEAS credentials: certificate %zu B, exported key %zu B held in "
		"RAM while registered (%d)", cert_der_len, key_der_len, ret);
	return ret;
}

/* ------------------------------------------------------------------------ */
/* Enrollment                                                                */
/* ------------------------------------------------------------------------ */

int spike_enroll_run(char *id_out, size_t id_len)
{
	char auth_hdr[192];
	char basic[96];
	char basic_b64[140];
	size_t olen;
	int64_t t_start;
	int ret, attempt = 0;

	settings_subsys_init();
	make_device_id();
	snprintk(id_out, id_len, "%s", device_id);
	LOG_INF("enroll: external ID %s", device_id);

	ret = ensure_key();
	if (ret) {
		return ret;
	}

	cert_der_len = settings_get("spike/enroll/cert", cert_der, sizeof(cert_der));
	if (cert_der_len > 0) {
		LOG_INF("enroll: certificate found in settings (%zu B)", cert_der_len);
		return register_credentials();
	}

	ensure_otp();
	print_registration_url();
	ret = make_csr();
	if (ret) {
		return ret;
	}

	snprintk(basic, sizeof(basic), "%s:%s", device_id, otp);
	mbedtls_base64_encode((unsigned char *)basic_b64, sizeof(basic_b64), &olen,
			      (const unsigned char *)basic, strlen(basic));
	basic_b64[olen] = '\0';
	snprintk(auth_hdr, sizeof(auth_hdr), "Authorization: Basic %s\r\n",
		 basic_b64);

	t_start = k_uptime_get();
	for (;;) {
		attempt++;
		ret = https_post("/.well-known/est/simpleenroll", auth_hdr, false,
				 csr_body);
		if (ret == 0 && resp_status == 200) {
			break;
		}
		LOG_INF("enroll: attempt %d: %s HTTP %u %.*s", attempt,
			ret ? "request failed" : "not registered yet:", resp_status,
			(int)MIN(resp_len, 160), resp);
		if (attempt == 1 || attempt % 6 == 0) {
			print_registration_url();
		}
		k_sleep(K_SECONDS(10));
	}
	LOG_INF("MEAS enroll: certificate issued after %d attempts, %lld ms after "
		"the first; reply %zu B", attempt, k_uptime_get() - t_start,
		resp_len);

	ret = unwrap_pkcs7(resp, cert_der, sizeof(cert_der), &cert_der_len);
	if (ret) {
		LOG_ERR("unwrapping the PKCS#7 reply failed: %d", ret);
		return ret;
	}
	settings_save_one("spike/enroll/cert", cert_der, cert_der_len);
	settings_delete("spike/enroll/otp");
	LOG_INF("enroll: certificate stored (%zu B DER)", cert_der_len);
	return register_credentials();
}

/* ------------------------------------------------------------------------ */
/* simplereenroll (task 5.6) and the shell                                   */
/* ------------------------------------------------------------------------ */

/* Diagnostics driven from the shell (spike-b). Without it, as in the WROOM
 * enabler build, they and their 10 KB thread stack are left out.
 */
#if defined(CONFIG_SHELL)

K_THREAD_STACK_DEFINE(reenroll_stack, 10240);
static struct k_thread reenroll_thread;

/* Log an HTTP result safely: deferred logging would read resp after the next
 * request overwrote it, and a base64 body has newlines.
 */
static void log_result(const char *what, int ret)
{
	char snippet[81];
	size_t n = 0;

	for (size_t i = 0; i < resp_len && n < sizeof(snippet) - 1; i++) {
		char ch = resp[i];

		snippet[n++] = (ch == '\r' || ch == '\n') ? ' ' : ch;
	}
	snippet[n] = '\0';
	LOG_INF("REENROLL %s: ret=%d HTTP %u, %zu B", what, ret, resp_status,
		resp_len);
	LOG_INF("REENROLL %s body: %s", what, snippet);
	k_msleep(200);
}

static void reenroll_fn(void *a, void *b, void *c)
{
	static char bearer[1100];
	const char *jwt = spike_mqtt_jwt();
	int ret;

	if (make_csr()) {
		return;
	}
	if (jwt && jwt[0]) {
		snprintk(bearer, sizeof(bearer), "Authorization: Bearer %s\r\n", jwt);
		LOG_INF("REENROLL trying Bearer JWT (%zu-byte header), no client cert",
			strlen(bearer));
		ret = https_post("/.well-known/est/simplereenroll", bearer, false,
				 csr_body);
		log_result("Bearer JWT, no client cert", ret);
		if (ret == 0 && resp_status == 200) {
			size_t len;
			static uint8_t der[1024];

			if (unwrap_pkcs7(resp, der, sizeof(der), &len) == 0) {
				LOG_INF("REENROLL Bearer: new certificate %zu B DER", len);
			}
		}
	} else {
		LOG_WRN("REENROLL: no JWT yet, skipped the Bearer attempt");
	}
	LOG_INF("REENROLL trying mTLS only");
	ret = https_post("/.well-known/est/simplereenroll", NULL, true, csr_body);
	log_result("mTLS only", ret);
}

static int cmd_reenroll(const struct shell *sh, size_t argc, char **argv)
{
	k_thread_create(&reenroll_thread, reenroll_stack,
			K_THREAD_STACK_SIZEOF(reenroll_stack), reenroll_fn, NULL,
			NULL, NULL, K_PRIO_PREEMPT(9), 0, K_NO_WAIT);
	shell_print(sh, "re-enrollment test started");
	return 0;
}

static void csr_fn(void *a, void *b, void *c)
{
	make_csr();
}

static int cmd_csr(const struct shell *sh, size_t argc, char **argv)
{
	k_thread_create(&reenroll_thread, reenroll_stack,
			K_THREAD_STACK_SIZEOF(reenroll_stack), csr_fn, NULL, NULL,
			NULL, K_PRIO_PREEMPT(9), 0, K_NO_WAIT);
	return 0;
}

/* Time P-256 key generation and one signature, with a throwaway key. */
static void bench_fn(void *a, void *b, void *c)
{
	psa_key_attributes_t attr = PSA_KEY_ATTRIBUTES_INIT;
	uint8_t hash[32] = {1}, sig[64];
	size_t sig_len;
	psa_key_id_t id;
	int64_t t0 = k_uptime_get(), t1;

	psa_set_key_type(&attr, PSA_KEY_TYPE_ECC_KEY_PAIR(PSA_ECC_FAMILY_SECP_R1));
	psa_set_key_bits(&attr, 256);
	psa_set_key_usage_flags(&attr, PSA_KEY_USAGE_SIGN_HASH);
	psa_set_key_algorithm(&attr, PSA_ALG_ECDSA(PSA_ALG_SHA_256));
	if (psa_generate_key(&attr, &id) != PSA_SUCCESS) {
		LOG_ERR("bench: key generation failed");
		return;
	}
	t1 = k_uptime_get();
	psa_sign_hash(id, PSA_ALG_ECDSA(PSA_ALG_SHA_256), hash, sizeof(hash), sig,
		      sizeof(sig), &sig_len);
	LOG_INF("MEAS bench: P-256 key generation %lld ms, ECDSA sign %lld ms",
		t1 - t0, k_uptime_get() - t1);
	psa_destroy_key(id);
}

static int cmd_bench(const struct shell *sh, size_t argc, char **argv)
{
	k_thread_create(&reenroll_thread, reenroll_stack,
			K_THREAD_STACK_SIZEOF(reenroll_stack), bench_fn, NULL, NULL,
			NULL, K_PRIO_PREEMPT(9), 0, K_NO_WAIT);
	return 0;
}

static int cmd_status(const struct shell *sh, size_t argc, char **argv)
{
	shell_print(sh, "external ID %s, certificate %zu B, key %s", device_id,
		    cert_der_len, key_der ? "exported to TLS" : "in PSA only");
	return 0;
}

static int cmd_reset(const struct shell *sh, size_t argc, char **argv)
{
	settings_delete("spike/enroll/cert");
	settings_delete("spike/enroll/otp");
	psa_destroy_key(KEY_ID);
	shell_print(sh, "certificate, one-time password and key deleted; reboot");
	return 0;
}

SHELL_STATIC_SUBCMD_SET_CREATE(sub_enroll,
	SHELL_CMD(status, NULL, "enrollment state", cmd_status),
	SHELL_CMD(csr, NULL, "log a CSR made with the stored key", cmd_csr),
	SHELL_CMD(bench, NULL, "time P-256 key generation and signing", cmd_bench),
	SHELL_CMD(reenroll, NULL, "task 5.6: simplereenroll tests", cmd_reenroll),
	SHELL_CMD(reset, NULL, "forget certificate, OTP and key", cmd_reset),
	SHELL_SUBCMD_SET_END);

SHELL_CMD_REGISTER(enroll, &sub_enroll, "Spike C: Cumulocity CA enrollment", NULL);

#endif /* CONFIG_SHELL */
```

## src/spike_time.c
```c
/* SPDX-License-Identifier: Apache-2.0
 *
 * Spike A, task 3.1: set the realtime clock from SNTP before any TLS connect.
 * mbedTLS checks certificate validity against time(), which reads this clock.
 */

#include <time.h>

#include <zephyr/kernel.h>
#include <zephyr/logging/log.h>
#include <zephyr/net/sntp.h>
#include <zephyr/sys/clock.h>

#include "spike.h"

LOG_MODULE_REGISTER(spike_time, LOG_LEVEL_INF);

void spike_time_sync(void)
{
	struct sntp_time ts;
	int attempt = 0;
	int ret;

	for (;;) {
		int64_t t0 = k_uptime_get();

		attempt++;
		ret = sntp_simple(CONFIG_SPIKE_SNTP_SERVER, 5000, &ts);
		if (ret == 0) {
			struct timespec tspec = {
				.tv_sec = (time_t)ts.seconds,
				.tv_nsec = (long)(((uint64_t)ts.fraction * 1000000000ULL) >> 32),
			};
			struct tm tm;

			sys_clock_settime(SYS_CLOCK_REALTIME, &tspec);
			gmtime_r(&tspec.tv_sec, &tm);
			LOG_INF("time set from %s (attempt %d, %lld ms): "
				"%04d-%02d-%02dT%02d:%02d:%02dZ",
				CONFIG_SPIKE_SNTP_SERVER, attempt,
				k_uptime_get() - t0, tm.tm_year + 1900,
				tm.tm_mon + 1, tm.tm_mday, tm.tm_hour, tm.tm_min,
				tm.tm_sec);
			return;
		}
		LOG_WRN("SNTP attempt %d failed (%d); not connecting until the "
			"clock is set", attempt, ret);
		k_sleep(K_SECONDS(MIN(2 * attempt, 30)));
	}
}
```
