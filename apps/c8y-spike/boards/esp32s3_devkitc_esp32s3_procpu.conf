## lib/common/Kconfig
```kconfig
# SPDX-License-Identifier: Apache-2.0
#
# Shared, protocol-agnostic firmware options: device identity, connectivity
# (Wi-Fi), status display, the data-model sampling interval, and the writable
# control points. Protocol frontends (OPC-UA, and later SNMP/Modbus/CAN) build
# on top of these; protocol-specific options live in each lib/<protocol>/Kconfig.

menu "Common firmware options"

config APP_DEVICE_NAME
	string "Device / application name"
	default "tedge-opcua-device"
	help
	  Human-readable device name advertised by protocol frontends and used
	  to derive the default mDNS hostname.

config APP_FIRMWARE_NAME
	string "Firmware name"
	default "zephyr-opcua-server"
	help
	  Identifies the firmware image/application (as opposed to the device).
	  Exposed by frontends (e.g. the OPC-UA node ns=1;s=FirmwareName) and
	  paired with FirmwareVersion so a collector can tell which firmware a
	  device runs. Each apps/<protocol> sets its own default.

config APP_MDNS_HOSTNAME
	string "mDNS hostname (advertised as <hostname>.local)"
	default "tedge-opcua"
	help
	  Hostname advertised over mDNS. The device becomes reachable as
	  "<hostname>.local" on the local network.

config APP_DNSSD_SERVICE_TYPE
	string "DNS-SD service type advertised by the active frontend"
	default "_opcua-tcp"
	help
	  DNS-SD/mDNS service type the firmware advertises (e.g. "_opcua-tcp" or
	  "_modbus"). Each app sets this to match its protocol frontend; the default
	  reproduces the OPC-UA firmware's advertisement.

config APP_DNSSD_PORT
	int "DNS-SD advertised port"
	default 4840
	range 1 65535
	help
	  Port advertised in the DNS-SD record. Set to the frontend's listen port
	  (OPC-UA 4840, Modbus 502, SNMP 161).

config APP_DNSSD_UDP
	bool "Advertise the DNS-SD service over UDP (instead of TCP)"
	default n
	help
	  Register the DNS-SD service as _<type>._udp rather than _<type>._tcp.
	  Set for UDP-based frontends (e.g. SNMP: _snmp._udp) so the transport in
	  the advertised service type matches reality. TCP-based frontends
	  (OPC-UA, Modbus) leave this off.

config APP_SAMPLE_INTERVAL_MS
	int "Data source sampling interval (ms)"
	default 1000
	range 50 3600000
	help
	  Interval at which the data source is sampled and frontend values are
	  refreshed.

config APP_SETPOINT_MIN
	int "Writable Setpoint minimum"
	default -1000

config APP_SETPOINT_MAX
	int "Writable Setpoint maximum"
	default 1000

config APP_SETPOINT_DEFAULT
	int "Writable Setpoint initial value"
	default 0

config APP_RUNNING_DEFAULT
	bool "Writable 'Running' flag initial value"
	default n

config APP_MODE_DEFAULT
	int "Initial mode (0=off, 1=auto, 2=manual)"
	default 0
	range 0 2
	help
	  Initial value of the writable 'mode' control point. Used by simulations
	  that model an operating mode (e.g. the pump). Ignored by simulations that
	  don't use it.

choice
	prompt "Device simulation model"
	default APP_SIM_ENVIRONMENT
	help
	  Selects which simulation drives the shared data model for this firmware.
	  Frontends are simulation-agnostic; switching this is a config-only change.

config APP_SIM_ENVIRONMENT
	bool "Environment (temperature / humidity / pressure)"
	help
	  Smoothly-varying environmental sensor values with a generic Setpoint and
	  Running control. The original demo model; default for the OPC-UA firmware.

config APP_SIM_PUMP
	bool "Pump / motor (control-driven)"
	help
	  A pump/motor whose measurements (flow, pressure, motor temperature, rpm,
	  vibration, run-hours) are produced by a stateful model driven by the
	  speed_setpoint / running / mode controls. Default for the Modbus firmware.

config APP_SIM_SWITCH
	bool "Managed switch / router (network interfaces)"
	help
	  A small managed switch/router modelled as a fixed set of Ethernet
	  interfaces, each with an operational/administrative status, nominal speed
	  and monotonic traffic counters. One interface flaps its link periodically
	  so a frontend can report link up/down events. Default for the SNMP firmware.

endchoice

config APP_SIM_SWITCH_IF_COUNT
	int "Simulated switch: number of network interfaces"
	default 5
	range 1 8
	depends on APP_SIM_SWITCH
	help
	  How many interfaces the switch/router simulation exposes (bounded by
	  SIM_SWITCH_MAX_IF = 8). Each becomes an ifTable row in the SNMP frontend.

config APP_SIM_SWITCH_FLAP_PERIOD_STEPS
	int "Simulated switch: link flap period (sample steps; 0 = never flap)"
	default 15
	range 0 86400
	depends on APP_SIM_SWITCH
	help
	  How often one interface toggles its operational status, counted in
	  sampling steps of APP_SAMPLE_INTERVAL_MS — so the default 15 flaps a link
	  every 15 s at the default 1 s interval.

	  Every toggle is a linkUp/linkDown notification in the SNMP frontend and an
	  alarm raise or clear in a collector, so at the default a device left
	  running produces on the order of 5,700 events a day. That is what makes a
	  short demo interesting and a long-running deployment noisy: raise it (900
	  = 15 minutes at the default interval) for something left running, or set 0
	  to keep every link stable and exercise only the counters.

config APP_DISPLAY_STATUS
	bool "Show connectivity status on a TFT display"
	default n
	help
	  On boards with a TFT (e.g. Adafruit Feather ESP32-S2 TFT), show a
	  colour-coded connectivity stage and the device's IPv4 address. Useful
	  to relay status when no serial console is available.

menu "Wi-Fi (station mode) — hardware targets"

config APP_WIFI
	bool "Connect to Wi-Fi in station mode"
	default y if WIFI
	default n
	help
	  Join a Wi-Fi network on boot. On native_sim this is not used; the
	  host network backend provides connectivity instead.

config APP_NET_RECONNECT_REBOOT
	bool "Self-reboot after a prolonged network outage (last resort)"
	default y
	depends on APP_WIFI
	select REBOOT
	help
	  If the device stays offline for APP_NET_REBOOT_TIMEOUT_S despite reconnect
	  attempts, reboot so it recovers autonomously instead of needing a manual
	  power-cycle. Disable on benches where a reboot would hide a problem.

config APP_NET_REBOOT_TIMEOUT_S
	int "Offline seconds before the last-resort reboot"
	default 300
	range 30 86400
	depends on APP_NET_RECONNECT_REBOOT

config APP_NET_WORKQ_STACK_SIZE
	int "Connectivity work queue stack size"
	default 3072
	depends on APP_WIFI
	help
	  Stack for the dedicated work queue that runs the connectivity status
	  tick (status render, gateway ping, reachability watchdog) and Wi-Fi
	  reconnects. The ESP32 WROOM needs about 1.1 KB at its peak, more than
	  the 1 KB system workqueue those items used to run on. Raise it when
	  logging is in immediate mode (overlay-diag.conf does).

config APP_NET_WORKQ_PRIORITY
	int "Connectivity work queue thread priority"
	default 4
	depends on APP_WIFI
	help
	  Preemptible and above the protocol server threads (5..7), so a busy
	  server cannot starve connectivity recovery.

config APP_STATUS_LED
	bool "Show connectivity on a status LED (led0 or led-strip alias)"
	default y
	help
	  Blink an LED while not connected and hold it steady once connected, so
	  an operator can tell at a glance whether the device is on the network;
	  Wi-Fi provisioning adds further patterns. Drives the board's 'led0'
	  alias (a plain GPIO LED) or, failing that, its 'led-strip' alias (an
	  addressable RGB LED such as a WS2812, which also shows each state in
	  its own colour). No-op on boards with neither and on native_sim.

# An addressable status LED needs the LED strip subsystem; turn it on only
# where the board devicetree provides one.
configdefault LED_STRIP
	default y if APP_STATUS_LED && $(dt_alias_enabled,led-strip)

config APP_PING_TARGET
	string "On-device ping target for the data-path diagnostic"
	default "192.168.68.1"
	depends on APP_WIFI
	help
	  IPv4 address the firmware periodically pings to test whether its
	  Wi-Fi data path passes traffic. Result shown on the display as GWPING.

config APP_STATIC_IP
	bool "Use a static IPv4 address instead of DHCP"
	default n
	help
	  Assign a fixed IPv4 address on Wi-Fi association instead of using
	  DHCP. Also set CONFIG_ESP32_WIFI_STA_AUTO_DHCPV4=n on ESP32 boards so
	  DHCP does not override it (see overlay-static-ip.conf.example).

config APP_STATIC_IP_ADDR
	string "Static IPv4 address"
	default "192.168.68.200"
	depends on APP_STATIC_IP

config APP_STATIC_NETMASK
	string "Static IPv4 netmask"
	default "255.255.252.0"
	depends on APP_STATIC_IP

config APP_STATIC_GW
	string "Static IPv4 gateway"
	default "192.168.68.1"
	depends on APP_STATIC_IP

config APP_WIFI_MAC
	string "Override Wi-Fi station MAC (AA:BB:CC:DD:EE:FF; empty = factory MAC)"
	default ""
	depends on APP_WIFI
	help
	  If non-empty, set the Wi-Fi station MAC to this address before
	  connecting (ESP32 only). Use a locally-administered unicast address.

config APP_WIFI_SSID
	string "Wi-Fi SSID"
	default ""
	depends on APP_WIFI
	help
	  Wi-Fi network name. Provide via a git-ignored local overlay
	  (see overlay-wifi-credentials.conf.example) rather than committing it.

config APP_WIFI_PSK
	string "Wi-Fi password (PSK)"
	default ""
	depends on APP_WIFI
	help
	  Wi-Fi pre-shared key. Provide via a git-ignored local overlay; do not
	  commit real credentials to the repository.

config APP_WIFI_CRED_STORE
	bool "Keep Wi-Fi credentials in flash (wifi_credentials)"
	default y if $(dt_nodelabel_exists,bootreq_partition)
	depends on APP_WIFI
	select FLASH
	select FLASH_MAP
	select NVS
	select SETTINGS
	select WIFI_CREDENTIALS
	help
	  Read the Wi-Fi credentials from Zephyr's wifi_credentials store (settings
	  on NVS in storage_partition), where the Wi-Fi provisioner saves them.
	  Stored credentials take precedence over APP_WIFI_SSID/APP_WIFI_PSK, so a
	  device built with a baked-in network can still be moved in the field.
	  On by default on boards whose layout has a provisioner (a
	  bootreq_partition).

# net.c owns connecting and reconnecting: no second connect path, one entry.
configdefault WIFI_CREDENTIALS_CONNECT_STORED
	default n if APP_WIFI_CRED_STORE
configdefault WIFI_CREDENTIALS_SHELL
	default n if APP_WIFI_CRED_STORE
configdefault WIFI_CREDENTIALS_MAX_ENTRIES
	default 1 if APP_WIFI_CRED_STORE

config APP_BOOT_REQUEST
	bool
	default y if $(dt_nodelabel_exists,bootreq_partition)
	select FLASH
	select FLASH_MAP
	help
	  The boot request record in bootreq_partition (boot_request.h).

config APP_PROV_HANDOFF
	bool "Hand over to the Wi-Fi provisioner image"
	default y if BOOTLOADER_MCUBOOT && $(dt_nodelabel_exists,prov_partition)
	depends on APP_WIFI_CRED_STORE && APP_BOOT_REQUEST && !APP_WIFI_PROVISIONER
	select REBOOT
	select GPIO
	help
	  Application side of BLE Wi-Fi provisioning. The application carries no
	  Bluetooth: with no credentials, or after the sw0 provisioning pattern,
	  it sets the boot request and reboots, and MCUboot launches the Wi-Fi
	  provisioner (apps/wifi-provisioner) from prov_partition. A 10 s hold of
	  sw0 erases the stored credentials first. Needs an MCUboot build with the
	  provisioner layout (west build --sysbuild; see the README).

if APP_PROV_HANDOFF

config APP_WIFI_PROV_PRESS_COUNT
	int "Short sw0 presses in the provisioning pattern"
	default 3
	range 2 6

config APP_WIFI_PROV_PRESS_WINDOW_MS
	int "Time to complete the provisioning pattern (ms)"
	default 2000
	range 500 10000

config APP_WIFI_PROV_ERASE_HOLD_S
	int "Hold sw0 this long (s) to erase stored credentials"
	default 10
	range 3 60

endif # APP_PROV_HANDOFF

config APP_WIFI_PROVISIONER
	bool "This image is the Wi-Fi provisioner"
	depends on APP_WIFI_CRED_STORE && APP_BOOT_REQUEST
	help
	  Set by apps/wifi-provisioner: this image is the provisioner. net.c
	  does not connect on its own and suspends connectivity recovery; the
	  provisioner joins only to test candidate credentials.

endmenu # Wi-Fi

menu "Liveness and diagnostics"

config APP_DIAG
	bool "Liveness and resource health diagnostics"
	default n
	select THREAD_MONITOR
	select THREAD_NAME
	help
	  Run a small diagnostics thread (not on the system workqueue) that logs
	  a HEALTH line every APP_DIAG_PERIOD_S: time since each watched context
	  last made progress, the busy state of the firmware's work items, free
	  heap, free net packets/buffers and the Wi-Fi state. When a context
	  stops making progress it also logs every thread's state and the wait
	  queue it is blocked on. Meant for investigations; overlay-diag.conf
	  turns it on together with immediate logging. With this off, nothing is
	  compiled in.

config APP_DIAG_PERIOD_S
	int "Health line period (s)"
	default 10
	range 1 3600
	depends on APP_DIAG

config APP_DIAG_STACK_SIZE
	int "Diagnostics thread stack size"
	default 3072
	depends on APP_DIAG

config APP_LIVENESS
	bool "Liveness watchdog: reset the device when it stops making progress"
	default y if APP_WIFI
	default n
	select TASK_WDT
	select WATCHDOG
	select HWINFO
	select REBOOT
	help
	  Watch the system workqueue and every protocol-serving thread with a
	  task watchdog channel each, fed only when that context makes progress,
	  and back it with the SoC hardware watchdog (the `watchdog0` alias). A
	  context that makes no progress for APP_LIVENESS_TIMEOUT_S resets the
	  device; a lockup that stops the task watchdog itself is caught by the
	  hardware watchdog. The next boot logs the reset cause and which context
	  stalled.

	  This is the recovery for a stalled firmware. APP_NET_RECONNECT_REBOOT is
	  the recovery for a network outage and cannot help here, because it runs
	  on the connectivity work queue. On a bench, where a reset would hide a
	  problem under a debugger, set CONFIG_APP_LIVENESS=n.

	  On by default for Wi-Fi targets since the 2026-09 acceptance soaks:
	  24 h and 10 h runs on four boards with no false reset, and an
	  access-point restart that every board rode out without one.

config APP_LIVENESS_TIMEOUT_S
	int "Seconds without progress before a reset"
	default 30
	range 5 3600
	depends on APP_LIVENESS
	help
	  Must sit well above the longest legitimate block of a watched context
	  (a blocking Wi-Fi management request, a DNS lookup).

config APP_LIVENESS_NETWQ_TIMEOUT_S
	int "Seconds without progress on the connectivity queue before a reset"
	default 120
	range 5 3600
	depends on APP_LIVENESS
	help
	  The connectivity queue's own timeout. It must clear the longest
	  legitimate block of a Wi-Fi driver call: on ESP32, a management or
	  status request can hold the queue for well over 30 s while an access
	  point disappears or comes back, and resetting for that is a false
	  positive. The status tick runs every 3 s, so this still detects a real
	  wedge long before the last-resort reboot at
	  APP_NET_REBOOT_TIMEOUT_S (300 s).

config APP_LIVENESS_SELFTEST
	bool "Liveness self-test: inject a failure (test builds only)"
	depends on APP_LIVENESS
	help
	  Inject one failure APP_LIVENESS_SELFTEST_DELAY_S after boot, to verify
	  that the device resets and the next boot names the right cause. Never
	  enable this in a deployed build.

if APP_LIVENESS_SELFTEST

choice APP_LIVENESS_SELFTEST_MODE
	prompt "Failure to inject"
	default APP_LIVENESS_SELFTEST_BLOCK_WQ

config APP_LIVENESS_SELFTEST_BLOCK_WQ
	bool "Block the system workqueue"

config APP_LIVENESS_SELFTEST_STOP_PROTO
	bool "Stop the protocol server loop"

config APP_LIVENESS_SELFTEST_IRQ_LOCK
	bool "Busy-loop at top priority with interrupts masked"

endchoice

config APP_LIVENESS_SELFTEST_DELAY_S
	int "Seconds after boot to inject the failure"
	default 60
	range 1 86400

endif # APP_LIVENESS_SELFTEST

# The task watchdog's timer feeds the hardware watchdog every
# TASK_WDT_MIN_TIMEOUT, and the hardware timeout is that plus
# TASK_WDT_HW_FALLBACK_DELAY (on ESP32 each of the two watchdog stages uses it,
# so the reset comes after twice that). Zephyr's 100 + 20 ms is too tight next
# to Wi-Fi flash writes; 1 s + 4 s resets a hard lockup after ~10 s.
configdefault TASK_WDT_MIN_TIMEOUT
	default 1000 if APP_LIVENESS

configdefault TASK_WDT_HW_FALLBACK_DELAY
	default 4000 if APP_LIVENESS

# The deferred-log thread peaks at ~900 B of its 1 KB default on ESP32 Wi-Fi
# builds; an overflow silently corrupts memory. Set here as a default rather
# than in board confs because the option does not exist with immediate
# logging (overlay-diag.conf), where an explicit assignment would warn.
configdefault LOG_PROCESS_THREAD_STACK_SIZE
	default 2048 if SOC_FAMILY_ESPRESSIF_ESP32 && APP_WIFI

# The connection manager's monitor thread uses ~320 of its 512-byte default on
# these builds (measured over the 2026-09-17 soaks): the least headroom of any
# thread. Set here rather than per board, for the same reason as the log thread.
configdefault NET_CONNECTION_MANAGER_MONITOR_STACK_SIZE
	default 1024 if SOC_FAMILY_ESPRESSIF_ESP32 && APP_WIFI

endmenu # Liveness and diagnostics

endmenu # Common firmware options
```
