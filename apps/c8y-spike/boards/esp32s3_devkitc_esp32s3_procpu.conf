## lib/modbus/Kconfig
```kconfig
# SPDX-License-Identifier: Apache-2.0
#
# Modbus TCP protocol frontend options. Present only when an application composes
# the lib/modbus module (e.g. apps/modbus-server).

menu "Modbus TCP frontend"

config APP_MODBUS_SERVER
	bool "Enable the Modbus TCP server"
	default y
	select MODBUS
	select MODBUS_RAW_ADU
	help
	  Serve the shared device data model over Modbus TCP using Zephyr's
	  in-tree modbus subsystem in raw-ADU server mode plus a TCP listener.
	  Also set CONFIG_MODBUS_ROLE_SERVER=y in the app (it is a Kconfig choice,
	  so it cannot be selected here).

config APP_MODBUS_PORT
	int "Modbus TCP listen port"
	default 502
	range 1 65535
	depends on APP_MODBUS_SERVER

config APP_MODBUS_UNIT_ID
	int "Modbus unit id"
	default 1
	range 1 247
	depends on APP_MODBUS_SERVER

config APP_MODBUS_CLIENT_IDLE_TIMEOUT_S
	int "Drop a client that sends nothing for this long (s; 0 = never)"
	default 60
	range 0 86400
	depends on APP_MODBUS_SERVER
	help
	  The server handles one client at a time, so a connection that has gone
	  half-open (the client vanished during a network outage without a FIN)
	  would otherwise lock every other client out until reboot. A polling
	  collector sends a request every few seconds and is not affected.

endmenu # Modbus TCP frontend
```

## lib/opcua/Kconfig
```kconfig
# SPDX-License-Identifier: Apache-2.0
#
# OPC-UA protocol frontend options. Present only when an application composes
# the lib/opcua module (e.g. apps/opcua-server).

menu "OPC-UA frontend"

config APP_OPCUA_SERVER
	bool "Enable the OPC-UA server (compiles the vendored open62541 stack)"
	default y
	help
	  When enabled, the OPC-UA server, address space and data-source
	  adapter are compiled and started. Disable to build the bare
	  connectivity skeleton (useful for bring-up).

config APP_OPCUA_PORT
	int "OPC-UA server TCP port (opc.tcp)"
	default 4840
	range 1 65535
	depends on APP_OPCUA_SERVER
	help
	  TCP port the OPC-UA server listens on.

config APP_OPCUA_MAX_SUBSCRIPTIONS
	int "Max concurrent OPC-UA subscriptions"
	default 2
	range 0 16
	depends on APP_OPCUA_SERVER
	help
	  Cap on concurrent subscriptions, to bound RAM on constrained boards.

config APP_OPCUA_MAX_MONITORED_ITEMS
	int "Max monitored items per subscription"
	default 8
	range 0 64
	depends on APP_OPCUA_SERVER
	help
	  Cap on monitored items per subscription.

endmenu # OPC-UA frontend
```

## lib/snmp/Kconfig
```kconfig
# SPDX-License-Identifier: Apache-2.0
#
# SNMP agent protocol frontend options. Present only when an application composes
# the lib/snmp module (e.g. apps/snmp-agent). The agent is a minimal SNMPv2c
# implementation (no external SNMP stack); it needs only UDP sockets, which the
# app's board config enables.

menu "SNMP agent frontend"

config APP_SNMP_AGENT
	bool "Enable the SNMPv2c agent"
	default y
	help
	  Serve the shared switch/router data model over SNMPv2c: answer
	  GET/GETNEXT/GETBULK on the agent UDP port and (optionally) originate
	  traps. BER/ASN.1 is implemented in-repo; no external SNMP library.

if APP_SNMP_AGENT

config APP_SNMP_PORT
	int "SNMP agent UDP port"
	default 161
	range 1 65535
	help
	  UDP port the agent binds for GET/GETNEXT/GETBULK requests.

config APP_SNMP_READ_COMMUNITY
	string "SNMPv2c read community string"
	default "public"
	help
	  Community string required on incoming requests. Requests with a different
	  community are silently ignored (per SNMP convention).

config APP_SNMP_SYS_CONTACT
	string "sysContact.0 value"
	default "admin@example.com"

config APP_SNMP_SYS_LOCATION
	string "sysLocation.0 value"
	default "Lab"

config APP_SNMP_MAX_VARBINDS
	int "Maximum varbinds in one request"
	default 32
	range 8 64
	depends on APP_SNMP_AGENT
	help
	  How many varbinds a single GET/GETNEXT/GETBULK may carry. A collector
	  typically polls every point of a device in one request, so this must
	  cover the whole MIB view of one device: the switch/router simulation
	  with 5 interfaces needs about 29. A larger request is answered tooBig.

	  Costs about 136 bytes of RAM per varbind, twice over (the parsed
	  request and the GETBULK cursors).

config APP_SNMP_TRAP
	bool "Originate SNMPv2c traps (coldStart / linkUp / linkDown)"
	default y
	help
	  Send SNMPv2c trap notifications to a configured manager: a coldStart on
	  boot and linkUp/linkDown as simulated interfaces change operational state.

if APP_SNMP_TRAP

config APP_SNMP_TRAP_MANAGER
	string "Trap manager IPv4 address or hostname"
	default "192.168.68.10"
	help
	  Destination for trap notifications: either a literal IPv4 address (used
	  directly, no lookup) or a hostname resolved at runtime via getaddrinfo.
	  An mDNS ".local" name (e.g. "mymac.local") works when the board enables
	  CONFIG_MDNS_RESOLVER; a regular DNS name needs CONFIG_DNS_RESOLVER.
	  Override per site (e.g. via a local overlay), like the Wi-Fi credentials.

config APP_SNMP_TRAP_PORT
	int "Trap manager UDP port"
	default 162
	range 1 65535

config APP_SNMP_TRAP_COMMUNITY
	string "Community string sent in trap PDUs"
	default "public"

endif # APP_SNMP_TRAP

endif # APP_SNMP_AGENT

endmenu # SNMP agent frontend
```
