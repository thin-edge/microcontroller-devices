## CMakeLists.txt
```
# SPDX-License-Identifier: Apache-2.0
#
# SNMP agent firmware: composes the shared core (lib/common, switch/router
# simulation) with the SNMPv2c agent frontend (lib/snmp). Build with:
#   west build -b <board> apps/snmp-agent
cmake_minimum_required(VERSION 3.20.0)

list(APPEND ZEPHYR_EXTRA_MODULES
  ${CMAKE_CURRENT_SOURCE_DIR}/../../lib/common
  ${CMAKE_CURRENT_SOURCE_DIR}/../../lib/snmp
)
# thin-edge.io device management (tiny-edge, off unless CONFIG_TEDGE=y) is a
# west project, so west adds it as a module; see west.yml.

find_package(Zephyr REQUIRED HINTS $ENV{ZEPHYR_BASE})
project(snmp_agent_firmware C)

target_sources(app PRIVATE src/main.c)
# The glue to the device-management client lives in the application, never in
# the module.
target_sources_ifdef(CONFIG_TEDGE app PRIVATE src/tedge_glue.c)
```

## Kconfig
```
# SPDX-License-Identifier: Apache-2.0
#
# SNMP agent application. Shared options come from the lib/common module and SNMP
# options from the lib/snmp module (both auto-sourced as Zephyr modules via
# Kconfig.zephyr below).

mainmenu "SNMP Agent Firmware"

config APP_TEDGE_MEASUREMENT_TYPE
	string "Measurement type published to the cloud"
	depends on TEDGE_TELEMETRY
	default "agent"

config APP_TEDGE_MEASUREMENT_INTERVAL_S
	int "Seconds between measurements"
	depends on TEDGE_TELEMETRY
	default 30

source "Kconfig.zephyr"
```

## prj.conf
```kconfig
# SPDX-License-Identifier: Apache-2.0
#
# Board-agnostic application configuration. Wi-Fi/stack specifics live in
# boards/<board>.conf; secrets in a git-ignored overlay at the repo root.

# --- Firmware identity + simulation selection ---
CONFIG_APP_DEVICE_NAME="tedge-snmp-device"
CONFIG_APP_FIRMWARE_NAME="zephyr-snmp-agent"
CONFIG_APP_SIM_SWITCH=y
CONFIG_APP_SIM_SWITCH_IF_COUNT=5
# One link flap every 15 minutes (900 steps x the 1 s sample interval). The
# Kconfig default of 15 steps makes a short demo lively but a device left
# running noisy: ~4 notifications a minute, each raising or clearing an alarm in
# a collector. Override per build for a livelier demo, or 0 to never flap.
CONFIG_APP_SIM_SWITCH_FLAP_PERIOD_STEPS=900

# --- SNMP agent + traps (manager address overridden per site) ---
CONFIG_APP_SNMP_AGENT=y
CONFIG_APP_SNMP_PORT=161
CONFIG_APP_SNMP_READ_COMMUNITY="public"
CONFIG_APP_SNMP_TRAP=y
CONFIG_APP_SNMP_TRAP_PORT=162
CONFIG_APP_SNMP_TRAP_COMMUNITY="public"

# --- DNS-SD discovery: advertise as _snmp._udp on 161 (mDNS on hardware boards) ---
CONFIG_APP_DNSSD_SERVICE_TYPE="_snmp"
CONFIG_APP_DNSSD_PORT=161
CONFIG_APP_DNSSD_UDP=y

# --- Logging ---
CONFIG_LOG=y
CONFIG_LOG_DEFAULT_LEVEL=3

# --- Runtime / memory ---
# main() starts the network, the protocol server and the client, then
# returns; nothing runs on its stack afterwards (the agent measured 1.2 KB
# at 4 KB). Confirm with the thread analyzer (wroom-stackinfo.local.conf)
# when the release workloads change.
CONFIG_MAIN_STACK_SIZE=4096
# The system heap (CONFIG_HEAP_MEM_POOL_SIZE) is not set: on every ESP32
# board the Wi-Fi driver's minimum (51,200 B) wins over any smaller value,
# so the image gets about 55 KB whatever is written here. See the board
# settings files for the size each board resolves to.
# No CONFIG_POSIX_API: the code uses Zephyr's native zsock_* socket API, so
# the POSIX layer's thread, signal, timer and fd pools stay out of the image.

# --- Networking (BSD sockets API; SNMP is UDP; stack specifics per board) ---
CONFIG_NETWORKING=y
CONFIG_NET_SOCKETS=y
CONFIG_NET_UDP=y
CONFIG_NET_LOG=y
```

## boards/adafruit_feather_esp32s2_tft_esp32s2.conf
```kconfig
# SPDX-License-Identifier: Apache-2.0
#
# Adafruit Feather ESP32-S2 TFT for the SNMP agent: single-core Xtensa LX7 Wi-Fi
# with 2 MB PSRAM and a built-in TFT. Build target:
# adafruit_feather_esp32s2_tft/esp32s2.
#
# NOTE: the S2 Feather cannot currently pass Wi-Fi traffic under this Zephyr
# (see the project's ESP32-S2 Wi-Fi note); this config is provided for parity
# and offline/bench use — verify end-to-end SNMP on the ESP32-WROOM instead.

# --- Wi-Fi driver ---
CONFIG_WIFI=y
CONFIG_WIFI_ESP32=y
CONFIG_APP_WIFI=y

CONFIG_NET_MGMT=y
CONFIG_NET_MGMT_EVENT=y
CONFIG_NET_MGMT_EVENT_INFO=y
CONFIG_NET_CONNECTION_MANAGER=y

# The system heap is not set: the Wi-Fi driver's minimum (51,200 B) wins
# over any smaller CONFIG_HEAP_MEM_POOL_SIZE, so this board's images get
# about 55 KB of system heap whatever is written here (the exact sum of the
# drivers' minimums varies a little with the options built).

# --- IP stack (UDP only) ---
CONFIG_NET_L2_ETHERNET=y
CONFIG_NET_IPV4=y
CONFIG_NET_IPV6=n
CONFIG_NET_UDP=y
CONFIG_NET_TCP=n
CONFIG_NET_DHCPV4=y

# --- mDNS + DNS-SD: resolve <hostname>.local and advertise _snmp._udp (port in prj.conf) ---
CONFIG_NET_HOSTNAME_ENABLE=y
CONFIG_NET_HOSTNAME="tedge-snmp"
CONFIG_NET_HOSTNAME_UNIQUE=y
CONFIG_MDNS_RESPONDER=y
CONFIG_DNS_SD=y
# Resolve the trap-manager hostname (incl. mDNS ".local") at runtime.
CONFIG_DNS_RESOLVER=y
CONFIG_MDNS_RESOLVER=y

# --- Built-in TFT status display (ST7789 over MIPI-DBI SPI) ---
CONFIG_APP_DISPLAY_STATUS=y
CONFIG_DISPLAY=y
CONFIG_MIPI_DBI=y
CONFIG_ST7789V=y
CONFIG_ST7789V_RGB565=y
CONFIG_SPI=y
CONFIG_GPIO=y
CONFIG_POWER_DOMAIN=y

# --- Socket / net buffer budget ---
CONFIG_NET_MAX_CONTEXTS=8
CONFIG_NET_MAX_CONN=6
CONFIG_ZVFS_OPEN_MAX=12
CONFIG_NET_PKT_RX_COUNT=6
CONFIG_NET_PKT_TX_COUNT=6
CONFIG_NET_BUF_RX_COUNT=16
CONFIG_NET_BUF_TX_COUNT=16
```

## boards/adafruit_qt_py_esp32s3_esp32s3_procpu.conf
```kconfig
# SPDX-License-Identifier: Apache-2.0
#
# Adafruit QT Py ESP32-S3 for the SNMP agent (the control board of the ESP32
# network-freeze investigation). Mirrors the WROOM config; the &wifi node is
# enabled via the sibling .overlay. UDP-only, so net pools are modest and TCP is
# left off.

# --- Wi-Fi driver ---
CONFIG_WIFI=y
CONFIG_WIFI_ESP32=y
CONFIG_APP_WIFI=y

CONFIG_NET_MGMT=y
CONFIG_NET_MGMT_EVENT=y
CONFIG_NET_MGMT_EVENT_INFO=y
CONFIG_NET_CONNECTION_MANAGER=y

# The system heap is not set: the Wi-Fi driver's minimum (51,200 B) wins
# over any smaller CONFIG_HEAP_MEM_POOL_SIZE, so this board's images get
# about 55 KB of system heap whatever is written here (the exact sum of the
# drivers' minimums varies a little with the options built).

# --- IP stack (UDP only; SNMP + DHCP + mDNS are all UDP) ---
CONFIG_NET_L2_ETHERNET=y
CONFIG_NET_IPV4=y
CONFIG_NET_IPV6=n
CONFIG_NET_UDP=y
CONFIG_NET_TCP=n
CONFIG_NET_DHCPV4=y

# --- mDNS + DNS-SD: resolve <hostname>.local and advertise _snmp._udp (port in prj.conf) ---
CONFIG_NET_HOSTNAME_ENABLE=y
CONFIG_NET_HOSTNAME="tedge-snmp"
CONFIG_NET_HOSTNAME_UNIQUE=y
CONFIG_MDNS_RESPONDER=y
CONFIG_DNS_SD=y
# Resolve the trap-manager hostname (incl. mDNS ".local") at runtime.
CONFIG_DNS_RESOLVER=y
CONFIG_MDNS_RESOLVER=y

# --- Socket / net buffer budget (a couple of UDP sockets: agent + trap) ---
CONFIG_NET_MAX_CONTEXTS=8
CONFIG_NET_MAX_CONN=6
CONFIG_ZVFS_OPEN_MAX=12
CONFIG_NET_PKT_RX_COUNT=8
CONFIG_NET_PKT_TX_COUNT=8
# The RX pool bottomed out at 4 free of 24 over a 10 h soak (0 free in an
# earlier one), the tightest resource on these builds. 32 keeps a margin; the
# OPC-UA firmware, which carries more traffic, uses 40.
CONFIG_NET_BUF_RX_COUNT=32
CONFIG_NET_BUF_TX_COUNT=24

# --- Thread stacks (measured with the thread analyzer on an ESP32-CAM) ---
# The system workqueue peaks at ~770 B of its 1 KB default and the log thread
# at ~900 B of 1 KB; an overflow of either silently corrupts memory and stalls
# the firmware. Give both headroom. (The connectivity work that overflowed the
# system workqueue now runs on its own queue: CONFIG_APP_NET_WORKQ_STACK_SIZE.)
CONFIG_SYSTEM_WORKQUEUE_STACK_SIZE=2048
CONFIG_LOG_PROCESS_THREAD_STACK_SIZE=2048

# --- Socket service poll set ---
# The socket service thread (mDNS responder, DNS-SD) polls 4 sockets here. With
# the default of 3 it logs "Please increase CONFIG_ZVFS_POLL_MAX" and never
# starts, so the device stops answering mDNS.
CONFIG_ZVFS_POLL_MAX=6
# Once it runs, the service thread (mDNS responder) peaks at ~1.4 KB: 16 bytes
# short of its 1408-byte default. Give it headroom.
CONFIG_NET_SOCKETS_SERVICE_STACK_SIZE=2400
```

## boards/esp32_devkitc_esp32_procpu.conf
```kconfig
# SPDX-License-Identifier: Apache-2.0
#
# ESP32-WROOM-32 for the SNMP agent. Wi-Fi station + native IP stack + mDNS. The
# SNMP agent is UDP-only and small, so net pools are modest and TCP is left off.

# Allow older ESP32 silicon (WROOM-32 rev v1.0) to boot.
CONFIG_ESP32_USE_UNSUPPORTED_REVISION=y

# --- Wi-Fi driver ---
CONFIG_WIFI=y
CONFIG_WIFI_ESP32=y
CONFIG_APP_WIFI=y

CONFIG_NET_MGMT=y
CONFIG_NET_MGMT_EVENT=y
CONFIG_NET_MGMT_EVENT_INFO=y
CONFIG_NET_CONNECTION_MANAGER=y

# The system heap is not set: the Wi-Fi driver's minimum (51,200 B) wins
# over any smaller CONFIG_HEAP_MEM_POOL_SIZE, so this board's images get
# about 55 KB of system heap whatever is written here (the exact sum of the
# drivers' minimums varies a little with the options built).

# --- IP stack (UDP only; SNMP + DHCP + mDNS are all UDP) ---
CONFIG_NET_L2_ETHERNET=y
CONFIG_NET_IPV4=y
CONFIG_NET_IPV6=n
CONFIG_NET_UDP=y
CONFIG_NET_TCP=n
CONFIG_NET_DHCPV4=y

# --- mDNS + DNS-SD: resolve <hostname>.local and advertise _snmp._udp (port in prj.conf) ---
CONFIG_NET_HOSTNAME_ENABLE=y
CONFIG_NET_HOSTNAME="tedge-snmp"
CONFIG_NET_HOSTNAME_UNIQUE=y
CONFIG_MDNS_RESPONDER=y
CONFIG_DNS_SD=y
# Resolve the trap-manager hostname (incl. mDNS ".local") at runtime.
CONFIG_DNS_RESOLVER=y
CONFIG_MDNS_RESOLVER=y

# --- Socket / net buffer budget (a couple of UDP sockets: agent + trap) ---
CONFIG_NET_MAX_CONTEXTS=8
CONFIG_NET_MAX_CONN=6
CONFIG_ZVFS_OPEN_MAX=12
CONFIG_NET_PKT_RX_COUNT=8
CONFIG_NET_PKT_TX_COUNT=8
# The RX pool bottomed out at 4 free of 24 over a 10 h soak (0 free in an
# earlier one), the tightest resource on these builds. 32 keeps a margin; the
# OPC-UA firmware, which carries more traffic, uses 40.
CONFIG_NET_BUF_RX_COUNT=32
CONFIG_NET_BUF_TX_COUNT=24

# --- Thread stacks (measured with the thread analyzer on an ESP32-CAM) ---
# The system workqueue peaks at ~770 B of its 1 KB default; an overflow
# silently corrupts memory and stalls the firmware. (The connectivity work that
# overflowed it now runs on its own queue: CONFIG_APP_NET_WORKQ_STACK_SIZE. The
# log thread's stack is raised in lib/common/Kconfig, because the option only
# exists with deferred logging.)
CONFIG_SYSTEM_WORKQUEUE_STACK_SIZE=2048

# --- Socket service poll set ---
# The socket service thread (mDNS responder, DNS-SD) polls 4 sockets here. With
# the default of 3 it logs "Please increase CONFIG_ZVFS_POLL_MAX" and never
# starts, so the device stops answering mDNS.
CONFIG_ZVFS_POLL_MAX=6
# Once it runs, the service thread (mDNS responder) peaks at ~1.4 KB: 16 bytes
# short of its 1408-byte default. Give it headroom.
CONFIG_NET_SOCKETS_SERVICE_STACK_SIZE=2400

# --- .noinit in DRAM region 1 (SRAM1), also under MCUboot ---
# Simple boot puts .noinit (thread stacks, net buffers; ~68 KB here) in the
# SRAM1 region a second-stage bootloader would use. Zephyr turns that off for
# MCUboot builds, which moves it into region 0 and takes it out of the libc
# heap (70 KB → 3 KB for OPC-UA). .noinit is never loaded, so MCUboot is done
# with that RAM by the time the application uses it.
CONFIG_ESP32_REGION_1_NOINIT=y
```

## boards/esp32_devkitc_esp32_procpu_tedge.conf
```kconfig
# SPDX-License-Identifier: Apache-2.0
#
# The SNMP ESP32-CAM build with thin-edge.io device management. Use on top
# of the board's own configuration:
#   west build --sysbuild -b esp32_devkitc/esp32/procpu apps/snmp-agent \
#     -- -DEXTRA_CONF_FILE="<board>.conf;<this file>;<tenant>.conf"
#
# The tenant host belongs in a git-ignored overlay (CONFIG_TEDGE_C8Y_URL).
#
# The SNMP agent alone is UDP-only; the client needs TCP for MQTT/TLS, the
# HTTP transfers and the remote-access WebSocket, so this file turns it back
# on and sizes the pools for it.

CONFIG_TEDGE=y
CONFIG_TEDGE_TRANSPORT_C8Y=y
CONFIG_TEDGE_C8Y_MQTT_SERVICE=y
CONFIG_TEDGE_AUTH_C8Y_CA=y
CONFIG_TEDGE_RESTART=y

# --- TCP, which the SNMP-only build switches off ---
CONFIG_NET_TCP=y
CONFIG_NET_SOCKETS=y

# --- What the application provides for the client (tedge-zephyr/README.md) ---
CONFIG_MBEDTLS=y
CONFIG_MBEDTLS_ENABLE_HEAP=y
CONFIG_MBEDTLS_HEAP_SIZE=98304
CONFIG_MBEDTLS_SSL_MAX_CONTENT_LEN=16384
CONFIG_MBEDTLS_SSL_PROTO_TLS1_2=y
CONFIG_MBEDTLS_CIPHERSUITE_TLS_ECDHE_RSA_WITH_AES_128_GCM_SHA256=y
CONFIG_MBEDTLS_CIPHERSUITE_TLS_ECDHE_ECDSA_WITH_AES_128_GCM_SHA256=y
CONFIG_PSA_WANT_ECC_SECP_R1_256=y
CONFIG_MBEDTLS_SSL_SERVER_NAME_INDICATION=y
CONFIG_MBEDTLS_HAVE_TIME_DATE=y
CONFIG_MBEDTLS_PEM_PARSE_C=y
CONFIG_MBEDTLS_X509_CRT_PARSE_C=y

# The device key lives in PSA ITS, stored through the settings backend.
CONFIG_SECURE_STORAGE_ITS_STORE_IMPLEMENTATION_SETTINGS=y

# --- The TLS heap goes in the module's quad PSRAM ---
# A classic ESP32 has only a 192 KB DRAM segment, so the 96 KB mbedTLS heap
# cannot live in it beside the client and the agent. The ESP32-CAM module
# carries 4 MB of quad PSRAM; without this the image does not fit at all.
#
# SPIRAM_TYPE_* alone leaves CONFIG_ESP_SPIRAM_SIZE at 0, the ext_dram
# region is empty and the link fails with "External SPIRAM overflowed", so
# the size has to be stated.
CONFIG_ESP_SPIRAM=y
CONFIG_SPIRAM_MODE_QUAD=y
CONFIG_SPIRAM_TYPE_ESPPSRAM32=y
CONFIG_ESP_SPIRAM_SIZE=4194304
CONFIG_MBEDTLS_HEAP_CUSTOM_SECTION=y

# --- What this part can carry ---
# A classic ESP32 splits its RAM into dram0 (192 KB) and dram1 (96 KB), and
# the net_buf pools and .dram0.noinit all land in dram1. With every feature
# enabled it overflows by 33 KB, so this board gets a deliberately small
# set: know the device is there, see how it is doing, restart it, and
# **update its firmware** — the one that matters, because without it the
# board can only ever be changed with a cable.
#
# Firmware update needs a second concurrent TLS session for the HTTPS
# download, so it is what the TLS context budget is spent on. Everything
# else that would want one is off:
CONFIG_TEDGE_FIRMWARE_UPDATE=y
CONFIG_TEDGE_FIRMWARE_STACK_SIZE=8192
CONFIG_TEDGE_TELEMETRY=y
CONFIG_TEDGE_HEALTH=y

# Off, and why: each needs RAM this part does not have, and the first three
# need a TLS session of their own beside MQTT and the download.
CONFIG_TEDGE_REMOTE_ACCESS=n
CONFIG_TEDGE_LOG_UPLOAD=n
CONFIG_TEDGE_CERT_RENEWAL=n
CONFIG_TEDGE_SHELL_COMMAND=n
CONFIG_TEDGE_COREDUMP=n
CONFIG_TEDGE_PARAMETERS=n

# MQTT plus one HTTPS download.
CONFIG_NET_SOCKETS_TLS_MAX_CONTEXTS=2

# --- Network buffers, as deep as this part allows ---
# A classic ESP32 splits its RAM into dram0 (192 KB) and dram1 (96 KB), and
# the net_buf pools and the kernel heap all land in dram1. The sizing the C6
# and the S3 boards use (96/64 buffers, 40 KB heap) fills it to 99.4% —
# 608 bytes spare — so this board takes the step below.
#
# With remote access off there is no tunnel to buffer for, so these stay
# near stock — 256-byte net_bufs rather than 128 is the one change worth
# keeping, because it quarters the number of allocations per frame. See
# tedge-zephyr/docs/debugging-against-real-devices.md.
# 16 KB is what the SNMP-only build used. The bigger heap the other
# boards need is for websocket masking buffers, and there is no tunnel
# here. Going back to it leaves this image a few KB of dram1 to spare
# rather than the 48 bytes it had at 20 KB.
CONFIG_HEAP_MEM_POOL_SIZE=16384
CONFIG_NET_BUF_DATA_SIZE=256
CONFIG_NET_PKT_RX_COUNT=10
CONFIG_NET_PKT_TX_COUNT=10
CONFIG_NET_BUF_RX_COUNT=24
CONFIG_NET_BUF_TX_COUNT=20

CONFIG_NET_MAX_CONN=10
CONFIG_NET_MAX_CONTEXTS=12
CONFIG_ZVFS_OPEN_MAX=14
```

## boards/esp32c6_devkitc_esp32c6_hpcore.conf
```kconfig
# SPDX-License-Identifier: Apache-2.0
#
# ESP32-C6 (QIQIAZI board carrying an ESP32-C6-WROOM-1-N4 module; single-core
# **RISC-V** + LP core, 160 MHz, ~512 KB HP SRAM, 4 MB flash, no PSRAM).
# Build target: esp32c6_devkitc/esp32c6/hpcore.
#
# *** This is the first RISC-V target in this repo, and the first Wi-Fi 6
# radio. *** Everything below is architecture-neutral and copied from the
# verified Xtensa ESP32-S3 ports: the net-buffer and stack figures were measured
# from workload behaviour (mDNS socket count, workqueue and log stack peaks
# under the protocol threads), not from SoC specifics, so they carry over. If a
# genuinely RISC-V-specific setting is ever needed, add it here under its own
# heading so the architecture split stays easy to find.
#
# The board is a clone, not an Espressif C6-DevKitC-1, so nothing here depends
# on board pinout — only on the on-die Wi-Fi and USB-Serial-JTAG peripherals.
#
# Two notes carried from the S3-DevKitC port:
#   * No &wifi overlay. The C6 board devicetree already sets the Wi-Fi node to
#     "okay", so CONFIG_WIFI_ESP32 can be selected directly.
#   * The sibling .overlay re-routes the console onto USB-Serial-JTAG and
#     corrects the declared flash size from the dtsi's 8 MB to the real 4 MB.
#
# No status LED: the board has a WS2812 addressable RGB LED, not the plain GPIO
# led0 alias lib/common/status_led.c drives, and the clone's LED pin is not
# documented upstream. The indicator is a no-op here (the "No LED present"
# scenario in the wifi-connectivity spec); read connectivity from the console.
#
# The C6 also carries IEEE 802.15.4 and BT LE radios, enabled in the board
# devicetree. Neither is used: no CONFIG_BT or CONFIG_IEEE802154 is set, so no
# driver is built and neither costs flash. This firmware is a Wi-Fi station.

# --- Wi-Fi driver ---
CONFIG_WIFI=y
CONFIG_WIFI_ESP32=y
CONFIG_APP_WIFI=y

CONFIG_NET_MGMT=y
CONFIG_NET_MGMT_EVENT=y
CONFIG_NET_MGMT_EVENT_INFO=y
CONFIG_NET_CONNECTION_MANAGER=y

# The system heap is not set: the Wi-Fi driver's minimum (51,200 B) wins
# over any smaller CONFIG_HEAP_MEM_POOL_SIZE, so this board's images get
# about 55 KB of system heap whatever is written here (the exact sum of the
# drivers' minimums varies a little with the options built).

# --- IP stack (UDP only; SNMP + DHCP + mDNS are all UDP) ---
CONFIG_NET_L2_ETHERNET=y
CONFIG_NET_IPV4=y
CONFIG_NET_IPV6=n
CONFIG_NET_UDP=y
CONFIG_NET_TCP=n
CONFIG_NET_DHCPV4=y

# --- mDNS + DNS-SD: resolve <hostname>.local and advertise _snmp._udp (port in prj.conf) ---
CONFIG_NET_HOSTNAME_ENABLE=y
CONFIG_NET_HOSTNAME="tedge-snmp"
CONFIG_NET_HOSTNAME_UNIQUE=y
CONFIG_MDNS_RESPONDER=y
CONFIG_DNS_SD=y
# Resolve the trap-manager hostname (incl. mDNS ".local") at runtime.
CONFIG_DNS_RESOLVER=y
CONFIG_MDNS_RESOLVER=y

# --- Socket / net buffer budget (a couple of UDP sockets: agent + trap) ---
CONFIG_NET_MAX_CONTEXTS=8
CONFIG_NET_MAX_CONN=6
CONFIG_ZVFS_OPEN_MAX=12
CONFIG_NET_PKT_RX_COUNT=8
CONFIG_NET_PKT_TX_COUNT=8
# The RX pool bottomed out at 4 free of 24 over a 10 h soak (0 free in an
# earlier one), the tightest resource on these builds. 32 keeps a margin; the
# OPC-UA firmware, which carries more traffic, uses 40.
CONFIG_NET_BUF_RX_COUNT=32
CONFIG_NET_BUF_TX_COUNT=24

# --- Thread stacks (measured with the thread analyzer on an ESP32-CAM) ---
# The system workqueue peaks at ~770 B of its 1 KB default and the log thread
# at ~900 B of 1 KB; an overflow of either silently corrupts memory and stalls
# the firmware. Give both headroom. (The connectivity work that overflowed the
# system workqueue now runs on its own queue: CONFIG_APP_NET_WORKQ_STACK_SIZE.)
CONFIG_SYSTEM_WORKQUEUE_STACK_SIZE=2048
CONFIG_LOG_PROCESS_THREAD_STACK_SIZE=2048

# --- Socket service poll set ---
# The socket service thread (mDNS responder, DNS-SD) polls 4 sockets here. With
# the default of 3 it logs "Please increase CONFIG_ZVFS_POLL_MAX" and never
# starts, so the device stops answering mDNS.
CONFIG_ZVFS_POLL_MAX=6
# Once it runs, the service thread (mDNS responder) peaks at ~1.4 KB: 16 bytes
# short of its 1408-byte default. Give it headroom.
CONFIG_NET_SOCKETS_SERVICE_STACK_SIZE=2400
```

## boards/esp32s3_devkitc_esp32s3_procpu.conf
```kconfig
# SPDX-License-Identifier: Apache-2.0
#
# ESP32-S3-DevKitC-1 (Espressif reference board; dual-core Xtensa LX7, 512 KB
# SRAM). The board in hand is an N16R8: 16 MB flash and 8 MB octal PSRAM,
# though the board devicetree assumes an N8 and no PSRAM is enabled here.
# Build target: esp32s3_devkitc/esp32s3/procpu.
#
# Mirrors the Adafruit QT Py ESP32-S3 config, which is verified on hardware and
# is near-identical silicon. Two deliberate differences from that port:
#   * No &wifi overlay. This board devicetree already sets the Wi-Fi node to
#     "okay", so CONFIG_WIFI_ESP32 can be selected directly.
#   * The console stays on uart0, the board's own choice, which comes out on the
#     board's UART port. That port's bridge wires DTR/RTS to EN/BOOT, so esptool
#     resets it into download mode by itself — flashing needs no button press and
#     boot output is not lost to a USB re-enumeration. The sibling .overlay only
#     corrects the declared flash size (this board is an N16R8, not the N8 the
#     board devicetree assumes).
#
# No status LED: the board carries a WS2812 addressable RGB LED, not the plain
# GPIO led0 alias that lib/common/status_led.c drives, so the indicator is a
# no-op here (see the "No LED present" scenario in the wifi-connectivity spec).
# Connectivity state is read from the console log.

# --- Wi-Fi driver ---
CONFIG_WIFI=y
CONFIG_WIFI_ESP32=y
CONFIG_APP_WIFI=y

CONFIG_NET_MGMT=y
CONFIG_NET_MGMT_EVENT=y
CONFIG_NET_MGMT_EVENT_INFO=y
CONFIG_NET_CONNECTION_MANAGER=y

# The system heap is not set: the Wi-Fi driver's minimum (51,200 B) wins
# over any smaller CONFIG_HEAP_MEM_POOL_SIZE, so this board's images get
# about 55 KB of system heap whatever is written here (the exact sum of the
# drivers' minimums varies a little with the options built).

# --- IP stack (UDP only; SNMP + DHCP + mDNS are all UDP) ---
CONFIG_NET_L2_ETHERNET=y
CONFIG_NET_IPV4=y
CONFIG_NET_IPV6=n
CONFIG_NET_UDP=y
CONFIG_NET_TCP=n
CONFIG_NET_DHCPV4=y

# --- mDNS + DNS-SD: resolve <hostname>.local and advertise _snmp._udp (port in prj.conf) ---
CONFIG_NET_HOSTNAME_ENABLE=y
CONFIG_NET_HOSTNAME="tedge-snmp"
CONFIG_NET_HOSTNAME_UNIQUE=y
CONFIG_MDNS_RESPONDER=y
CONFIG_DNS_SD=y
# Resolve the trap-manager hostname (incl. mDNS ".local") at runtime.
CONFIG_DNS_RESOLVER=y
CONFIG_MDNS_RESOLVER=y

# --- Socket / net buffer budget (a couple of UDP sockets: agent + trap) ---
CONFIG_NET_MAX_CONTEXTS=8
CONFIG_NET_MAX_CONN=6
CONFIG_ZVFS_OPEN_MAX=12
CONFIG_NET_PKT_RX_COUNT=8
CONFIG_NET_PKT_TX_COUNT=8
# The RX pool bottomed out at 4 free of 24 over a 10 h soak (0 free in an
# earlier one), the tightest resource on these builds. 32 keeps a margin; the
# OPC-UA firmware, which carries more traffic, uses 40.
CONFIG_NET_BUF_RX_COUNT=32
CONFIG_NET_BUF_TX_COUNT=24

# --- Thread stacks (measured with the thread analyzer on an ESP32-CAM) ---
# The system workqueue peaks at ~770 B of its 1 KB default and the log thread
# at ~900 B of 1 KB; an overflow of either silently corrupts memory and stalls
# the firmware. Give both headroom. (The connectivity work that overflowed the
# system workqueue now runs on its own queue: CONFIG_APP_NET_WORKQ_STACK_SIZE.)
CONFIG_SYSTEM_WORKQUEUE_STACK_SIZE=2048
CONFIG_LOG_PROCESS_THREAD_STACK_SIZE=2048

# --- Socket service poll set ---
# The socket service thread (mDNS responder, DNS-SD) polls 4 sockets here. With
# the default of 3 it logs "Please increase CONFIG_ZVFS_POLL_MAX" and never
# starts, so the device stops answering mDNS.
CONFIG_ZVFS_POLL_MAX=6
# Once it runs, the service thread (mDNS responder) peaks at ~1.4 KB: 16 bytes
# short of its 1408-byte default. Give it headroom.
CONFIG_NET_SOCKETS_SERVICE_STACK_SIZE=2400
```

## boards/adafruit_feather_esp32s2_tft_esp32s2.overlay
```dts
/* SPDX-License-Identifier: Apache-2.0
 *
 * The Adafruit Feather ESP32-S2 board devicetree leaves the Wi-Fi node
 * disabled. Enable it so CONFIG_WIFI_ESP32 (which depends on
 * DT_HAS_ESPRESSIF_ESP32_WIFI_ENABLED) can be selected.
 */
&wifi {
	status = "okay";
};

/* Enable the built-in ST7789 TFT (disabled by default on this board) so the
 * firmware can show connectivity status / the device IP on-screen. */
&st7789v_tft {
	status = "okay";
};
```

## boards/esp32s3_devkitc_esp32s3_procpu.overlay
```dts
/* SPDX-License-Identifier: Apache-2.0
 *
 * ESP32-S3-DevKitC-1 — flash size and layout.
 *
 * Console: **left as the board devicetree sets it**, i.e. `uart0` on the
 * board's UART port (the one marked UART, not the one marked USB). That port
 * carries a USB-serial bridge with DTR/RTS wired to EN/BOOT, so esptool can
 * reset the board into download mode on its own — no BOOT/RESET button press
 * to flash, and no losing the first lines of boot output to a USB re-enumeration.
 * That makes it the better default for this board, so this overlay deliberately
 * does *not* re-route the console onto USB-Serial-JTAG the way the ESP32-C6
 * overlay does.
 *
 * If you would rather use the native USB port, add:
 *
 *     &usb_serial { status = "okay"; };
 *     &usb_otg    { status = "disabled"; };   // shares GPIO19/20 with the above
 *     / { chosen {
 *             zephyr,console   = &usb_serial;
 *             zephyr,shell-uart = &usb_serial;
 *     }; };
 *
 * and be aware that a board running unrelated factory firmware on that port may
 * refuse every esptool reset strategy until you hold BOOT and tap RESET once.
 *
 * Flash size: the board devicetree includes `esp32s3_wroom_n8.dtsi`, which
 * declares an 8 MB part. The board in hand is an **N16R8** — `esptool flash-id`
 * reports 16 MB (manufacturer 0x1c, device 0x7118) on an ESP32-S3 rev v0.2 with
 * MAC 7c:0c:5f:5a:6e:b8, plus 8 MB of octal PSRAM that this firmware does not
 * use. The shared layout (lib/common/dts/layout-esp32s3-16M.dtsi) declares the
 * real size and replaces the upstream AMP partitions with the MCUboot + Wi-Fi
 * provisioner layout, which MCUboot and the provisioner are built with too. A
 * plain build (no --sysbuild) still boots from 0x0. It needs a 16 MB part.
 *
 * No `&wifi` node is enabled here: unlike the QT Py S3 and the S2 Feather, the
 * ESP32-S3-DevKitC board devicetree already sets it to "okay".
 */

#include "../../../lib/common/dts/layout-esp32s3-16M.dtsi"

/* Status LED: the WS2812 RGB LED. */
#include "../../../lib/common/dts/rgb-led-esp32s3-devkitc.dtsi"
```

## src/main.c
```c
/* SPDX-License-Identifier: Apache-2.0
 *
 * SNMP agent firmware entry point.
 *
 * Boot sequence:
 *   1. Bring up connectivity (Wi-Fi station on hardware; host networking on
 *      native_sim) and wait until the network is usable.
 *   2. Start the SNMPv2c agent (UDP responder on port 161 + trap originator),
 *      which presents the device as a managed switch/router.
 */

#include <zephyr/kernel.h>
#include <zephyr/logging/log.h>

#include "net.h"
#include "prov_tedge.h"
#include "display.h"
#include "snmp_agent.h"
#if defined(CONFIG_TEDGE)
#include "tedge_glue.h"
#endif

LOG_MODULE_REGISTER(main, CONFIG_LOG_DEFAULT_LEVEL);

int main(void)
{
	int ret;

	LOG_INF("SNMP agent firmware starting: device \"%s\"",
		CONFIG_APP_DEVICE_NAME);

	display_status_init();
	display_status_stage(DISPLAY_STAGE_WIFI_CONNECTING);

	ret = app_net_init();
	if (ret) {
		LOG_ERR("Connectivity init failed (%d)", ret);
		display_status_stage(DISPLAY_STAGE_ERROR);
		return 0;
	}

	/* No Wi-Fi network yet: the client starts first (tedge-onboard gives
	 * the device one), and the rest waits for the network. */
	bool onboarding = app_prov_tedge_start_unprovisioned(tedge_glue_start);

	LOG_INF("Waiting for network...");
	ret = app_net_wait_connected(onboarding ? K_FOREVER : K_SECONDS(60));
	if (ret) {
		LOG_ERR("Network did not come up in time (%d)", ret);
		display_status_stage(DISPLAY_STAGE_ERROR);
		return 0;
	}

	ret = snmp_agent_start();
	if (ret) {
		LOG_ERR("Failed to start SNMP agent (%d)", ret);
		display_status_stage(DISPLAY_STAGE_ERROR);
		return 0;
	}
	LOG_INF("SNMP agent running on UDP port %d", CONFIG_APP_SNMP_PORT);

#if defined(CONFIG_TEDGE)
	/* Device management runs alongside the protocol agent. */
	if (onboarding || tedge_glue_start() == 0) {
#if defined(CONFIG_TEDGE_TELEMETRY)
		tedge_glue_start_telemetry();
#endif
	}
#endif

	return 0;
}
```

## src/tedge_glue.c
```c
/* SPDX-License-Identifier: Apache-2.0
 *
 * The glue between this application and the tiny-edge client. It lives
 * here, not in the module: the module knows nothing about lib/common.
 *
 * The SNMP agent answers polls and sends traps; the client gives the same
 * device a way to be managed from Cumulocity — onboarded, restarted,
 * updated, and adjusted through its parameter set — without either knowing
 * about the other.
 */

#include "tedge_glue.h"

#include "boot_request.h"
#include "identity.h"
#if defined(CONFIG_APP_WIFI_CRED_STORE)
#include "prov_c8y.h"
#include "prov_tedge.h"
#endif
#include "status_led.h"

#include <zephyr/kernel.h>
#include <zephyr/logging/log.h>

#include <tedge/tedge.h>

#include <stdio.h>
#include <string.h>

LOG_MODULE_REGISTER(tedge_glue, CONFIG_LOG_DEFAULT_LEVEL);

static void on_state(enum tedge_state state, void *user_data)
{
	ARG_UNUSED(user_data);

	switch (state) {
	case TEDGE_STATE_AWAITING_REGISTRATION: {
		char url[220];

		/* The operator registers the device from this URL. It carries
		 * the one-time password, so the module never logs it itself. */
		if (tedge_registration_url(url, sizeof(url)) > 0) {
			LOG_INF("register this device: %s", url);
		}
		status_led_set_mode(STATUS_LED_PROVISIONING);
		break;
	}
	case TEDGE_STATE_CONNECTED:
		status_led_set_mode(STATUS_LED_CONNECTED);
		break;
	default:
		break;
	}
}

/* An SNMP poll is stateless and a manager retries, so a restart costs a
 * missed poll at worst; nothing here needs to veto it. */
static int restart_request(char *reason, size_t reason_len, void *user_data)
{
	ARG_UNUSED(reason);
	ARG_UNUSED(reason_len);
	ARG_UNUSED(user_data);
	LOG_INF("restart requested from the cloud");
	return 0;
}

static void reset(void *user_data)
{
	ARG_UNUSED(user_data);
	boot_request_reboot();
}

static const struct tedge_hooks hooks = {
	.on_state = on_state,
	.restart_request = restart_request,
	.reset = reset,
};

#if defined(CONFIG_TEDGE_PARAMETERS) && defined(CONFIG_TEDGE_TELEMETRY)
/* What an operator may change on an SNMP device from the cloud. The
 * client's own "tiny_edge" set is declared beside this one and covers how much
 * it logs, how often it reports its health and whether tunnels are allowed.
 */
#define AGENT_SET "zephyr_snmp_telemetry"

static const struct tedge_parameter agent_params[] = {
	TEDGE_PARAM_INT("interval_s", CONFIG_APP_TEDGE_MEASUREMENT_INTERVAL_S,
			5, 3600, "Seconds between measurements"),
	TEDGE_PARAM_BOOL("telemetry", true,
			 "Publish measurements to the cloud"),
};

static int32_t param_interval_s(void)
{
	int32_t seconds;

	if (tedge_parameter_get_int(AGENT_SET, "interval_s", &seconds) == 0) {
		return seconds;
	}
	return CONFIG_APP_TEDGE_MEASUREMENT_INTERVAL_S;
}

static bool param_telemetry_on(void)
{
	bool on;

	if (tedge_parameter_get_bool(AGENT_SET, "telemetry", &on) == 0) {
		return on;
	}
	return true;
}
#endif /* CONFIG_TEDGE_PARAMETERS && CONFIG_TEDGE_TELEMETRY */

int tedge_glue_start(void)
{
	struct tedge_identity id = {
		.external_id = app_identity_device_id(),
		.name = app_identity_device_id(),
		.type = "thin-edge.io-zephyr-snmp",
		.firmware_name = app_identity_firmware_name(),
		.firmware_version = app_identity_firmware_version(),
	};
	int rc = tedge_init(&id, &hooks);

	if (rc != 0) {
		LOG_ERR("tedge_init failed (%d)", rc);
		return rc;
	}
#if defined(CONFIG_APP_TEDGE_PROVISIONING)
	(void)app_prov_tedge_init();
#endif
#if defined(CONFIG_APP_WIFI_CRED_STORE)
	/* Tenant and one-time password from the ZTP provisioner, if it left
	 * any. The external ID already came through app_identity_device_id(). */
	(void)prov_c8y_handoff();
#endif
#if defined(CONFIG_TEDGE_PARAMETERS) && defined(CONFIG_TEDGE_TELEMETRY)
	/* Before tedge_start(): the client loads the stored values over the
	 * declared defaults and reports the set as soon as it connects. */
	rc = tedge_declare_parameters(AGENT_SET, agent_params,
				      ARRAY_SIZE(agent_params), NULL, NULL);
	if (rc != 0) {
		LOG_WRN("could not declare the '%s' parameters (%d)",
			AGENT_SET, rc);
	}
#endif
	rc = tedge_start();
	if (rc != 0) {
		LOG_ERR("tedge_start failed (%d)", rc);
	}
	return rc;
}

#if defined(CONFIG_TEDGE_TELEMETRY)
/* The agent already knows its uptime and what it has served; sending the
 * same numbers to Cumulocity costs one message per interval and gives an
 * operator something without an SNMP manager. */
static void telemetry_fn(struct k_work *work)
{
	struct tedge_measurement_value values[] = {
		{ .series = "uptime", .unit = "s" },
	};
	int32_t interval = CONFIG_APP_TEDGE_MEASUREMENT_INTERVAL_S;
	bool on = true;

#if defined(CONFIG_TEDGE_PARAMETERS)
	interval = param_interval_s();
	on = param_telemetry_on();
#endif
	values[0].value = (double)(k_uptime_get() / 1000);
	if (on) {
		(void)tedge_publish_measurement(
			CONFIG_APP_TEDGE_MEASUREMENT_TYPE, values,
			ARRAY_SIZE(values), 0);
	}
	(void)k_work_reschedule(k_work_delayable_from_work(work),
				K_SECONDS(interval));
}

static K_WORK_DELAYABLE_DEFINE(telemetry_work, telemetry_fn);

void tedge_glue_start_telemetry(void)
{
	(void)k_work_schedule(&telemetry_work,
			      K_SECONDS(CONFIG_APP_TEDGE_MEASUREMENT_INTERVAL_S));
}
#endif /* CONFIG_TEDGE_TELEMETRY */
```

## src/tedge_glue.h
```c
/* SPDX-License-Identifier: Apache-2.0 */
#ifndef TEDGE_GLUE_H_
#define TEDGE_GLUE_H_

/** Start the thin-edge.io client with this application's identity and hooks. */
int tedge_glue_start(void);

#if defined(CONFIG_TEDGE_TELEMETRY)
/** Begin publishing the agent's own measurements. Call after the client. */
void tedge_glue_start_telemetry(void);
#endif

#endif /* TEDGE_GLUE_H_ */
```
