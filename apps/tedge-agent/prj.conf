## CMakeLists.txt
```
# SPDX-License-Identifier: Apache-2.0
#
# Device-management agent firmware: the shared core (lib/common) and the
# thin-edge.io client (tiny-edge), with no protocol frontend. For a device
# whose job is to be managed from Cumulocity and to give it remote access to
# hosts on its LAN. Build with a tiny-edge profile and the board's settings
# (both in tiny-edge's ports/zephyr/profiles/):
#   west build --sysbuild -b <board> apps/tedge-agent -- \
#     "-DEXTRA_CONF_FILE=<profile>.conf;<board settings>.conf"
cmake_minimum_required(VERSION 3.20.0)

list(APPEND ZEPHYR_EXTRA_MODULES
  ${CMAKE_CURRENT_SOURCE_DIR}/../../lib/common
)
# The thin-edge.io client (tiny-edge) is a west project, so west adds it as a
# module; see west.yml.

find_package(Zephyr REQUIRED HINTS $ENV{ZEPHYR_BASE})
project(tedge_agent_firmware C)

# The glue to the device-management client lives in the application, never in
# the module.
target_sources(app PRIVATE src/main.c src/tedge_glue.c)
```

## Kconfig
```
# SPDX-License-Identifier: Apache-2.0
#
# Device-management agent. Shared options come from the lib/common module and
# the client's from tiny-edge (both auto-sourced via Kconfig.zephyr below).

mainmenu "thin-edge.io Device Agent Firmware"

config APP_TEDGE_MEASUREMENT_TYPE
	string "Measurement type of the device's own telemetry"
	depends on TEDGE_TELEMETRY
	default "device"

config APP_TEDGE_MEASUREMENT_INTERVAL_S
	int "Seconds between device telemetry measurements"
	depends on TEDGE_TELEMETRY
	default 60

source "Kconfig.zephyr"
```

## prj.conf
```kconfig
# SPDX-License-Identifier: Apache-2.0
#
# Board-agnostic application configuration. Wi-Fi/stack specifics live in
# boards/<board>.conf; the client's feature set in a tiny-edge profile and
# its board sizing in tiny-edge/ports/zephyr/profiles/boards/, both passed as
# EXTRA_CONF_FILE. What is here is enough for the client to connect on its
# own; the profile adds to it.

# --- Firmware identity ---
CONFIG_APP_DEVICE_NAME="tedge-agent-device"
CONFIG_APP_FIRMWARE_NAME="zephyr-tedge-agent"

# --- The client: this application exists to run it ---
CONFIG_TEDGE=y
CONFIG_TEDGE_TRANSPORT_C8Y=y
CONFIG_TEDGE_C8Y_MQTT_SERVICE=y
CONFIG_TEDGE_AUTH_C8Y_CA=y
CONFIG_TEDGE_RESTART=y
CONFIG_TEDGE_HEALTH=y
CONFIG_TEDGE_TELEMETRY=y

# What the application must provide for the client (tiny-edge/ports/zephyr/README.md).
CONFIG_MBEDTLS=y
CONFIG_MBEDTLS_ENABLE_HEAP=y
CONFIG_MBEDTLS_HEAP_SIZE=65536
CONFIG_MBEDTLS_SSL_MAX_CONTENT_LEN=16384
CONFIG_MBEDTLS_SSL_PROTO_TLS1_2=y
CONFIG_MBEDTLS_CIPHERSUITE_TLS_ECDHE_RSA_WITH_AES_128_GCM_SHA256=y
CONFIG_MBEDTLS_CIPHERSUITE_TLS_ECDHE_ECDSA_WITH_AES_128_GCM_SHA256=y
CONFIG_PSA_WANT_ECC_SECP_R1_256=y
CONFIG_MBEDTLS_SSL_SERVER_NAME_INDICATION=y
CONFIG_MBEDTLS_HAVE_TIME_DATE=y
CONFIG_MBEDTLS_PEM_PARSE_C=y
CONFIG_MBEDTLS_X509_CRT_PARSE_C=y
CONFIG_SECURE_STORAGE_ITS_STORE_IMPLEMENTATION_SETTINGS=y

# Free system heap in the device's own telemetry.
CONFIG_SYS_HEAP_RUNTIME_STATS=y

# --- Logging ---
CONFIG_LOG=y
CONFIG_LOG_DEFAULT_LEVEL=3

# --- Runtime / memory ---
# main() only starts the client and returns; the client runs on its own
# threads. On the WROOM every KB of DRAM counts.
CONFIG_MAIN_STACK_SIZE=4096
# The system heap (CONFIG_HEAP_MEM_POOL_SIZE) is not set: on every ESP32
# board the Wi-Fi driver's minimum (51,200 B) wins over any smaller value,
# so the image gets about 55 KB whatever is written here. See the board
# settings files for the size each board resolves to.
# No CONFIG_POSIX_API: the code uses Zephyr's native zsock_* socket API, so
# the POSIX layer's thread, signal, timer and fd pools stay out of the image.

# --- Networking (BSD sockets API; stack specifics per board) ---
CONFIG_NETWORKING=y
CONFIG_NET_SOCKETS=y
CONFIG_NET_LOG=y
```

## boards/adafruit_qt_py_esp32s3_esp32s3_procpu.conf
```kconfig
# SPDX-License-Identifier: Apache-2.0
#
# Adafruit QT Py ESP32-S3 for the device-management agent. Wi-Fi station + native IP
# stack + mDNS. The &wifi node is enabled via the sibling .overlay.

# --- Wi-Fi driver ---
CONFIG_WIFI=y
CONFIG_WIFI_ESP32=y
CONFIG_APP_WIFI=y

CONFIG_NET_MGMT=y
CONFIG_NET_MGMT_EVENT=y
CONFIG_NET_MGMT_EVENT_INFO=y
CONFIG_NET_CONNECTION_MANAGER=y

# The system heap is not set: the Wi-Fi driver's minimum (51,200 B) wins
# over any smaller CONFIG_HEAP_MEM_POOL_SIZE, so this board's images get
# about 55 KB of system heap whatever is written here (the exact sum of the
# drivers' minimums varies a little with the options built).

# --- IP stack ---
CONFIG_NET_L2_ETHERNET=y
CONFIG_NET_IPV4=y
CONFIG_NET_IPV6=n
CONFIG_NET_UDP=y
CONFIG_NET_TCP=y
CONFIG_NET_DHCPV4=y

# --- mDNS: reachable as <hostname>.local; no DNS-SD service to advertise ---
CONFIG_NET_HOSTNAME_ENABLE=y
CONFIG_NET_HOSTNAME="tedge-agent"
CONFIG_NET_HOSTNAME_UNIQUE=y
CONFIG_MDNS_RESPONDER=y
CONFIG_DNS_SD=n

# --- Socket / net buffer budget (the client and its tunnel; keep some headroom) ---
CONFIG_NET_MAX_CONTEXTS=8
CONFIG_NET_MAX_CONN=6
CONFIG_ZVFS_OPEN_MAX=12
CONFIG_NET_TCP_TIME_WAIT_DELAY=250
CONFIG_NET_PKT_RX_COUNT=8
CONFIG_NET_PKT_TX_COUNT=8
# The RX pool bottomed out at 4 free of 24 over a 10 h soak (0 free in an
# earlier one), the tightest resource on these builds. 32 keeps a margin; the
# OPC-UA firmware, which carries more traffic, uses 40.
CONFIG_NET_BUF_RX_COUNT=32
CONFIG_NET_BUF_TX_COUNT=24

# --- Thread stacks (measured with the thread analyzer on an ESP32-CAM) ---
# The system workqueue peaks at ~770 B of its 1 KB default; an overflow
# silently corrupts memory and stalls the firmware. (The connectivity work that
# overflowed it now runs on its own queue: CONFIG_APP_NET_WORKQ_STACK_SIZE. The
# log thread's stack is raised in lib/common/Kconfig, because the option only
# exists with deferred logging.)
CONFIG_SYSTEM_WORKQUEUE_STACK_SIZE=2048

# --- Socket service poll set ---
# The socket service thread (mDNS responder, DNS-SD) polls 4 sockets here. With
# the default of 3 it logs "Please increase CONFIG_ZVFS_POLL_MAX" and never
# starts, so the device stops answering mDNS.
CONFIG_ZVFS_POLL_MAX=6
# Once it runs, the service thread (mDNS responder) peaks at ~1.4 KB: 16 bytes
# short of its 1408-byte default. Give it headroom.
CONFIG_NET_SOCKETS_SERVICE_STACK_SIZE=2400
```

## boards/esp32_devkitc_esp32_procpu.conf
```kconfig
# SPDX-License-Identifier: Apache-2.0
#
# ESP32-WROOM-32 for the device-management agent. Wi-Fi station + native IP stack +
# mDNS. No protocol server, so net pools are modest.

# Allow older ESP32 silicon (WROOM-32 rev v1.0) to boot.
CONFIG_ESP32_USE_UNSUPPORTED_REVISION=y

# --- Wi-Fi driver ---
CONFIG_WIFI=y
CONFIG_WIFI_ESP32=y
CONFIG_APP_WIFI=y

CONFIG_NET_MGMT=y
CONFIG_NET_MGMT_EVENT=y
CONFIG_NET_MGMT_EVENT_INFO=y
CONFIG_NET_CONNECTION_MANAGER=y

# The system heap is not set: the Wi-Fi driver's minimum (51,200 B) wins
# over any smaller CONFIG_HEAP_MEM_POOL_SIZE, so this board's images get
# about 55 KB of system heap whatever is written here (the exact sum of the
# drivers' minimums varies a little with the options built).

# --- IP stack ---
CONFIG_NET_L2_ETHERNET=y
CONFIG_NET_IPV4=y
CONFIG_NET_IPV6=n
CONFIG_NET_UDP=y
CONFIG_NET_TCP=y
CONFIG_NET_DHCPV4=y

# --- mDNS: reachable as <hostname>.local; no DNS-SD service to advertise ---
CONFIG_NET_HOSTNAME_ENABLE=y
CONFIG_NET_HOSTNAME="tedge-agent"
CONFIG_NET_HOSTNAME_UNIQUE=y
CONFIG_MDNS_RESPONDER=y
CONFIG_DNS_SD=n

# --- Socket / net buffer budget (the client and its tunnel; keep some headroom) ---
CONFIG_NET_MAX_CONTEXTS=8
CONFIG_NET_MAX_CONN=6
CONFIG_ZVFS_OPEN_MAX=12
CONFIG_NET_TCP_TIME_WAIT_DELAY=250
CONFIG_NET_PKT_RX_COUNT=8
CONFIG_NET_PKT_TX_COUNT=8
# The RX pool bottomed out at 4 free of 24 over a 10 h soak (0 free in an
# earlier one), the tightest resource on these builds. 32 keeps a margin; the
# OPC-UA firmware, which carries more traffic, uses 40.
CONFIG_NET_BUF_RX_COUNT=32
CONFIG_NET_BUF_TX_COUNT=24

# --- Thread stacks (measured with the thread analyzer on an ESP32-CAM) ---
# The system workqueue peaks at ~770 B of its 1 KB default; an overflow
# silently corrupts memory and stalls the firmware. (The connectivity work that
# overflowed it now runs on its own queue: CONFIG_APP_NET_WORKQ_STACK_SIZE. The
# log thread's stack is raised in lib/common/Kconfig, because the option only
# exists with deferred logging.)
CONFIG_SYSTEM_WORKQUEUE_STACK_SIZE=2048

# --- Socket service poll set ---
# The socket service thread (mDNS responder, DNS-SD) polls 4 sockets here. With
# the default of 3 it logs "Please increase CONFIG_ZVFS_POLL_MAX" and never
# starts, so the device stops answering mDNS.
CONFIG_ZVFS_POLL_MAX=6
# Once it runs, the service thread (mDNS responder) peaks at ~1.4 KB: 16 bytes
# short of its 1408-byte default. Give it headroom.
CONFIG_NET_SOCKETS_SERVICE_STACK_SIZE=2400

# --- .noinit in DRAM region 1 (SRAM1), also under MCUboot ---
# Simple boot puts .noinit (thread stacks, net buffers; ~68 KB here) in the
# SRAM1 region a second-stage bootloader would use. Zephyr turns that off for
# MCUboot builds, which moves it into region 0 and takes it out of the libc
# heap (70 KB → 3 KB for OPC-UA). .noinit is never loaded, so MCUboot is done
# with that RAM by the time the application uses it.
CONFIG_ESP32_REGION_1_NOINIT=y
```

## boards/esp32c6_devkitc_esp32c6_hpcore.conf
```kconfig
# SPDX-License-Identifier: Apache-2.0
#
# ESP32-C6 (QIQIAZI board carrying an ESP32-C6-WROOM-1-N4 module; single-core
# **RISC-V** + LP core, 160 MHz, ~512 KB HP SRAM, 4 MB flash, no PSRAM).
# Build target: esp32c6_devkitc/esp32c6/hpcore.
#
# *** This is the first RISC-V target in this repo, and the first Wi-Fi 6
# radio. *** Everything below is architecture-neutral and copied from the
# verified Xtensa ESP32-S3 ports: the net-buffer and stack figures were measured
# from workload behaviour (mDNS socket count, workqueue and log stack peaks
# under the protocol threads), not from SoC specifics, so they carry over. If a
# genuinely RISC-V-specific setting is ever needed, add it here under its own
# heading so the architecture split stays easy to find.
#
# The board is a clone, not an Espressif C6-DevKitC-1, so nothing here depends
# on board pinout — only on the on-die Wi-Fi and USB-Serial-JTAG peripherals.
#
# Two notes carried from the S3-DevKitC port:
#   * No &wifi overlay. The C6 board devicetree already sets the Wi-Fi node to
#     "okay", so CONFIG_WIFI_ESP32 can be selected directly.
#   * The sibling .overlay re-routes the console onto USB-Serial-JTAG and
#     corrects the declared flash size from the dtsi's 8 MB to the real 4 MB.
#
# No status LED: the board has a WS2812 addressable RGB LED, not the plain GPIO
# led0 alias lib/common/status_led.c drives, and the clone's LED pin is not
# documented upstream. The indicator is a no-op here (the "No LED present"
# scenario in the wifi-connectivity spec); read connectivity from the console.
#
# The C6 also carries IEEE 802.15.4 and BT LE radios, enabled in the board
# devicetree. Neither is used: no CONFIG_BT or CONFIG_IEEE802154 is set, so no
# driver is built and neither costs flash. This firmware is a Wi-Fi station.

# --- Wi-Fi driver ---
CONFIG_WIFI=y
CONFIG_WIFI_ESP32=y
CONFIG_APP_WIFI=y

CONFIG_NET_MGMT=y
CONFIG_NET_MGMT_EVENT=y
CONFIG_NET_MGMT_EVENT_INFO=y
CONFIG_NET_CONNECTION_MANAGER=y

# The system heap is not set: the Wi-Fi driver's minimum (51,200 B) wins
# over any smaller CONFIG_HEAP_MEM_POOL_SIZE, so this board's images get
# about 55 KB of system heap whatever is written here (the exact sum of the
# drivers' minimums varies a little with the options built).

# --- IP stack ---
CONFIG_NET_L2_ETHERNET=y
CONFIG_NET_IPV4=y
CONFIG_NET_IPV6=n
CONFIG_NET_UDP=y
CONFIG_NET_TCP=y
CONFIG_NET_DHCPV4=y

# --- mDNS: reachable as <hostname>.local; no DNS-SD service to advertise ---
CONFIG_NET_HOSTNAME_ENABLE=y
CONFIG_NET_HOSTNAME="tedge-agent"
CONFIG_NET_HOSTNAME_UNIQUE=y
CONFIG_MDNS_RESPONDER=y
CONFIG_DNS_SD=n

# --- Socket / net buffer budget (the client and its tunnel; keep some headroom) ---
CONFIG_NET_MAX_CONTEXTS=8
CONFIG_NET_MAX_CONN=6
CONFIG_ZVFS_OPEN_MAX=12
CONFIG_NET_TCP_TIME_WAIT_DELAY=250
CONFIG_NET_PKT_RX_COUNT=8
CONFIG_NET_PKT_TX_COUNT=8
# The RX pool bottomed out at 4 free of 24 over a 10 h soak (0 free in an
# earlier one), the tightest resource on these builds. 32 keeps a margin; the
# OPC-UA firmware, which carries more traffic, uses 40.
CONFIG_NET_BUF_RX_COUNT=32
CONFIG_NET_BUF_TX_COUNT=24

# --- Thread stacks (measured with the thread analyzer on an ESP32-CAM) ---
# The system workqueue peaks at ~770 B of its 1 KB default; an overflow
# silently corrupts memory and stalls the firmware. (The connectivity work that
# overflowed it now runs on its own queue: CONFIG_APP_NET_WORKQ_STACK_SIZE. The
# log thread's stack is raised in lib/common/Kconfig, because the option only
# exists with deferred logging.)
CONFIG_SYSTEM_WORKQUEUE_STACK_SIZE=2048

# --- Socket service poll set ---
# The socket service thread (mDNS responder, DNS-SD) polls 4 sockets here. With
# the default of 3 it logs "Please increase CONFIG_ZVFS_POLL_MAX" and never
# starts, so the device stops answering mDNS.
CONFIG_ZVFS_POLL_MAX=6
# Once it runs, the service thread (mDNS responder) peaks at ~1.4 KB: 16 bytes
# short of its 1408-byte default. Give it headroom.
CONFIG_NET_SOCKETS_SERVICE_STACK_SIZE=2400
```

## boards/esp32s3_devkitc_esp32s3_procpu.conf
```kconfig
# SPDX-License-Identifier: Apache-2.0
#
# ESP32-S3-DevKitC-1 (Espressif reference board; dual-core Xtensa LX7, 512 KB
# SRAM). The board in hand is an N16R8: 16 MB flash and 8 MB octal PSRAM,
# though the board devicetree assumes an N8 and no PSRAM is enabled here.
# Build target: esp32s3_devkitc/esp32s3/procpu.
#
# Mirrors the Adafruit QT Py ESP32-S3 config, which is verified on hardware and
# is near-identical silicon. Two deliberate differences from that port:
#   * No &wifi overlay. This board devicetree already sets the Wi-Fi node to
#     "okay", so CONFIG_WIFI_ESP32 can be selected directly.
#   * The console stays on uart0, the board's own choice, which comes out on the
#     board's UART port. That port's bridge wires DTR/RTS to EN/BOOT, so esptool
#     resets it into download mode by itself — flashing needs no button press and
#     boot output is not lost to a USB re-enumeration. The sibling .overlay only
#     corrects the declared flash size (this board is an N16R8, not the N8 the
#     board devicetree assumes).
#
# No status LED: the board carries a WS2812 addressable RGB LED, not the plain
# GPIO led0 alias that lib/common/status_led.c drives, so the indicator is a
# no-op here (see the "No LED present" scenario in the wifi-connectivity spec).
# Connectivity state is read from the console log.

# --- Wi-Fi driver ---
CONFIG_WIFI=y
CONFIG_WIFI_ESP32=y
CONFIG_APP_WIFI=y

CONFIG_NET_MGMT=y
CONFIG_NET_MGMT_EVENT=y
CONFIG_NET_MGMT_EVENT_INFO=y
CONFIG_NET_CONNECTION_MANAGER=y

# The system heap is not set: the Wi-Fi driver's minimum (51,200 B) wins
# over any smaller CONFIG_HEAP_MEM_POOL_SIZE, so this board's images get
# about 55 KB of system heap whatever is written here (the exact sum of the
# drivers' minimums varies a little with the options built).

# --- IP stack ---
CONFIG_NET_L2_ETHERNET=y
CONFIG_NET_IPV4=y
CONFIG_NET_IPV6=n
CONFIG_NET_UDP=y
CONFIG_NET_TCP=y
CONFIG_NET_DHCPV4=y

# --- mDNS: reachable as <hostname>.local; no DNS-SD service to advertise ---
CONFIG_NET_HOSTNAME_ENABLE=y
CONFIG_NET_HOSTNAME="tedge-agent"
CONFIG_NET_HOSTNAME_UNIQUE=y
CONFIG_MDNS_RESPONDER=y
CONFIG_DNS_SD=n

# --- Socket / net buffer budget (the client and its tunnel; keep some headroom) ---
CONFIG_NET_MAX_CONTEXTS=8
CONFIG_NET_MAX_CONN=6
CONFIG_ZVFS_OPEN_MAX=12
CONFIG_NET_TCP_TIME_WAIT_DELAY=250
CONFIG_NET_PKT_RX_COUNT=8
CONFIG_NET_PKT_TX_COUNT=8
# The RX pool bottomed out at 4 free of 24 over a 10 h soak (0 free in an
# earlier one), the tightest resource on these builds. 32 keeps a margin; the
# OPC-UA firmware, which carries more traffic, uses 40.
CONFIG_NET_BUF_RX_COUNT=32
CONFIG_NET_BUF_TX_COUNT=24

# --- Thread stacks (measured with the thread analyzer on an ESP32-CAM) ---
# The system workqueue peaks at ~770 B of its 1 KB default; an overflow
# silently corrupts memory and stalls the firmware. (The connectivity work that
# overflowed it now runs on its own queue: CONFIG_APP_NET_WORKQ_STACK_SIZE. The
# log thread's stack is raised in lib/common/Kconfig, because the option only
# exists with deferred logging.)
CONFIG_SYSTEM_WORKQUEUE_STACK_SIZE=2048

# --- Socket service poll set ---
# The socket service thread (mDNS responder, DNS-SD) polls 4 sockets here. With
# the default of 3 it logs "Please increase CONFIG_ZVFS_POLL_MAX" and never
# starts, so the device stops answering mDNS.
CONFIG_ZVFS_POLL_MAX=6
# Once it runs, the service thread (mDNS responder) peaks at ~1.4 KB: 16 bytes
# short of its 1408-byte default. Give it headroom.
CONFIG_NET_SOCKETS_SERVICE_STACK_SIZE=2400
```

## boards/esp32_devkitc_esp32_procpu.overlay
```dts
/* SPDX-License-Identifier: Apache-2.0
 *
 * ESP32-WROOM-32: expose a status LED via the `led0` alias for the connectivity
 * indicator (lib/common/status_led.c). GPIO2 is the common on-board LED on
 * DevKitC-style boards; rewire here if your board differs.
 */
#include <zephyr/dt-bindings/gpio/gpio.h>

/ {
	aliases {
		led0 = &status_led;
	};

	leds {
		compatible = "gpio-leds";
		status_led: led_0 {
			gpios = <&gpio0 2 GPIO_ACTIVE_HIGH>;
			label = "Status LED";
		};
	};
};

/* Flash layout: the MCUboot + Wi-Fi provisioner partitions, shared with
 * MCUboot and the provisioner. A plain build (no --sysbuild) still boots from
 * 0x1000 and only uses its storage partition.
 */
#include "../../../lib/common/dts/layout-esp32-4M.dtsi"
```

## src/main.c
```c
/* SPDX-License-Identifier: Apache-2.0
 *
 * Device-management agent firmware entry point.
 *
 * Boot sequence:
 *   1. Bring up connectivity (Wi-Fi station, stored or provisioned
 *      credentials; with none, lib/common hands off to the provisioner) and
 *      wait until the network is usable.
 *   2. Start the thin-edge.io client. There is no protocol server: the
 *      device is managed from the cloud, and remote access reaches hosts on
 *      its LAN.
 */

#include <zephyr/kernel.h>
#include <zephyr/logging/log.h>

#include "net.h"
#include "prov_tedge.h"
#include "display.h"
#include "tedge_glue.h"

LOG_MODULE_REGISTER(main, CONFIG_LOG_DEFAULT_LEVEL);

int main(void)
{
	int ret;

	LOG_INF("Device agent firmware starting: device \"%s\"",
		CONFIG_APP_DEVICE_NAME);

	display_status_init();
	display_status_stage(DISPLAY_STAGE_WIFI_CONNECTING);

	ret = app_net_init();
	if (ret) {
		LOG_ERR("Connectivity init failed (%d)", ret);
		display_status_stage(DISPLAY_STAGE_ERROR);
		return 0;
	}

	/* No Wi-Fi network yet: the client starts first (tedge-onboard gives
	 * the device one), and the rest waits for the network. */
	bool onboarding = app_prov_tedge_start_unprovisioned(tedge_glue_start);

	LOG_INF("Waiting for network...");
	ret = app_net_wait_connected(onboarding ? K_FOREVER : K_SECONDS(60));
	if (ret) {
		LOG_ERR("Network did not come up in time (%d)", ret);
		display_status_stage(DISPLAY_STAGE_ERROR);
		return 0;
	}

	ret = onboarding ? 0 : tedge_glue_start();
	if (ret) {
		LOG_ERR("Device management did not start (%d)", ret);
		display_status_stage(DISPLAY_STAGE_ERROR);
		return 0;
	}
	LOG_INF("Device agent running");
#if defined(CONFIG_INIT_STACKS) && defined(CONFIG_THREAD_STACK_INFO)
	size_t unused;

	if (k_thread_stack_space_get(k_current_get(), &unused) == 0) {
		LOG_INF("main stack: %zu of %d bytes never used", unused,
			CONFIG_MAIN_STACK_SIZE);
	}
#endif
	return 0;
}
```

## src/tedge_glue.c
```c
/* SPDX-License-Identifier: Apache-2.0
 *
 * The glue between this application and the tiny-edge client. It lives
 * here, not in the module: the module knows nothing about lib/common.
 *
 * This application has no protocol of its own, so the glue is most of it:
 * the device's identity, the registration URL while it waits to be
 * registered, the status LED driven from the client's state, the platform
 * reset this repository uses (a CPU reset hangs MCUboot on the ESP32-C6),
 * and a little telemetry about the device itself so that a bare agent still
 * shows something in the cloud.
 *
 * Remote access follows the client's Kconfig policy (hosts on the device's
 * own LAN by default), so there is no allow hook here.
 */

#include "tedge_glue.h"

#include "boot_request.h"
#include "identity.h"
#include "net.h"
#if defined(CONFIG_APP_WIFI_CRED_STORE)
#include "prov_c8y.h"
#include "prov_tedge.h"
#endif
#include "status_led.h"

#include <zephyr/kernel.h>
#include <zephyr/logging/log.h>
#if defined(CONFIG_SHELL)
#include <zephyr/shell/shell.h>
#endif
#if defined(CONFIG_WIFI)
#include <zephyr/net/net_if.h>
#include <zephyr/net/wifi_mgmt.h>
#endif
#if defined(CONFIG_SYS_HEAP_RUNTIME_STATS)
#include <zephyr/sys/sys_heap.h>
#endif

#include <tedge/tedge.h>

LOG_MODULE_REGISTER(tedge_glue, CONFIG_LOG_DEFAULT_LEVEL);

static void on_state(enum tedge_state state, void *user_data)
{
	ARG_UNUSED(user_data);

	switch (state) {
	case TEDGE_STATE_AWAITING_REGISTRATION: {
		char url[220];

		/* The operator registers the device from this URL. It carries
		 * the one-time password, so the module never logs it itself. */
		if (tedge_registration_url(url, sizeof(url)) > 0) {
			LOG_INF("register this device: %s", url);
		}
		status_led_set_mode(STATUS_LED_PROVISIONING);
		break;
	}
	case TEDGE_STATE_CONNECTED:
		status_led_set_mode(STATUS_LED_CONNECTED);
		break;
	default:
		break;
	}
}

/* Nothing on this device needs to finish first. */
static int restart_request(char *reason, size_t reason_len, void *user_data)
{
	ARG_UNUSED(reason);
	ARG_UNUSED(reason_len);
	ARG_UNUSED(user_data);
	LOG_INF("restart requested from the cloud");
	return 0;
}

static void reset(void *user_data)
{
	ARG_UNUSED(user_data);
	boot_request_reboot();
}

static const struct tedge_hooks hooks = {
	.on_state = on_state,
	.restart_request = restart_request,
	.reset = reset,
};

#if defined(CONFIG_SHELL)
/* The client's state, for the cloud's shell command (a general health check
 * on the device; see tiny-edge/ports/zephyr/profiles/extras/shell-diagnostics.conf). */
static int cmd_diag(const struct shell *sh, size_t argc, char **argv)
{
	static const char *const names[] = {
		"stopped",   "waiting-network", "waiting-time",
		"awaiting-registration", "connecting", "connected", "updating",
	};
	enum tedge_state state = tedge_get_state();

	ARG_UNUSED(argc);
	ARG_UNUSED(argv);
	shell_print(sh, "tedge state=%s uptime=%llds",
		    ((size_t)state < ARRAY_SIZE(names)) ? names[state] : "?",
		    (long long)(k_uptime_get() / 1000));
	return 0;
}

/* Hangs off the client's own "tedge" root, which tiny-edge defines. */
SHELL_SUBCMD_ADD((tedge), diag, NULL, "client state", cmd_diag, 1, 0);
#endif /* CONFIG_SHELL */

#if defined(CONFIG_TEDGE_TELEMETRY)
#if defined(CONFIG_SYS_HEAP_RUNTIME_STATS)
extern struct k_heap _system_heap;
#endif

/* The device's own vitals: how long it has been up, how much kernel heap
 * the Wi-Fi driver and the client leave free, and the signal it joined on.
 * Values the device cannot read are left out rather than sent as zero. */
static void telemetry_fn(struct k_work *work)
{
	struct tedge_measurement_value values[3];
	size_t count = 0;

	values[count++] = (struct tedge_measurement_value){
		.series = "uptime",
		.unit = "s",
		.value = (double)(k_uptime_get() / 1000),
	};
#if defined(CONFIG_SYS_HEAP_RUNTIME_STATS)
	struct sys_memory_stats heap;

	if (sys_heap_runtime_stats_get(&_system_heap.heap, &heap) == 0) {
		values[count++] = (struct tedge_measurement_value){
			.series = "heap_free",
			.unit = "B",
			.value = (double)heap.free_bytes,
		};
	}
#endif
#if defined(CONFIG_WIFI)
	struct net_if *wifi = net_if_get_first_wifi();
	struct wifi_iface_status st = {0};

	/* Only while associated: a status query against a driver that is
	 * reconnecting can block. */
	if (wifi != NULL && app_net_is_connected() &&
	    net_mgmt(NET_REQUEST_WIFI_IFACE_STATUS, wifi, &st, sizeof(st)) ==
		    0) {
		values[count++] = (struct tedge_measurement_value){
			.series = "rssi",
			.unit = "dBm",
			.value = (double)st.rssi,
		};
	}
#endif
	(void)tedge_publish_measurement(CONFIG_APP_TEDGE_MEASUREMENT_TYPE,
					values, count, 0);
	(void)k_work_reschedule(k_work_delayable_from_work(work),
				K_SECONDS(CONFIG_APP_TEDGE_MEASUREMENT_INTERVAL_S));
}

static K_WORK_DELAYABLE_DEFINE(telemetry_work, telemetry_fn);
#endif /* CONFIG_TEDGE_TELEMETRY */

int tedge_glue_start(void)
{
	struct tedge_identity id = {
		.external_id = app_identity_device_id(),
		.name = app_identity_device_id(),
		.type = "thin-edge.io-zephyr-agent",
		.firmware_name = app_identity_firmware_name(),
		.firmware_version = app_identity_firmware_version(),
	};
	int rc = tedge_init(&id, &hooks);

	if (rc != 0) {
		LOG_ERR("tedge_init failed (%d)", rc);
		return rc;
	}
#if defined(CONFIG_APP_TEDGE_PROVISIONING)
	(void)app_prov_tedge_init();
#endif
#if defined(CONFIG_APP_WIFI_CRED_STORE)
	/* Tenant and one-time password from the ZTP provisioner, if it left
	 * any. The external ID already came through app_identity_device_id(). */
	(void)prov_c8y_handoff();
#endif
	rc = tedge_start();
	if (rc != 0) {
		LOG_ERR("tedge_start failed (%d)", rc);
		return rc;
	}
#if defined(CONFIG_TEDGE_TELEMETRY)
	(void)k_work_schedule(&telemetry_work,
			      K_SECONDS(CONFIG_APP_TEDGE_MEASUREMENT_INTERVAL_S));
#endif
	return 0;
}
```
