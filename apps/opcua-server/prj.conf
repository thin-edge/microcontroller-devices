## CMakeLists.txt
```
# SPDX-License-Identifier: Apache-2.0
#
# OPC-UA server firmware: composes the shared core (lib/common) with the OPC-UA
# protocol frontend (lib/opcua). Build with:
#   west build -b <board> apps/opcua-server
cmake_minimum_required(VERSION 3.20.0)

# Pull in the in-repo Zephyr modules this firmware is composed from. Must be set
# before find_package(Zephyr). Each module contributes its sources (via
# zephyr_library) and Kconfig. An app that needs a different protocol simply
# lists a different lib/<protocol> module here.
list(APPEND ZEPHYR_EXTRA_MODULES
  ${CMAKE_CURRENT_SOURCE_DIR}/../../lib/common
  ${CMAKE_CURRENT_SOURCE_DIR}/../../lib/opcua
)
# thin-edge.io device management (tiny-edge, off unless CONFIG_TEDGE=y) is a
# west project, so west adds it as a module; see west.yml.

find_package(Zephyr REQUIRED HINTS $ENV{ZEPHYR_BASE})
project(opcua_server_firmware C)

target_sources(app PRIVATE src/main.c)
# The glue to the device-management client lives in the application, never in
# the module.
target_sources_ifdef(CONFIG_TEDGE app PRIVATE src/tedge_glue.c)
```

## Kconfig
```
# SPDX-License-Identifier: Apache-2.0
#
# OPC-UA server application. Shared options come from the lib/common module and
# OPC-UA options from the lib/opcua module; both are auto-sourced as Zephyr
# modules via Kconfig.zephyr below, so this app defines no symbols of its own.

mainmenu "OPC-UA Server Firmware"

config APP_TEDGE_MEASUREMENT_TYPE
	string "Measurement type published to the cloud"
	depends on TEDGE_TELEMETRY
	default "server"

config APP_TEDGE_MEASUREMENT_INTERVAL_S
	int "Seconds between measurements"
	depends on TEDGE_TELEMETRY
	default 30

source "Kconfig.zephyr"
```

## prj.conf
```kconfig
# SPDX-License-Identifier: Apache-2.0
#
# Board-agnostic application configuration. Networking stack specifics and
# Wi-Fi live in boards/<board>.conf; secrets live in a git-ignored overlay
# (see overlay-wifi-credentials.conf.example).

# --- Firmware identity (paired with the VERSION file → FirmwareVersion) ---
CONFIG_APP_FIRMWARE_NAME="zephyr-opcua-server"

# --- Logging ---
CONFIG_LOG=y
CONFIG_LOG_DEFAULT_LEVEL=3

# --- Runtime / memory ---
# main() starts the network, the protocol server and the client, then
# returns; nothing runs on its stack afterwards (the agent measured 1.2 KB
# at 4 KB). Confirm with the thread analyzer (wroom-stackinfo.local.conf)
# when the release workloads change.
CONFIG_MAIN_STACK_SIZE=4096
# The system heap (CONFIG_HEAP_MEM_POOL_SIZE) is not set: on every ESP32
# board the Wi-Fi driver's minimum (51,200 B) wins over any smaller value,
# so the image gets about 55 KB whatever is written here. See the board
# settings files for the size each board resolves to.
# open62541 is built for the POSIX architecture (getaddrinfo, select,
# gethostname, ...), so this image keeps the POSIX layer.
CONFIG_POSIX_API=y

# --- Networking (BSD sockets API; stack specifics per board) ---
CONFIG_NETWORKING=y
CONFIG_NET_SOCKETS=y
CONFIG_NET_LOG=y
```

## boards/adafruit_feather_esp32s2_tft_esp32s2.conf
```kconfig
# SPDX-License-Identifier: Apache-2.0
#
# Adafruit Feather ESP32-S2 TFT (co-primary target): single-core Xtensa LX7
# Wi-Fi with 2 MB PSRAM. Build target: adafruit_feather_esp32s2_tft/esp32s2.

# --- Wi-Fi driver ---
CONFIG_WIFI=y
CONFIG_WIFI_ESP32=y
CONFIG_APP_WIFI=y

CONFIG_NET_MGMT=y
CONFIG_NET_MGMT_EVENT=y
CONFIG_NET_MGMT_EVENT_INFO=y
CONFIG_NET_CONNECTION_MANAGER=y

# open62541 uses the libc malloc arena (sized "all remaining RAM"): what
# the system heap takes is gone from that arena.
# The system heap is not set: the Wi-Fi driver's minimum (51,200 B) wins
# over any smaller CONFIG_HEAP_MEM_POOL_SIZE, so this board's images get
# about 55 KB of system heap whatever is written here (the exact sum of the
# drivers' minimums varies a little with the options built).

# --- IP stack ---
CONFIG_NET_L2_ETHERNET=y
CONFIG_NET_IPV4=y
CONFIG_NET_IPV6=n
CONFIG_NET_UDP=y
CONFIG_NET_TCP=y
CONFIG_NET_DHCPV4=y

# --- mDNS / DNS-SD advertisement ---
CONFIG_NET_HOSTNAME_ENABLE=y
CONFIG_NET_HOSTNAME="tedge-opcua"
CONFIG_NET_HOSTNAME_UNIQUE=y
CONFIG_MDNS_RESPONDER=y
CONFIG_DNS_SD=y

# --- Built-in TFT status display (ST7789 over MIPI-DBI SPI) ---
CONFIG_APP_DISPLAY_STATUS=y
CONFIG_DISPLAY=y
CONFIG_MIPI_DBI=y
CONFIG_ST7789V=y
CONFIG_ST7789V_RGB565=y
CONFIG_SPI=y
CONFIG_GPIO=y
CONFIG_POWER_DOMAIN=y

# Socket / net buffer budget.
CONFIG_NET_MAX_CONTEXTS=8
CONFIG_NET_MAX_CONN=6
CONFIG_ZVFS_OPEN_MAX=12
CONFIG_NET_PKT_RX_COUNT=6
CONFIG_NET_PKT_TX_COUNT=6
CONFIG_NET_BUF_RX_COUNT=16
CONFIG_NET_BUF_TX_COUNT=16
```

## boards/adafruit_qt_py_esp32s3_esp32s3_procpu.conf
```kconfig
# SPDX-License-Identifier: Apache-2.0
#
# Adafruit QT Py ESP32-S3 (dual-core Xtensa LX7, 512 KB SRAM, Wi-Fi + BT,
# 4 MB flash, 2 MB PSRAM). Build target: adafruit_qt_py_esp32s3/esp32s3/procpu.
# The tuned open62541 build fits the 512 KB internal SRAM, so PSRAM is not
# required here (use the board's @psram revision if it ever becomes tight).
# Mirrors the ESP32-WROOM config, including the connection-churn RAM/buffer
# tuning; the &wifi node is enabled via the sibling .overlay.

# --- Wi-Fi driver ---
CONFIG_WIFI=y
CONFIG_WIFI_ESP32=y
CONFIG_APP_WIFI=y

CONFIG_NET_MGMT=y
CONFIG_NET_MGMT_EVENT=y
CONFIG_NET_MGMT_EVENT_INFO=y
CONFIG_NET_CONNECTION_MANAGER=y

# open62541 uses the libc malloc arena (sized "all remaining RAM"): what
# the system heap takes is gone from that arena.
# The system heap is not set: the Wi-Fi driver's minimum (51,200 B) wins
# over any smaller CONFIG_HEAP_MEM_POOL_SIZE, so this board's images get
# about 55 KB of system heap whatever is written here (the exact sum of the
# drivers' minimums varies a little with the options built).

# --- IP stack ---
CONFIG_NET_L2_ETHERNET=y
CONFIG_NET_IPV4=y
CONFIG_NET_IPV6=n
CONFIG_NET_UDP=y
CONFIG_NET_TCP=y
CONFIG_NET_DHCPV4=y

# --- mDNS / DNS-SD advertisement ---
CONFIG_NET_HOSTNAME_ENABLE=y
CONFIG_NET_HOSTNAME="tedge-opcua"
CONFIG_NET_HOSTNAME_UNIQUE=y
CONFIG_MDNS_RESPONDER=y
CONFIG_DNS_SD=y

# Socket / connection headroom, sized with margin so a burst of client
# (re)connections cannot exhaust contexts/file descriptors (which would wedge
# the event loop). Matches the WROOM tuning that survives the churn stress.
CONFIG_NET_MAX_CONTEXTS=12
CONFIG_NET_MAX_CONN=10
CONFIG_ZVFS_OPEN_MAX=16
CONFIG_NET_TCP_TIME_WAIT_DELAY=250

# --- Net buffer pools (deep enough that connection bursts don't starve the
#     Wi-Fi driver of RX buffers) ---
CONFIG_NET_PKT_RX_COUNT=10
CONFIG_NET_PKT_TX_COUNT=10
CONFIG_NET_BUF_RX_COUNT=40
CONFIG_NET_BUF_TX_COUNT=32

# --- Thread stacks (measured with the thread analyzer on an ESP32-CAM) ---
# The system workqueue peaks at ~770 B of its 1 KB default; an overflow
# silently corrupts memory and stalls the firmware. (The connectivity work that
# overflowed it now runs on its own queue: CONFIG_APP_NET_WORKQ_STACK_SIZE. The
# log thread's stack is raised in lib/common/Kconfig, because the option only
# exists with deferred logging.)
CONFIG_SYSTEM_WORKQUEUE_STACK_SIZE=2048

# --- Socket service poll set ---
# The socket service thread (mDNS responder, DNS-SD) polls 4 sockets here. With
# the default of 3 it logs "Please increase CONFIG_ZVFS_POLL_MAX" and never
# starts, so the device stops answering mDNS.
CONFIG_ZVFS_POLL_MAX=6
# Once it runs, the service thread (mDNS responder) peaks at ~1.4 KB: 16 bytes
# short of its 1408-byte default. Give it headroom.
CONFIG_NET_SOCKETS_SERVICE_STACK_SIZE=2400
```

## boards/esp32_devkitc_esp32_procpu.conf
```kconfig
# SPDX-License-Identifier: Apache-2.0
#
# ESP32-WROOM-32 (co-primary target): Wi-Fi station + native IP stack + mDNS.

# Allow running on older ESP32 silicon (e.g. WROOM-32 chip revision v1.0),
# which the v4.4 bootloader otherwise refuses to boot.
CONFIG_ESP32_USE_UNSUPPORTED_REVISION=y

# --- Wi-Fi driver ---
CONFIG_WIFI=y
CONFIG_WIFI_ESP32=y
CONFIG_APP_WIFI=y

# open62541 allocates via libc malloc, whose arena is "all remaining RAM"
# (CONFIG_COMMON_LIBC_MALLOC_ARENA_SIZE=-1): what the system heap takes is
# gone from that arena.
# The system heap is not set: the Wi-Fi driver's minimum (51,200 B) wins
# over any smaller CONFIG_HEAP_MEM_POOL_SIZE, so this board's images get
# about 55 KB of system heap whatever is written here (the exact sum of the
# drivers' minimums varies a little with the options built).
CONFIG_NET_MGMT=y
CONFIG_NET_MGMT_EVENT=y
CONFIG_NET_MGMT_EVENT_INFO=y
CONFIG_NET_CONNECTION_MANAGER=y

# --- IP stack ---
CONFIG_NET_L2_ETHERNET=y
CONFIG_NET_IPV4=y
CONFIG_NET_IPV6=n
CONFIG_NET_UDP=y
CONFIG_NET_TCP=y
CONFIG_NET_DHCPV4=y

# --- mDNS / DNS-SD advertisement ---
CONFIG_NET_HOSTNAME_ENABLE=y
CONFIG_NET_HOSTNAME="tedge-opcua"
CONFIG_NET_HOSTNAME_UNIQUE=y
CONFIG_MDNS_RESPONDER=y
CONFIG_DNS_SD=y

# Socket / connection headroom for the OPC-UA server. Sized with margin so a
# burst of client (re)connections does not exhaust contexts/file descriptors —
# which would make the event loop's select() fail with ENOMEM and wedge the
# whole network stack (see the connection-churn stress test).
CONFIG_NET_MAX_CONTEXTS=12
CONFIG_NET_MAX_CONN=10
CONFIG_ZVFS_OPEN_MAX=16

# Free closed TCP connections quickly (default 1500 ms). A collector that
# reconnects frequently otherwise leaves many contexts pinned in TIME_WAIT.
CONFIG_NET_TCP_TIME_WAIT_DELAY=250

# --- RAM budget tuning (WROOM-32 has no PSRAM) ---
# The Wi-Fi stack and open62541 share ~300 KB of SRAM. These pools must be deep
# enough that a burst of client (re)connections does not starve the Wi-Fi driver
# of RX net buffers ("esp32_wifi: Failed to allocate net buffer"), which would
# otherwise wedge the network path. Sized with margin (verified via the
# connection-churn stress test) while still leaving heap for open62541.
CONFIG_NET_PKT_RX_COUNT=10
CONFIG_NET_PKT_TX_COUNT=10
CONFIG_NET_BUF_RX_COUNT=40
CONFIG_NET_BUF_TX_COUNT=32

# --- Thread stacks (measured with the thread analyzer on an ESP32-CAM) ---
# The system workqueue peaks at ~770 B of its 1 KB default; an overflow
# silently corrupts memory and stalls the firmware. (The connectivity work that
# overflowed it now runs on its own queue: CONFIG_APP_NET_WORKQ_STACK_SIZE. The
# log thread's stack is raised in lib/common/Kconfig, because the option only
# exists with deferred logging.)
CONFIG_SYSTEM_WORKQUEUE_STACK_SIZE=2048

# --- Socket service poll set ---
# The socket service thread (mDNS responder, DNS-SD) polls 4 sockets here. With
# the default of 3 it logs "Please increase CONFIG_ZVFS_POLL_MAX" and never
# starts, so the device stops answering mDNS.
CONFIG_ZVFS_POLL_MAX=6
# Once it runs, the service thread (mDNS responder) peaks at ~1.4 KB: 16 bytes
# short of its 1408-byte default. Give it headroom.
CONFIG_NET_SOCKETS_SERVICE_STACK_SIZE=2400

# --- .noinit in DRAM region 1 (SRAM1), also under MCUboot ---
# Simple boot puts .noinit (thread stacks, net buffers; ~68 KB here) in the
# SRAM1 region a second-stage bootloader would use. Zephyr turns that off for
# MCUboot builds, which moves it into region 0 and takes it out of the libc
# heap (70 KB → 3 KB for OPC-UA). .noinit is never loaded, so MCUboot is done
# with that RAM by the time the application uses it.
CONFIG_ESP32_REGION_1_NOINIT=y
```

## boards/esp32c6_devkitc_esp32c6_hpcore.conf
```kconfig
# SPDX-License-Identifier: Apache-2.0
#
# ESP32-C6 (QIQIAZI board carrying an ESP32-C6-WROOM-1-N4 module; single-core
# **RISC-V** + LP core, 160 MHz, ~512 KB HP SRAM, 4 MB flash, no PSRAM).
# Build target: esp32c6_devkitc/esp32c6/hpcore.
#
# *** This is the first RISC-V target in this repo, and the first Wi-Fi 6
# radio. *** Everything below is architecture-neutral and copied from the
# verified Xtensa ESP32-S3 ports: the net-buffer and stack figures were measured
# from workload behaviour (mDNS socket count, workqueue and log stack peaks
# under the protocol threads), not from SoC specifics, so they carry over. If a
# genuinely RISC-V-specific setting is ever needed, add it here under its own
# heading so the architecture split stays easy to find.
#
# The board is a clone, not an Espressif C6-DevKitC-1, so nothing here depends
# on board pinout — only on the on-die Wi-Fi and USB-Serial-JTAG peripherals.
#
# Two notes carried from the S3-DevKitC port:
#   * No &wifi overlay. The C6 board devicetree already sets the Wi-Fi node to
#     "okay", so CONFIG_WIFI_ESP32 can be selected directly.
#   * The sibling .overlay re-routes the console onto USB-Serial-JTAG and
#     corrects the declared flash size from the dtsi's 8 MB to the real 4 MB.
#
# No status LED: the board has a WS2812 addressable RGB LED, not the plain GPIO
# led0 alias lib/common/status_led.c drives, and the clone's LED pin is not
# documented upstream. The indicator is a no-op here (the "No LED present"
# scenario in the wifi-connectivity spec); read connectivity from the console.
#
# The C6 also carries IEEE 802.15.4 and BT LE radios, enabled in the board
# devicetree. Neither is used: no CONFIG_BT or CONFIG_IEEE802154 is set, so no
# driver is built and neither costs flash. This firmware is a Wi-Fi station.

# --- Wi-Fi driver ---
CONFIG_WIFI=y
CONFIG_WIFI_ESP32=y
CONFIG_APP_WIFI=y

CONFIG_NET_MGMT=y
CONFIG_NET_MGMT_EVENT=y
CONFIG_NET_MGMT_EVENT_INFO=y
CONFIG_NET_CONNECTION_MANAGER=y

# open62541 uses the libc malloc arena (sized "all remaining RAM"): what
# the system heap takes is gone from that arena.
# The system heap is not set: the Wi-Fi driver's minimum (51,200 B) wins
# over any smaller CONFIG_HEAP_MEM_POOL_SIZE, so this board's images get
# about 55 KB of system heap whatever is written here (the exact sum of the
# drivers' minimums varies a little with the options built).

# --- IP stack ---
CONFIG_NET_L2_ETHERNET=y
CONFIG_NET_IPV4=y
CONFIG_NET_IPV6=n
CONFIG_NET_UDP=y
CONFIG_NET_TCP=y
CONFIG_NET_DHCPV4=y

# --- mDNS / DNS-SD advertisement ---
CONFIG_NET_HOSTNAME_ENABLE=y
CONFIG_NET_HOSTNAME="tedge-opcua"
CONFIG_NET_HOSTNAME_UNIQUE=y
CONFIG_MDNS_RESPONDER=y
CONFIG_DNS_SD=y

# Socket / connection headroom, sized with margin so a burst of client
# (re)connections cannot exhaust contexts/file descriptors (which would wedge
# the event loop). Matches the WROOM tuning that survives the churn stress.
CONFIG_NET_MAX_CONTEXTS=12
CONFIG_NET_MAX_CONN=10
CONFIG_ZVFS_OPEN_MAX=16
CONFIG_NET_TCP_TIME_WAIT_DELAY=250

# --- Net buffer pools (deep enough that connection bursts don't starve the
#     Wi-Fi driver of RX buffers) ---
CONFIG_NET_PKT_RX_COUNT=10
CONFIG_NET_PKT_TX_COUNT=10
CONFIG_NET_BUF_RX_COUNT=40
CONFIG_NET_BUF_TX_COUNT=32

# --- Thread stacks (measured with the thread analyzer on an ESP32-CAM) ---
# The system workqueue peaks at ~770 B of its 1 KB default; an overflow
# silently corrupts memory and stalls the firmware. (The connectivity work that
# overflowed it now runs on its own queue: CONFIG_APP_NET_WORKQ_STACK_SIZE. The
# log thread's stack is raised in lib/common/Kconfig, because the option only
# exists with deferred logging.)
CONFIG_SYSTEM_WORKQUEUE_STACK_SIZE=2048

# --- Socket service poll set ---
# The socket service thread (mDNS responder, DNS-SD) polls 4 sockets here. With
# the default of 3 it logs "Please increase CONFIG_ZVFS_POLL_MAX" and never
# starts, so the device stops answering mDNS.
CONFIG_ZVFS_POLL_MAX=6
# Once it runs, the service thread (mDNS responder) peaks at ~1.4 KB: 16 bytes
# short of its 1408-byte default. Give it headroom.
CONFIG_NET_SOCKETS_SERVICE_STACK_SIZE=2400
```

## boards/esp32s3_devkitc_esp32s3_procpu.conf
```kconfig
# SPDX-License-Identifier: Apache-2.0
#
# ESP32-S3-DevKitC-1 (Espressif reference board; dual-core Xtensa LX7, 512 KB
# SRAM). The board in hand is an N16R8: 16 MB flash and 8 MB octal PSRAM,
# though the board devicetree assumes an N8 and no PSRAM is enabled here.
# Build target: esp32s3_devkitc/esp32s3/procpu.
#
# Mirrors the Adafruit QT Py ESP32-S3 config, which is verified on hardware and
# is near-identical silicon. Two deliberate differences from that port:
#   * No &wifi overlay. This board devicetree already sets the Wi-Fi node to
#     "okay", so CONFIG_WIFI_ESP32 can be selected directly.
#   * The console stays on uart0, the board's own choice, which comes out on the
#     board's UART port. That port's bridge wires DTR/RTS to EN/BOOT, so esptool
#     resets it into download mode by itself — flashing needs no button press and
#     boot output is not lost to a USB re-enumeration. The sibling .overlay only
#     corrects the declared flash size (this board is an N16R8, not the N8 the
#     board devicetree assumes).
#
# No status LED: the board carries a WS2812 addressable RGB LED, not the plain
# GPIO led0 alias that lib/common/status_led.c drives, so the indicator is a
# no-op here (see the "No LED present" scenario in the wifi-connectivity spec).
# Connectivity state is read from the console log.

# --- Wi-Fi driver ---
CONFIG_WIFI=y
CONFIG_WIFI_ESP32=y
CONFIG_APP_WIFI=y

CONFIG_NET_MGMT=y
CONFIG_NET_MGMT_EVENT=y
CONFIG_NET_MGMT_EVENT_INFO=y
CONFIG_NET_CONNECTION_MANAGER=y

# open62541 uses the libc malloc arena (sized "all remaining RAM"): what
# the system heap takes is gone from that arena.
# The system heap is not set: the Wi-Fi driver's minimum (51,200 B) wins
# over any smaller CONFIG_HEAP_MEM_POOL_SIZE, so this board's images get
# about 55 KB of system heap whatever is written here (the exact sum of the
# drivers' minimums varies a little with the options built).

# --- IP stack ---
CONFIG_NET_L2_ETHERNET=y
CONFIG_NET_IPV4=y
CONFIG_NET_IPV6=n
CONFIG_NET_UDP=y
CONFIG_NET_TCP=y
CONFIG_NET_DHCPV4=y

# --- mDNS / DNS-SD advertisement ---
CONFIG_NET_HOSTNAME_ENABLE=y
CONFIG_NET_HOSTNAME="tedge-opcua"
CONFIG_NET_HOSTNAME_UNIQUE=y
CONFIG_MDNS_RESPONDER=y
CONFIG_DNS_SD=y

# Socket / connection headroom, sized with margin so a burst of client
# (re)connections cannot exhaust contexts/file descriptors (which would wedge
# the event loop). Matches the WROOM tuning that survives the churn stress.
CONFIG_NET_MAX_CONTEXTS=12
CONFIG_NET_MAX_CONN=10
CONFIG_ZVFS_OPEN_MAX=16
CONFIG_NET_TCP_TIME_WAIT_DELAY=250

# --- Net buffer pools (deep enough that connection bursts don't starve the
#     Wi-Fi driver of RX buffers) ---
CONFIG_NET_PKT_RX_COUNT=10
CONFIG_NET_PKT_TX_COUNT=10
CONFIG_NET_BUF_RX_COUNT=40
CONFIG_NET_BUF_TX_COUNT=32

# --- Thread stacks (measured with the thread analyzer on an ESP32-CAM) ---
# The system workqueue peaks at ~770 B of its 1 KB default; an overflow
# silently corrupts memory and stalls the firmware. (The connectivity work that
# overflowed it now runs on its own queue: CONFIG_APP_NET_WORKQ_STACK_SIZE. The
# log thread's stack is raised in lib/common/Kconfig, because the option only
# exists with deferred logging.)
CONFIG_SYSTEM_WORKQUEUE_STACK_SIZE=2048

# --- Socket service poll set ---
# The socket service thread (mDNS responder, DNS-SD) polls 4 sockets here. With
# the default of 3 it logs "Please increase CONFIG_ZVFS_POLL_MAX" and never
# starts, so the device stops answering mDNS.
CONFIG_ZVFS_POLL_MAX=6
# Once it runs, the service thread (mDNS responder) peaks at ~1.4 KB: 16 bytes
# short of its 1408-byte default. Give it headroom.
CONFIG_NET_SOCKETS_SERVICE_STACK_SIZE=2400
```

## boards/native_sim_native_64.conf
```kconfig
# SPDX-License-Identifier: Apache-2.0
#
# native_sim networking via NSOS (Native Simulator Offloaded Sockets): Zephyr
# BSD socket calls are routed straight to the host OS. A real OPC-UA client on
# the host/container can then connect to the server's port without setting up a
# zeth TAP interface (no root/CAP_NET_ADMIN needed) — ideal for automated tests.
#
# Note: the Zephyr-native IP stack, DHCP and mDNS responder are bypassed in this
# mode, so those features are validated on hardware, not here.
CONFIG_ETH_NATIVE_TAP=n
CONFIG_NET_DRIVERS=y
CONFIG_NET_SOCKETS=y
CONFIG_NET_SOCKETS_OFFLOAD=y
CONFIG_NET_NATIVE_OFFLOADED_SOCKETS=y
CONFIG_NET_IPV6_DAD=n

# open62541 allocates via libc malloc; the default 16 KB arena is far too small
# for the OPC-UA stack. The host has ample RAM, so give native_sim a large arena.
CONFIG_COMMON_LIBC_MALLOC_ARENA_SIZE=4194304
# The system heap the simulator build always had (it used to come from
# prj.conf, where it was a no-op on the ESP32 boards).
CONFIG_HEAP_MEM_POOL_SIZE=131072
```

## boards/adafruit_qt_py_esp32s3_esp32s3_procpu.overlay
```dts
/* SPDX-License-Identifier: Apache-2.0
 *
 * Adafruit QT Py ESP32-S3: the Wi-Fi node is disabled by default in the S3 SoC
 * devicetree, so enable it for station-mode connectivity.
 */
&wifi {
	status = "okay";
};

/* Flash size and layout: the board devicetree assumes an N8 (8 MB); the QT Py
 * in hand is an N4R2 (4 MB). The shared layout declares the 4 MB and the
 * MCUboot + Wi-Fi provisioner partitions (see the ESP32-C6 overlay for how a
 * plain build uses them).
 */
#include "../../../lib/common/dts/layout-esp32s3-4M.dtsi"
```

## src/main.c
```c
/* SPDX-License-Identifier: Apache-2.0
 *
 * OPC-UA server firmware entry point.
 *
 * Boot sequence:
 *   1. Bring up connectivity (Wi-Fi station on hardware; host networking on
 *      native_sim) and wait until the network is usable.
 *   2. Start the OPC-UA server (when CONFIG_APP_OPCUA_SERVER is enabled).
 */

#include <zephyr/kernel.h>
#include <zephyr/logging/log.h>

#include "net.h"
#include "prov_tedge.h"
#include "display.h"

#if defined(CONFIG_APP_OPCUA_SERVER)
#include "opcua_server.h"
#if defined(CONFIG_TEDGE)
#include "tedge_glue.h"
#endif
#endif

LOG_MODULE_REGISTER(main, CONFIG_LOG_DEFAULT_LEVEL);

int main(void)
{
	int ret;

	LOG_INF("OPC-UA server firmware starting: device \"%s\"",
		CONFIG_APP_DEVICE_NAME);

	display_status_init();
	display_status_stage(DISPLAY_STAGE_WIFI_CONNECTING);

	ret = app_net_init();
	if (ret) {
		LOG_ERR("Connectivity init failed (%d)", ret);
		display_status_stage(DISPLAY_STAGE_ERROR);
		return 0;
	}

	/* No Wi-Fi network yet: the client starts first (tedge-onboard gives
	 * the device one), and the rest waits for the network. */
	bool onboarding = app_prov_tedge_start_unprovisioned(tedge_glue_start);

	LOG_INF("Waiting for network...");
	ret = app_net_wait_connected(onboarding ? K_FOREVER : K_SECONDS(60));
	if (ret) {
		LOG_ERR("Network did not come up in time (%d)", ret);
		display_status_stage(DISPLAY_STAGE_ERROR);
		return 0;
	}

#if defined(CONFIG_APP_OPCUA_SERVER)
	ret = opcua_server_start();
	if (ret) {
		LOG_ERR("Failed to start OPC-UA server (%d)", ret);
		display_status_stage(DISPLAY_STAGE_ERROR);
		return 0;
	}
	LOG_INF("OPC-UA server running on port %d", CONFIG_APP_OPCUA_PORT);
#else
	LOG_INF("OPC-UA server disabled (CONFIG_APP_OPCUA_SERVER=n) — "
		"connectivity skeleton only");
#endif

#if defined(CONFIG_TEDGE)
	/* Device management runs alongside the protocol server. */
	if (onboarding || tedge_glue_start() == 0) {
#if defined(CONFIG_TEDGE_TELEMETRY)
		tedge_glue_start_telemetry();
#endif
	}
#endif

	return 0;
}
```

## src/tedge_glue.c
```c
/* SPDX-License-Identifier: Apache-2.0
 *
 * The glue between this application and the tiny-edge client. It lives
 * here, not in the module: the module knows nothing about lib/common.
 *
 * The OPC-UA server serves its address space to whoever browses it; the
 * client gives the same device a way to be managed from Cumulocity —
 * onboarded, restarted, updated, and adjusted through its parameter set —
 * without either knowing about the other.
 *
 * Note that the WROOM-32 boards this application usually runs on cannot
 * carry much of the client beside it; see DEVICES.md.
 */

#include "tedge_glue.h"

#include "boot_request.h"
#include "data_source.h"
#include "identity.h"
#include "opcua_server.h"
#if defined(CONFIG_APP_WIFI_CRED_STORE)
#include "prov_c8y.h"
#include "prov_tedge.h"
#endif
#include "status_led.h"

#include <zephyr/kernel.h>
#include <zephyr/logging/log.h>

#include <tedge/tedge.h>

#include <stdio.h>
#include <string.h>

LOG_MODULE_REGISTER(tedge_glue, CONFIG_LOG_DEFAULT_LEVEL);

static void on_state(enum tedge_state state, void *user_data)
{
	ARG_UNUSED(user_data);

	switch (state) {
	case TEDGE_STATE_AWAITING_REGISTRATION: {
		char url[220];

		/* The operator registers the device from this URL. It carries
		 * the one-time password, so the module never logs it itself. */
		if (tedge_registration_url(url, sizeof(url)) > 0) {
			LOG_INF("register this device: %s", url);
		}
		status_led_set_mode(STATUS_LED_PROVISIONING);
		break;
	}
	case TEDGE_STATE_CONNECTED:
		status_led_set_mode(STATUS_LED_CONNECTED);
		break;
	default:
		break;
	}
}

/* An OPC-UA client reconnects and re-subscribes after a restart, so a
 * restart costs a gap in the data at worst; nothing here needs to veto it. */
static int restart_request(char *reason, size_t reason_len, void *user_data)
{
	ARG_UNUSED(reason);
	ARG_UNUSED(reason_len);
	ARG_UNUSED(user_data);
	LOG_INF("restart requested from the cloud");
	return 0;
}

static void reset(void *user_data)
{
	ARG_UNUSED(user_data);
	boot_request_reboot();
}

#if defined(CONFIG_TEDGE_FIRMWARE_UPDATE)
/* An update is only kept if this image can do its job. The OPC-UA server
 * starts on its own thread, so the device connects to the cloud even when
 * open62541 could not start (out of memory, say): refusing here leaves the
 * image unconfirmed and the bootloader restores the previous one. */
static int firmware_confirm_check(void *user_data)
{
	ARG_UNUSED(user_data);
	if (opcua_server_failed()) {
		LOG_ERR("the OPC-UA server did not start; refusing this firmware");
		return -EIO;
	}
	return 0;
}
#endif

static const struct tedge_hooks hooks = {
	.on_state = on_state,
	.restart_request = restart_request,
	.reset = reset,
#if defined(CONFIG_TEDGE_FIRMWARE_UPDATE)
	.firmware_confirm_check = firmware_confirm_check,
#endif
};

#if defined(CONFIG_TEDGE_PARAMETERS) && defined(CONFIG_TEDGE_TELEMETRY)
/* What an operator may change on an OPC-UA device from the cloud. The
 * client's own "tiny_edge" set is declared beside this one and covers how much
 * it logs, how often it reports its health and whether tunnels are allowed.
 */
#define SERVER_SET "zephyr_opcua_telemetry"

static const struct tedge_parameter server_params[] = {
	TEDGE_PARAM_INT("interval_s", CONFIG_APP_TEDGE_MEASUREMENT_INTERVAL_S,
			5, 3600, "Seconds between measurements"),
	TEDGE_PARAM_BOOL("telemetry", true,
			 "Publish measurements to the cloud"),
};

static int32_t param_interval_s(void)
{
	int32_t seconds;

	if (tedge_parameter_get_int(SERVER_SET, "interval_s", &seconds) == 0) {
		return seconds;
	}
	return CONFIG_APP_TEDGE_MEASUREMENT_INTERVAL_S;
}

static bool param_telemetry_on(void)
{
	bool on;

	if (tedge_parameter_get_bool(SERVER_SET, "telemetry", &on) == 0) {
		return on;
	}
	return true;
}
#endif /* CONFIG_TEDGE_PARAMETERS && CONFIG_TEDGE_TELEMETRY */

int tedge_glue_start(void)
{
	struct tedge_identity id = {
		.external_id = app_identity_device_id(),
		.name = app_identity_device_id(),
		.type = "thin-edge.io-zephyr-opcua",
		.firmware_name = app_identity_firmware_name(),
		.firmware_version = app_identity_firmware_version(),
	};
	int rc = tedge_init(&id, &hooks);

	if (rc != 0) {
		LOG_ERR("tedge_init failed (%d)", rc);
		return rc;
	}
#if defined(CONFIG_APP_TEDGE_PROVISIONING)
	(void)app_prov_tedge_init();
#endif
#if defined(CONFIG_APP_WIFI_CRED_STORE)
	/* Tenant and one-time password from the ZTP provisioner, if it left
	 * any. The external ID already came through app_identity_device_id(). */
	(void)prov_c8y_handoff();
#endif
#if defined(CONFIG_TEDGE_PARAMETERS) && defined(CONFIG_TEDGE_TELEMETRY)
	/* Before tedge_start(): the client loads the stored values over the
	 * declared defaults and reports the set as soon as it connects. */
	rc = tedge_declare_parameters(SERVER_SET, server_params,
				      ARRAY_SIZE(server_params), NULL, NULL);
	if (rc != 0) {
		LOG_WRN("could not declare the '%s' parameters (%d)",
			SERVER_SET, rc);
	}
#endif
	rc = tedge_start();
	if (rc != 0) {
		LOG_ERR("tedge_start failed (%d)", rc);
	}
	return rc;
}

#if defined(CONFIG_TEDGE_TELEMETRY)
/* The same values the OPC-UA address space exposes, sent to Cumulocity once
 * per interval so an operator without an OPC-UA client can still see them. */
static void telemetry_fn(struct k_work *work)
{
	struct tedge_measurement_value values[8];
	size_t count = MIN(data_source_count(), ARRAY_SIZE(values));
	int32_t interval = CONFIG_APP_TEDGE_MEASUREMENT_INTERVAL_S;
	bool on = true;

#if defined(CONFIG_TEDGE_PARAMETERS)
	interval = param_interval_s();
	on = param_telemetry_on();
#endif
	for (size_t i = 0; i < count; i++) {
		const struct data_measurement *d = data_source_descriptor(i);

		values[i].series = d->name;
		values[i].unit = d->unit;
		values[i].value = data_source_sample(i);
	}
	if (on && count > 0) {
		(void)tedge_publish_measurement(
			CONFIG_APP_TEDGE_MEASUREMENT_TYPE, values, count, 0);
	}
	(void)k_work_reschedule(k_work_delayable_from_work(work),
				K_SECONDS(interval));
}

static K_WORK_DELAYABLE_DEFINE(telemetry_work, telemetry_fn);

void tedge_glue_start_telemetry(void)
{
	(void)k_work_schedule(&telemetry_work,
			      K_SECONDS(CONFIG_APP_TEDGE_MEASUREMENT_INTERVAL_S));
}
#endif /* CONFIG_TEDGE_TELEMETRY */
```

## src/tedge_glue.h
```c
/* SPDX-License-Identifier: Apache-2.0 */
#ifndef TEDGE_GLUE_H_
#define TEDGE_GLUE_H_

/** Start the thin-edge.io client with this application's identity and hooks. */
int tedge_glue_start(void);

#if defined(CONFIG_TEDGE_TELEMETRY)
/** Begin publishing the server's measurements. Call after the client. */
void tedge_glue_start_telemetry(void);
#endif

#endif /* TEDGE_GLUE_H_ */
```
