## CMakeLists.txt
```
# SPDX-License-Identifier: Apache-2.0
#
# Modbus TCP server firmware: composes the shared core (lib/common, pump
# simulation) with the Modbus TCP frontend (lib/modbus). Build with:
#   west build -b <board> apps/modbus-server
cmake_minimum_required(VERSION 3.20.0)

list(APPEND ZEPHYR_EXTRA_MODULES
  ${CMAKE_CURRENT_SOURCE_DIR}/../../lib/common
  ${CMAKE_CURRENT_SOURCE_DIR}/../../lib/modbus
)
# thin-edge.io device management (tiny-edge, off unless CONFIG_TEDGE=y) is a
# west project, so west adds it as a module; see west.yml.

find_package(Zephyr REQUIRED HINTS $ENV{ZEPHYR_BASE})
project(modbus_server_firmware C)

target_sources(app PRIVATE src/main.c)
# The glue to the device-management client lives in the application, never in
# the module.
target_sources_ifdef(CONFIG_TEDGE app PRIVATE src/tedge_glue.c)
```

## Kconfig
```
# SPDX-License-Identifier: Apache-2.0
#
# Modbus TCP server application. Shared options come from the lib/common module
# and Modbus options from the lib/modbus module (both auto-sourced as Zephyr
# modules via Kconfig.zephyr below).

mainmenu "Modbus TCP Server Firmware"

config APP_TEDGE_MEASUREMENT_TYPE
	string "Measurement type published to the cloud"
	depends on TEDGE_TELEMETRY
	default "pump"

config APP_TEDGE_MEASUREMENT_INTERVAL_S
	int "Seconds between measurements"
	depends on TEDGE_TELEMETRY
	default 30

config APP_TEDGE_TEST_REFUSE_FIRMWARE
	bool "Test build: refuse to confirm a new firmware image"
	depends on TEDGE_FIRMWARE_UPDATE
	help
	  Makes the application's firmware-check hook always refuse, so a
	  newly installed image is never confirmed and the bootloader rolls
	  it back. For testing the rollback path only.

config APP_TEDGE_TEST_FAULT_COMMAND
	bool "Test build: a shell command that crashes the device"
	depends on SHELL
	help
	  Adds "tedge crash", which dereferences a null pointer so the
	  coredump path can be tested end to end. For testing only.

source "Kconfig.zephyr"
```

## prj.conf
```kconfig
# SPDX-License-Identifier: Apache-2.0
#
# Board-agnostic application configuration. Wi-Fi/stack specifics live in
# boards/<board>.conf; secrets in a git-ignored overlay at the repo root.

# --- Firmware identity + simulation selection ---
CONFIG_APP_FIRMWARE_NAME="zephyr-modbus-server"
CONFIG_APP_SIM_PUMP=y

# --- Control ranges/defaults for the pump ---
# speed_setpoint reuses the generic Setpoint control, constrained to 0..100 %.
CONFIG_APP_SETPOINT_MIN=0
CONFIG_APP_SETPOINT_MAX=100
CONFIG_APP_SETPOINT_DEFAULT=0
# Default operating mode = auto (1), so turning Running on spins the pump.
CONFIG_APP_MODE_DEFAULT=1

# --- Modbus ---
CONFIG_MODBUS_ROLE_SERVER=y
CONFIG_MODBUS_NUMOF_RAW_ADU=1

# --- DNS-SD: advertise as a Modbus service on 502 (not OPC-UA) ---
CONFIG_APP_DNSSD_SERVICE_TYPE="_modbus"
CONFIG_APP_DNSSD_PORT=502

# --- Logging ---
CONFIG_LOG=y
CONFIG_LOG_DEFAULT_LEVEL=3

# --- Runtime / memory ---
# main() starts the network, the protocol server and the client, then
# returns; nothing runs on its stack afterwards (the agent measured 1.2 KB
# at 4 KB). Confirm with the thread analyzer (wroom-stackinfo.local.conf)
# when the release workloads change.
CONFIG_MAIN_STACK_SIZE=4096
# The system heap (CONFIG_HEAP_MEM_POOL_SIZE) is not set: on every ESP32
# board the Wi-Fi driver's minimum (51,200 B) wins over any smaller value,
# so the image gets about 55 KB whatever is written here. See the board
# settings files for the size each board resolves to.
# No CONFIG_POSIX_API: the code uses Zephyr's native zsock_* socket API, so
# the POSIX layer's thread, signal, timer and fd pools stay out of the image.

# --- Networking (BSD sockets API; stack specifics per board) ---
CONFIG_NETWORKING=y
CONFIG_NET_SOCKETS=y
CONFIG_NET_LOG=y
```

## boards/adafruit_feather_esp32s2_tft_esp32s2.conf
```kconfig
# SPDX-License-Identifier: Apache-2.0
#
# Adafruit Feather ESP32-S2 TFT for the Modbus TCP server: single-core Xtensa
# LX7 Wi-Fi with 2 MB PSRAM and a built-in TFT. Build target:
# adafruit_feather_esp32s2_tft/esp32s2.
#
# NOTE: the S2 Feather locks up under this Zephyr (see the project's ESP32-S2
# Wi-Fi note); prefer the ESP32-WROOM or the QT Py ESP32-S3 for real work.

# --- Wi-Fi driver ---
CONFIG_WIFI=y
CONFIG_WIFI_ESP32=y
CONFIG_APP_WIFI=y

CONFIG_NET_MGMT=y
CONFIG_NET_MGMT_EVENT=y
CONFIG_NET_MGMT_EVENT_INFO=y
CONFIG_NET_CONNECTION_MANAGER=y

# The system heap is not set: the Wi-Fi driver's minimum (51,200 B) wins
# over any smaller CONFIG_HEAP_MEM_POOL_SIZE, so this board's images get
# about 55 KB of system heap whatever is written here (the exact sum of the
# drivers' minimums varies a little with the options built).

# --- IP stack ---
CONFIG_NET_L2_ETHERNET=y
CONFIG_NET_IPV4=y
CONFIG_NET_IPV6=n
CONFIG_NET_UDP=y
CONFIG_NET_TCP=y
CONFIG_NET_DHCPV4=y

# --- mDNS / DNS-SD advertisement (service type/port set in prj.conf: _modbus/502) ---
CONFIG_NET_HOSTNAME_ENABLE=y
CONFIG_NET_HOSTNAME="tedge-modbus"
CONFIG_NET_HOSTNAME_UNIQUE=y
CONFIG_MDNS_RESPONDER=y
CONFIG_DNS_SD=y

# --- Built-in TFT status display (ST7789 over MIPI-DBI SPI) ---
CONFIG_APP_DISPLAY_STATUS=y
CONFIG_DISPLAY=y
CONFIG_MIPI_DBI=y
CONFIG_ST7789V=y
CONFIG_ST7789V_RGB565=y
CONFIG_SPI=y
CONFIG_GPIO=y
CONFIG_POWER_DOMAIN=y

# --- Socket / net buffer budget (single Modbus client; keep some headroom) ---
CONFIG_NET_MAX_CONTEXTS=8
CONFIG_NET_MAX_CONN=6
CONFIG_ZVFS_OPEN_MAX=12
CONFIG_NET_TCP_TIME_WAIT_DELAY=250
CONFIG_NET_PKT_RX_COUNT=8
CONFIG_NET_PKT_TX_COUNT=8
# The RX pool bottomed out at 4 free of 24 over a 10 h soak (0 free in an
# earlier one), the tightest resource on these builds. 32 keeps a margin; the
# OPC-UA firmware, which carries more traffic, uses 40.
CONFIG_NET_BUF_RX_COUNT=32
CONFIG_NET_BUF_TX_COUNT=24

# --- Thread stacks ---
# The system workqueue overflows its 1 KB default on ESP32 Wi-Fi builds, which
# silently corrupts memory and stalls the firmware.
CONFIG_SYSTEM_WORKQUEUE_STACK_SIZE=2048

# --- Socket service poll set ---
# The socket service thread (mDNS responder, DNS-SD) polls 4 sockets; with the
# default of 3 it never starts. It peaks just above its 1408-byte default stack.
CONFIG_ZVFS_POLL_MAX=6
CONFIG_NET_SOCKETS_SERVICE_STACK_SIZE=2400
```

## boards/adafruit_qt_py_esp32s3_esp32s3_procpu.conf
```kconfig
# SPDX-License-Identifier: Apache-2.0
#
# Adafruit QT Py ESP32-S3 for the Modbus TCP server. Wi-Fi station + native IP
# stack + mDNS/DNS-SD. The &wifi node is enabled via the sibling .overlay.

# --- Wi-Fi driver ---
CONFIG_WIFI=y
CONFIG_WIFI_ESP32=y
CONFIG_APP_WIFI=y

CONFIG_NET_MGMT=y
CONFIG_NET_MGMT_EVENT=y
CONFIG_NET_MGMT_EVENT_INFO=y
CONFIG_NET_CONNECTION_MANAGER=y

# The system heap is not set: the Wi-Fi driver's minimum (51,200 B) wins
# over any smaller CONFIG_HEAP_MEM_POOL_SIZE, so this board's images get
# about 55 KB of system heap whatever is written here (the exact sum of the
# drivers' minimums varies a little with the options built).

# --- IP stack ---
CONFIG_NET_L2_ETHERNET=y
CONFIG_NET_IPV4=y
CONFIG_NET_IPV6=n
CONFIG_NET_UDP=y
CONFIG_NET_TCP=y
CONFIG_NET_DHCPV4=y

# --- mDNS / DNS-SD advertisement (service type/port set in prj.conf: _modbus/502) ---
CONFIG_NET_HOSTNAME_ENABLE=y
CONFIG_NET_HOSTNAME="tedge-modbus"
CONFIG_NET_HOSTNAME_UNIQUE=y
CONFIG_MDNS_RESPONDER=y
CONFIG_DNS_SD=y

# --- Socket / net buffer budget (single Modbus client; keep some headroom) ---
CONFIG_NET_MAX_CONTEXTS=8
CONFIG_NET_MAX_CONN=6
CONFIG_ZVFS_OPEN_MAX=12
CONFIG_NET_TCP_TIME_WAIT_DELAY=250
CONFIG_NET_PKT_RX_COUNT=8
CONFIG_NET_PKT_TX_COUNT=8
# The RX pool bottomed out at 4 free of 24 over a 10 h soak (0 free in an
# earlier one), the tightest resource on these builds. 32 keeps a margin; the
# OPC-UA firmware, which carries more traffic, uses 40.
CONFIG_NET_BUF_RX_COUNT=32
CONFIG_NET_BUF_TX_COUNT=24

# --- Thread stacks (measured with the thread analyzer on an ESP32-CAM) ---
# The system workqueue peaks at ~770 B of its 1 KB default; an overflow
# silently corrupts memory and stalls the firmware. (The connectivity work that
# overflowed it now runs on its own queue: CONFIG_APP_NET_WORKQ_STACK_SIZE. The
# log thread's stack is raised in lib/common/Kconfig, because the option only
# exists with deferred logging.)
CONFIG_SYSTEM_WORKQUEUE_STACK_SIZE=2048

# --- Socket service poll set ---
# The socket service thread (mDNS responder, DNS-SD) polls 4 sockets here. With
# the default of 3 it logs "Please increase CONFIG_ZVFS_POLL_MAX" and never
# starts, so the device stops answering mDNS.
CONFIG_ZVFS_POLL_MAX=6
# Once it runs, the service thread (mDNS responder) peaks at ~1.4 KB: 16 bytes
# short of its 1408-byte default. Give it headroom.
CONFIG_NET_SOCKETS_SERVICE_STACK_SIZE=2400
```

## boards/adafruit_qt_py_esp32s3_esp32s3_procpu_tedge.conf
```kconfig
# SPDX-License-Identifier: Apache-2.0
#
# The Modbus QT Py ESP32-S3 build with thin-edge.io device management. Use on top of the
# board's own configuration:
#   west build --sysbuild -b adafruit_qt_py_esp32s3/esp32s3/procpu apps/modbus-server \
#     -- -DEXTRA_CONF_FILE="<this file>;<tenant>.conf"
#
# The tenant host belongs in a git-ignored overlay (CONFIG_TEDGE_C8Y_URL).

CONFIG_TEDGE=y
CONFIG_TEDGE_TRANSPORT_C8Y=y
CONFIG_TEDGE_C8Y_MQTT_SERVICE=y
CONFIG_TEDGE_AUTH_C8Y_CA=y
CONFIG_TEDGE_RESTART=y

# --- What the application provides for the client (tedge-zephyr/README.md) ---
CONFIG_MBEDTLS=y
CONFIG_MBEDTLS_ENABLE_HEAP=y
CONFIG_MBEDTLS_HEAP_SIZE=98304
CONFIG_MBEDTLS_SSL_MAX_CONTENT_LEN=16384
CONFIG_MBEDTLS_SSL_PROTO_TLS1_2=y
CONFIG_MBEDTLS_CIPHERSUITE_TLS_ECDHE_RSA_WITH_AES_128_GCM_SHA256=y
CONFIG_MBEDTLS_CIPHERSUITE_TLS_ECDHE_ECDSA_WITH_AES_128_GCM_SHA256=y
CONFIG_PSA_WANT_ECC_SECP_R1_256=y
CONFIG_MBEDTLS_SSL_SERVER_NAME_INDICATION=y
CONFIG_MBEDTLS_HAVE_TIME_DATE=y
CONFIG_MBEDTLS_PEM_PARSE_C=y
CONFIG_MBEDTLS_X509_CRT_PARSE_C=y

# The device key lives in PSA ITS, stored through the settings backend.
CONFIG_SECURE_STORAGE_ITS_STORE_IMPLEMENTATION_SETTINGS=y

# --- The TLS heap goes in the board's quad PSRAM ---
# The N4R2 module has 2 MB of quad PSRAM where the DevKitC has 8 MB octal.
# Without this the 96 KB mbedTLS heap stays in internal DRAM and the image
# links at 99.8% of it, with 764 bytes to spare. Moving it frees 95,968 B
# and brings the board to 75.8%.
#
# SPIRAM_TYPE_* alone is not enough: it leaves CONFIG_ESP_SPIRAM_SIZE at 0,
# the ext_dram region is empty and the link fails with "External SPIRAM
# overflowed". The size has to be stated.
CONFIG_ESP_SPIRAM=y
CONFIG_SPIRAM_MODE_QUAD=y
CONFIG_SPIRAM_TYPE_ESPPSRAM16=y
CONFIG_ESP_SPIRAM_SIZE=2097152
CONFIG_MBEDTLS_HEAP_CUSTOM_SECTION=y

# One TLS context for MQTT, plus one per remote-access session.
CONFIG_NET_SOCKETS_TLS_MAX_CONTEXTS=2

# A closed TLS connection holds its TCP context for a moment, so the client
# needs headroom over what Modbus uses.
CONFIG_NET_MAX_CONN=10
CONFIG_NET_MAX_CONTEXTS=12
CONFIG_ZVFS_OPEN_MAX=14

# --- What a remote-access tunnel needs beside MQTT ---
# The Wi-Fi driver's receive path runs out of net_bufs under an interactive
# session long before it runs out of bandwidth, and websocket_send_msg()
# k_mallocs a masking buffer per frame. Sized as on the C6, which was
# verified against a real htop session. See
# tedge-zephyr/docs/debugging-against-real-devices.md.
CONFIG_HEAP_MEM_POOL_SIZE=40960
CONFIG_NET_BUF_DATA_SIZE=256
CONFIG_NET_PKT_RX_COUNT=16
CONFIG_NET_PKT_TX_COUNT=16
CONFIG_NET_BUF_RX_COUNT=96
CONFIG_NET_BUF_TX_COUNT=64
```

## boards/esp32_devkitc_esp32_procpu.conf
```kconfig
# SPDX-License-Identifier: Apache-2.0
#
# ESP32-WROOM-32 for the Modbus TCP server. Wi-Fi station + native IP stack +
# mDNS/DNS-SD. Modbus is far lighter than open62541, so net pools are modest.

# Allow older ESP32 silicon (WROOM-32 rev v1.0) to boot.
CONFIG_ESP32_USE_UNSUPPORTED_REVISION=y

# --- Wi-Fi driver ---
CONFIG_WIFI=y
CONFIG_WIFI_ESP32=y
CONFIG_APP_WIFI=y

CONFIG_NET_MGMT=y
CONFIG_NET_MGMT_EVENT=y
CONFIG_NET_MGMT_EVENT_INFO=y
CONFIG_NET_CONNECTION_MANAGER=y

# The system heap is not set: the Wi-Fi driver's minimum (51,200 B) wins
# over any smaller CONFIG_HEAP_MEM_POOL_SIZE, so this board's images get
# about 55 KB of system heap whatever is written here (the exact sum of the
# drivers' minimums varies a little with the options built).

# --- IP stack ---
CONFIG_NET_L2_ETHERNET=y
CONFIG_NET_IPV4=y
CONFIG_NET_IPV6=n
CONFIG_NET_UDP=y
CONFIG_NET_TCP=y
CONFIG_NET_DHCPV4=y

# --- mDNS / DNS-SD advertisement (service type/port set in prj.conf: _modbus/502) ---
CONFIG_NET_HOSTNAME_ENABLE=y
CONFIG_NET_HOSTNAME="tedge-modbus"
CONFIG_NET_HOSTNAME_UNIQUE=y
CONFIG_MDNS_RESPONDER=y
CONFIG_DNS_SD=y

# --- Socket / net buffer budget (single Modbus client; keep some headroom) ---
CONFIG_NET_MAX_CONTEXTS=8
CONFIG_NET_MAX_CONN=6
CONFIG_ZVFS_OPEN_MAX=12
CONFIG_NET_TCP_TIME_WAIT_DELAY=250
CONFIG_NET_PKT_RX_COUNT=8
CONFIG_NET_PKT_TX_COUNT=8
# The RX pool bottomed out at 4 free of 24 over a 10 h soak (0 free in an
# earlier one), the tightest resource on these builds. 32 keeps a margin; the
# OPC-UA firmware, which carries more traffic, uses 40.
CONFIG_NET_BUF_RX_COUNT=32
CONFIG_NET_BUF_TX_COUNT=24

# --- Thread stacks (measured with the thread analyzer on an ESP32-CAM) ---
# The system workqueue peaks at ~770 B of its 1 KB default; an overflow
# silently corrupts memory and stalls the firmware. (The connectivity work that
# overflowed it now runs on its own queue: CONFIG_APP_NET_WORKQ_STACK_SIZE. The
# log thread's stack is raised in lib/common/Kconfig, because the option only
# exists with deferred logging.)
CONFIG_SYSTEM_WORKQUEUE_STACK_SIZE=2048

# --- Socket service poll set ---
# The socket service thread (mDNS responder, DNS-SD) polls 4 sockets here. With
# the default of 3 it logs "Please increase CONFIG_ZVFS_POLL_MAX" and never
# starts, so the device stops answering mDNS.
CONFIG_ZVFS_POLL_MAX=6
# Once it runs, the service thread (mDNS responder) peaks at ~1.4 KB: 16 bytes
# short of its 1408-byte default. Give it headroom.
CONFIG_NET_SOCKETS_SERVICE_STACK_SIZE=2400

# --- .noinit in DRAM region 1 (SRAM1), also under MCUboot ---
# Simple boot puts .noinit (thread stacks, net buffers; ~68 KB here) in the
# SRAM1 region a second-stage bootloader would use. Zephyr turns that off for
# MCUboot builds, which moves it into region 0 and takes it out of the libc
# heap (70 KB → 3 KB for OPC-UA). .noinit is never loaded, so MCUboot is done
# with that RAM by the time the application uses it.
CONFIG_ESP32_REGION_1_NOINIT=y
```

## boards/esp32c6_devkitc_esp32c6_hpcore.conf
```kconfig
# SPDX-License-Identifier: Apache-2.0
#
# ESP32-C6 (QIQIAZI board carrying an ESP32-C6-WROOM-1-N4 module; single-core
# **RISC-V** + LP core, 160 MHz, ~512 KB HP SRAM, 4 MB flash, no PSRAM).
# Build target: esp32c6_devkitc/esp32c6/hpcore.
#
# *** This is the first RISC-V target in this repo, and the first Wi-Fi 6
# radio. *** Everything below is architecture-neutral and copied from the
# verified Xtensa ESP32-S3 ports: the net-buffer and stack figures were measured
# from workload behaviour (mDNS socket count, workqueue and log stack peaks
# under the protocol threads), not from SoC specifics, so they carry over. If a
# genuinely RISC-V-specific setting is ever needed, add it here under its own
# heading so the architecture split stays easy to find.
#
# The board is a clone, not an Espressif C6-DevKitC-1, so nothing here depends
# on board pinout — only on the on-die Wi-Fi and USB-Serial-JTAG peripherals.
#
# Two notes carried from the S3-DevKitC port:
#   * No &wifi overlay. The C6 board devicetree already sets the Wi-Fi node to
#     "okay", so CONFIG_WIFI_ESP32 can be selected directly.
#   * The sibling .overlay re-routes the console onto USB-Serial-JTAG and
#     corrects the declared flash size from the dtsi's 8 MB to the real 4 MB.
#
# No status LED: the board has a WS2812 addressable RGB LED, not the plain GPIO
# led0 alias lib/common/status_led.c drives, and the clone's LED pin is not
# documented upstream. The indicator is a no-op here (the "No LED present"
# scenario in the wifi-connectivity spec); read connectivity from the console.
#
# The C6 also carries IEEE 802.15.4 and BT LE radios, enabled in the board
# devicetree. Neither is used: no CONFIG_BT or CONFIG_IEEE802154 is set, so no
# driver is built and neither costs flash. This firmware is a Wi-Fi station.

# --- Wi-Fi driver ---
CONFIG_WIFI=y
CONFIG_WIFI_ESP32=y
CONFIG_APP_WIFI=y

CONFIG_NET_MGMT=y
CONFIG_NET_MGMT_EVENT=y
CONFIG_NET_MGMT_EVENT_INFO=y
CONFIG_NET_CONNECTION_MANAGER=y

# The system heap is not set: the Wi-Fi driver's minimum (51,200 B) wins
# over any smaller CONFIG_HEAP_MEM_POOL_SIZE, so this board's images get
# about 55 KB of system heap whatever is written here (the exact sum of the
# drivers' minimums varies a little with the options built).

# --- IP stack ---
CONFIG_NET_L2_ETHERNET=y
CONFIG_NET_IPV4=y
CONFIG_NET_IPV6=n
CONFIG_NET_UDP=y
CONFIG_NET_TCP=y
CONFIG_NET_DHCPV4=y

# --- mDNS / DNS-SD advertisement (service type/port set in prj.conf: _modbus/502) ---
CONFIG_NET_HOSTNAME_ENABLE=y
CONFIG_NET_HOSTNAME="tedge-modbus"
CONFIG_NET_HOSTNAME_UNIQUE=y
CONFIG_MDNS_RESPONDER=y
CONFIG_DNS_SD=y

# --- Socket / net buffer budget (single Modbus client; keep some headroom) ---
CONFIG_NET_MAX_CONTEXTS=8
CONFIG_NET_MAX_CONN=6
CONFIG_ZVFS_OPEN_MAX=12
CONFIG_NET_TCP_TIME_WAIT_DELAY=250
CONFIG_NET_PKT_RX_COUNT=8
CONFIG_NET_PKT_TX_COUNT=8
# The RX pool bottomed out at 4 free of 24 over a 10 h soak (0 free in an
# earlier one), the tightest resource on these builds. 32 keeps a margin; the
# OPC-UA firmware, which carries more traffic, uses 40.
CONFIG_NET_BUF_RX_COUNT=32
CONFIG_NET_BUF_TX_COUNT=24

# --- Thread stacks (measured with the thread analyzer on an ESP32-CAM) ---
# The system workqueue peaks at ~770 B of its 1 KB default; an overflow
# silently corrupts memory and stalls the firmware. (The connectivity work that
# overflowed it now runs on its own queue: CONFIG_APP_NET_WORKQ_STACK_SIZE. The
# log thread's stack is raised in lib/common/Kconfig, because the option only
# exists with deferred logging.)
CONFIG_SYSTEM_WORKQUEUE_STACK_SIZE=2048

# --- Socket service poll set ---
# The socket service thread (mDNS responder, DNS-SD) polls 4 sockets here. With
# the default of 3 it logs "Please increase CONFIG_ZVFS_POLL_MAX" and never
# starts, so the device stops answering mDNS.
CONFIG_ZVFS_POLL_MAX=6
# Once it runs, the service thread (mDNS responder) peaks at ~1.4 KB: 16 bytes
# short of its 1408-byte default. Give it headroom.
CONFIG_NET_SOCKETS_SERVICE_STACK_SIZE=2400
```

## boards/esp32c6_devkitc_esp32c6_hpcore_tedge.conf
```kconfig
# SPDX-License-Identifier: Apache-2.0
#
# The Modbus C6 build with thin-edge.io device management. Use on top of the
# board's own configuration:
#   west build --sysbuild -b esp32c6_devkitc/esp32c6/hpcore apps/modbus-server \
#     -- -DEXTRA_CONF_FILE="<this file>;<tenant>.conf"
#
# The tenant host belongs in a git-ignored overlay (CONFIG_TEDGE_C8Y_URL).

CONFIG_TEDGE=y
CONFIG_TEDGE_TRANSPORT_C8Y=y
CONFIG_TEDGE_C8Y_MQTT_SERVICE=y
CONFIG_TEDGE_AUTH_C8Y_CA=y
CONFIG_TEDGE_RESTART=y

# --- What the application provides for the client (tedge-zephyr/README.md) ---
CONFIG_MBEDTLS=y
CONFIG_MBEDTLS_ENABLE_HEAP=y
# One TLS session needs 52 KB at the handshake and holds 35 KB; every extra
# concurrent session (a remote-access tunnel, a download) needs another
# ~52 KB while it connects. 96 KB covers MQTT plus one tunnel.
CONFIG_MBEDTLS_HEAP_SIZE=98304
CONFIG_MBEDTLS_SSL_MAX_CONTENT_LEN=16384
CONFIG_MBEDTLS_SSL_PROTO_TLS1_2=y
CONFIG_MBEDTLS_CIPHERSUITE_TLS_ECDHE_RSA_WITH_AES_128_GCM_SHA256=y
CONFIG_MBEDTLS_CIPHERSUITE_TLS_ECDHE_ECDSA_WITH_AES_128_GCM_SHA256=y
CONFIG_PSA_WANT_ECC_SECP_R1_256=y
CONFIG_MBEDTLS_SSL_SERVER_NAME_INDICATION=y
CONFIG_MBEDTLS_HAVE_TIME_DATE=y
CONFIG_MBEDTLS_PEM_PARSE_C=y
CONFIG_MBEDTLS_X509_CRT_PARSE_C=y

# The device key lives in PSA ITS, stored through the settings backend.
CONFIG_SECURE_STORAGE_ITS_STORE_IMPLEMENTATION_SETTINGS=y

# One TLS context for MQTT, plus one per remote-access session.
CONFIG_NET_SOCKETS_TLS_MAX_CONTEXTS=2

# A closed TLS connection holds its TCP context for a moment, so the client
# needs headroom over what Modbus uses.
CONFIG_NET_MAX_CONN=10
CONFIG_NET_MAX_CONTEXTS=12
CONFIG_ZVFS_OPEN_MAX=14

# --- What a remote-access tunnel needs beside MQTT on a board with no PSRAM
#
# Verified against an interactive htop session over a tunnel (2026-09-20).
# Without these it renders one screen, freezes, and the device drops off the
# cloud and reconnects; the console shows the pool it ran out of. See
# tedge-zephyr/docs/debugging-against-real-devices.md.

# websocket_send_msg() k_mallocs a masking buffer for every frame it sends
# (masking is mandatory client->server), from the same kernel heap the Wi-Fi
# adapter uses. 16 KB covers MQTT alone; a tunnel exhausts it and the
# -ENOMEM surfaces as "sending to the cloud failed".
CONFIG_HEAP_MEM_POOL_SIZE=40960

# The Wi-Fi driver's RX path allocates a net_pkt per frame with a 100 ms
# deadline. At the default 128-byte net_buf a 1500-byte frame costs twelve
# of them, so 64 buffers is about five full-size packets in flight: one
# burst from a repainting terminal empties the pool ("esp32_wifi: Failed to
# allocate net buffer"), frames are dropped, TCP retransmits and the
# tunnel's TLS socket times out. This is burst depth, not bandwidth — the
# same image streams 1 MB happily. Sized for ~16 full packets.
CONFIG_NET_BUF_DATA_SIZE=256
CONFIG_NET_PKT_RX_COUNT=16
CONFIG_NET_PKT_TX_COUNT=16
CONFIG_NET_BUF_RX_COUNT=96
CONFIG_NET_BUF_TX_COUNT=64
```

## boards/adafruit_qt_py_esp32s3_esp32s3_procpu.overlay
```dts
/* SPDX-License-Identifier: Apache-2.0
 *
 * Adafruit QT Py ESP32-S3: the Wi-Fi node is disabled by default in the S3 SoC
 * devicetree, so enable it for station-mode connectivity.
 */
&wifi {
	status = "okay";
};
```

## boards/esp32_devkitc_esp32_procpu.overlay
```dts
/* SPDX-License-Identifier: Apache-2.0
 *
 * ESP32-WROOM-32: expose a status LED via the `led0` alias for the connectivity
 * indicator (lib/common/status_led.c). GPIO2 is the common on-board LED on
 * DevKitC-style boards; rewire here if your board differs.
 */
#include <zephyr/dt-bindings/gpio/gpio.h>

/ {
	aliases {
		led0 = &status_led;
	};

	leds {
		compatible = "gpio-leds";
		status_led: led_0 {
			gpios = <&gpio0 2 GPIO_ACTIVE_HIGH>;
			label = "Status LED";
		};
	};
};
```

## boards/esp32c6_devkitc_esp32c6_hpcore.overlay
```dts
/* SPDX-License-Identifier: Apache-2.0
 *
 * ESP32-C6 (QIQIAZI board, ESP32-C6-WROOM-1-N4 module) — console + flash size.
 *
 * 1. Console. The board devicetree chooses `uart0`, which is the separate UART
 *    port. This board is connected through its native USB-Serial-JTAG port, so
 *    enable that peripheral and re-choose the console onto it. Without this
 *    there is no console on the port in use.
 *
 *    A USB-Serial-JTAG console re-enumerates on reset, so the earliest boot
 *    output is lost. For early-boot debugging, drop this block and use the
 *    board's UART port with the stock `uart0` console.
 *
 * 2. Flash size and layout. The board devicetree includes
 *    `esp32c6_wroom_n8.dtsi`, which declares an 8 MB part. The module in hand is an **N4**: `esptool flash-id`
 *    reports 4 MB (manufacturer 0x68, device 0x4016) on the ESP32-C6 rev v0.2
 *    with MAC e8:f6:0a:fc:32:0c. Correct the declaration so nothing reasons
 *    from 2 MB of flash that does not exist.
 *
 *    The shared layout (lib/common/dts/layout-esp32c6-4M.dtsi) declares the
 *    4 MB part and replaces the upstream partitions with the MCUboot +
 *    Wi-Fi provisioner layout, which MCUboot and the provisioner are built
 *    with too. A plain build (no --sysbuild) still boots from 0x0 and only
 *    uses its storage partition.
 *
 * No `&wifi` node is enabled here: the ESP32-C6 board devicetree already sets
 * the Wi-Fi node to "okay".
 */

&usb_serial {
	status = "okay";
};

/ {
	chosen {
		zephyr,console = &usb_serial;
		zephyr,shell-uart = &usb_serial;
	};
};

#include "../../../lib/common/dts/layout-esp32c6-4M.dtsi"
```

## boards/esp32s3_devkitc_esp32s3_procpu.overlay
```dts
/* SPDX-License-Identifier: Apache-2.0
 *
 * ESP32-S3-DevKitC-1 — flash size and layout.
 *
 * Console: **left as the board devicetree sets it**, i.e. `uart0` on the
 * board's UART port (the one marked UART, not the one marked USB). That port
 * carries a USB-serial bridge with DTR/RTS wired to EN/BOOT, so esptool can
 * reset the board into download mode on its own — no BOOT/RESET button press
 * to flash, and no losing the first lines of boot output to a USB re-enumeration.
 * That makes it the better default for this board, so this overlay deliberately
 * does *not* re-route the console onto USB-Serial-JTAG the way the ESP32-C6
 * overlay does.
 *
 * If you would rather use the native USB port, add:
 *
 *     &usb_serial { status = "okay"; };
 *     &usb_otg    { status = "disabled"; };   // shares GPIO19/20 with the above
 *     / { chosen {
 *             zephyr,console   = &usb_serial;
 *             zephyr,shell-uart = &usb_serial;
 *     }; };
 *
 * and be aware that a board running unrelated factory firmware on that port may
 * refuse every esptool reset strategy until you hold BOOT and tap RESET once.
 *
 * Flash size: the board devicetree includes `esp32s3_wroom_n8.dtsi`, which
 * declares an 8 MB part. The board in hand is an **N16R8** — `esptool flash-id`
 * reports 16 MB (manufacturer 0x1c, device 0x7118) on an ESP32-S3 rev v0.2 with
 * MAC 7c:0c:5f:5a:6e:b8, plus 8 MB of octal PSRAM that this firmware does not
 * use. The shared layout (lib/common/dts/layout-esp32s3-16M.dtsi) declares the
 * real size and replaces the upstream AMP partitions with the MCUboot + Wi-Fi
 * provisioner layout, which MCUboot and the provisioner are built with too. A
 * plain build (no --sysbuild) still boots from 0x0. It needs a 16 MB part.
 *
 * No `&wifi` node is enabled here: unlike the QT Py S3 and the S2 Feather, the
 * ESP32-S3-DevKitC board devicetree already sets it to "okay".
 */

#include "../../../lib/common/dts/layout-esp32s3-16M.dtsi"

/* Status LED: the WS2812 RGB LED. */
#include "../../../lib/common/dts/rgb-led-esp32s3-devkitc.dtsi"

/* The board's 8 MB octal PSRAM. Declaring it does not enable it: that takes
 * CONFIG_ESP_SPIRAM (see the _tedge board overlay). */
&psram0 {
	size = <DT_SIZE_M(8)>;
};
```

## src/main.c
```c
/* SPDX-License-Identifier: Apache-2.0
 *
 * Modbus TCP server firmware entry point.
 *
 * Boot sequence:
 *   1. Bring up connectivity (Wi-Fi station on hardware; host networking on
 *      native_sim) and wait until the network is usable.
 *   2. Start the Modbus TCP server (raw-ADU server + TCP listener on port 502).
 */

#include <zephyr/kernel.h>
#include <zephyr/logging/log.h>

#include "net.h"
#include "prov_tedge.h"
#include "display.h"
#include "modbus_server.h"
#if defined(CONFIG_TEDGE)
#include "tedge_glue.h"
#endif

LOG_MODULE_REGISTER(main, CONFIG_LOG_DEFAULT_LEVEL);

int main(void)
{
	int ret;

	LOG_INF("Modbus TCP server firmware starting: device \"%s\"",
		CONFIG_APP_DEVICE_NAME);

	display_status_init();
	display_status_stage(DISPLAY_STAGE_WIFI_CONNECTING);

	ret = app_net_init();
	if (ret) {
		LOG_ERR("Connectivity init failed (%d)", ret);
		display_status_stage(DISPLAY_STAGE_ERROR);
		return 0;
	}

	/* No Wi-Fi network yet: the client starts first (tedge-onboard gives
	 * the device one), and the rest waits for the network. */
	bool onboarding = app_prov_tedge_start_unprovisioned(tedge_glue_start);

	LOG_INF("Waiting for network...");
	ret = app_net_wait_connected(onboarding ? K_FOREVER : K_SECONDS(60));
	if (ret) {
		LOG_ERR("Network did not come up in time (%d)", ret);
		display_status_stage(DISPLAY_STAGE_ERROR);
		return 0;
	}

	ret = modbus_server_start();
	if (ret) {
		LOG_ERR("Failed to start Modbus server (%d)", ret);
		display_status_stage(DISPLAY_STAGE_ERROR);
		return 0;
	}
	LOG_INF("Modbus TCP server running on port %d", CONFIG_APP_MODBUS_PORT);

#if defined(CONFIG_TEDGE)
	/* Device management runs alongside the protocol server. */
	if (!onboarding) {
		(void)tedge_glue_start();
	}
#endif

	return 0;
}
```

## src/tedge_glue.c
```c
/* SPDX-License-Identifier: Apache-2.0
 *
 * The glue between this application and the tiny-edge client. It lives
 * here, not in the module: the module knows nothing about lib/common.
 *
 * It gives the client this device's identity, shows the registration URL
 * while the device waits to be registered, drives the status LED from the
 * client's state, and hands it the platform reset this repository already
 * uses (a CPU reset hangs MCUboot on the ESP32-C6).
 */

#include "tedge_glue.h"

#include "boot_request.h"
#include "controls.h"
#include "data_source.h"
#include "identity.h"
#if defined(CONFIG_APP_WIFI_CRED_STORE)
#include "prov_c8y.h"
#include "prov_tedge.h"
#endif
#include "status_led.h"

#include <zephyr/kernel.h>
#include <zephyr/logging/log.h>

#include <tedge/tedge.h>

#include <stdlib.h>
#include <string.h>

#if defined(CONFIG_SHELL)
#include <zephyr/shell/shell.h>
#endif
#if defined(CONFIG_SHELL) && defined(CONFIG_MBEDTLS_MEMORY_DEBUG)
#include <mbedtls/memory_buffer_alloc.h>
#endif

LOG_MODULE_REGISTER(tedge_glue, CONFIG_LOG_DEFAULT_LEVEL);

static void on_state(enum tedge_state state, void *user_data)
{
	ARG_UNUSED(user_data);

	switch (state) {
	case TEDGE_STATE_AWAITING_REGISTRATION: {
		char url[220];

		/* The operator registers the device from this URL. It carries
		 * the one-time password, so the module never logs it itself;
		 * on a device with a display or a provisioner, show it there
		 * instead of on the console. */
		if (tedge_registration_url(url, sizeof(url)) > 0) {
			LOG_INF("register this device: %s", url);
		}
		status_led_set_mode(STATUS_LED_PROVISIONING);
		break;
	}
	case TEDGE_STATE_CONNECTED:
		status_led_set_mode(STATUS_LED_CONNECTED);
		break;
	default:
		break;
	}
}

/* The Modbus server keeps running across a restart, and clients reconnect,
 * so nothing here needs to veto it. */
static int restart_request(char *reason, size_t reason_len, void *user_data)
{
	ARG_UNUSED(reason);
	ARG_UNUSED(reason_len);
	ARG_UNUSED(user_data);
	LOG_INF("restart requested from the cloud");
	return 0;
}

static void reset(void *user_data)
{
	ARG_UNUSED(user_data);
	boot_request_reboot();
}

#if defined(CONFIG_APP_TEDGE_TEST_REFUSE_FIRMWARE)
/* Test build only: pretend the application is unhealthy after an update, so
 * the image is never confirmed and the bootloader rolls it back. */
static int firmware_confirm_check(void *user_data)
{
	ARG_UNUSED(user_data);
	LOG_WRN("test build: refusing to confirm this firmware");
	return -EINVAL;
}
#endif

static const struct tedge_hooks hooks = {
	.on_state = on_state,
	.restart_request = restart_request,
	.reset = reset,
#if defined(CONFIG_APP_TEDGE_TEST_REFUSE_FIRMWARE)
	.firmware_confirm_check = firmware_confirm_check,
#endif
};

#if defined(CONFIG_SHELL)
/* The client's state, and with CONFIG_MBEDTLS_MEMORY_DEBUG the TLS heap in
 * use, so a reconnect cycle can be checked for leaks (task 8.3). Allowed from
 * the cloud in release images as a health check. */
static int cmd_diag(const struct shell *sh, size_t argc, char **argv)
{
	static const char *const names[] = {
		"stopped",   "waiting-network", "waiting-time",
		"awaiting-registration", "connecting", "connected", "updating",
	};
	enum tedge_state state = tedge_get_state();
	const char *name = ((size_t)state < ARRAY_SIZE(names)) ? names[state] : "?";

	ARG_UNUSED(argc);
	ARG_UNUSED(argv);
#if defined(CONFIG_MBEDTLS_MEMORY_DEBUG)
	size_t cur = 0, cur_blocks = 0, peak = 0, peak_blocks = 0;

	mbedtls_memory_buffer_alloc_cur_get(&cur, &cur_blocks);
	mbedtls_memory_buffer_alloc_max_get(&peak, &peak_blocks);
	shell_print(sh, "tedge state=%s tls_heap cur=%zu (%zu blocks) peak=%zu",
		    name, cur, cur_blocks, peak);
#else
	shell_print(sh, "tedge state=%s uptime=%llds", name,
		    (long long)(k_uptime_get() / 1000));
#endif
	return 0;
}

#if defined(CONFIG_TEDGE_TELEMETRY)
/* Test aids: an application normally decides for itself when something is
 * worth an event or an alarm, but a console is the quickest way to see one
 * arrive in the cloud. */
static int cmd_event(const struct shell *sh, size_t argc, char **argv)
{
	int rc = tedge_publish_event("app_test",
				     (argc > 1) ? argv[1] : "test event", 0);

	shell_print(sh, "event: %d", rc);
	return rc;
}

static int cmd_alarm(const struct shell *sh, size_t argc, char **argv)
{
	static const char *const names[] = {"critical", "major", "minor",
					    "warning"};
	enum tedge_alarm_severity severity = TEDGE_ALARM_WARNING;
	int rc;

	if (argc > 1) {
		for (size_t i = 0; i < ARRAY_SIZE(names); i++) {
			if (strcmp(argv[1], names[i]) == 0) {
				severity = (enum tedge_alarm_severity)i;
			}
		}
	}
	rc = tedge_raise_alarm("app_test_alarm", severity,
			       (argc > 2) ? argv[2] : "test alarm");
	shell_print(sh, "alarm: %d", rc);
	return rc;
}

static int cmd_clear(const struct shell *sh, size_t argc, char **argv)
{
	int rc = tedge_clear_alarm((argc > 1) ? argv[1] : "app_test_alarm");

	ARG_UNUSED(argv);
	shell_print(sh, "clear: %d", rc);
	return rc;
}

/* Publish faster than the link can carry, to see what a full buffer does. */
static int cmd_flood(const struct shell *sh, size_t argc, char **argv)
{
	struct tedge_measurement_value value = {.series = "flood", .value = 0};
	long count = (argc > 1) ? strtol(argv[1], NULL, 10) : 50;
	int last = 0;

	for (long i = 0; i < count; i++) {
		value.value = (double)i;
		last = tedge_publish_measurement("flood", &value, 1, 0);
	}
	shell_print(sh, "flood: %ld published, last=%d, dropped=%u", count,
		    last, tedge_telemetry_dropped());
	return 0;
}
#endif /* CONFIG_TEDGE_TELEMETRY */

#if defined(CONFIG_APP_TEDGE_TEST_FAULT_COMMAND)
/* Test aid: crashes the device on purpose, so the crash dump has something
 * to report. */
static int cmd_crash(const struct shell *sh, size_t argc, char **argv)
{
	volatile uint32_t *nowhere = NULL;

	ARG_UNUSED(argc);
	ARG_UNUSED(argv);
	shell_print(sh, "crashing on purpose");
	*nowhere = 1;
	return 0;
}
#endif

/* These hang off the client's own "tedge" root, which tiny-edge defines.
 * An application that registered a root of the same name would give the
 * device two of them, and the shell would only ever reach one. */
SHELL_SUBCMD_ADD((tedge), diag, NULL, "client state and TLS heap", cmd_diag,
		 1, 0);
#if defined(CONFIG_APP_TEDGE_TEST_FAULT_COMMAND)
SHELL_SUBCMD_ADD((tedge), crash, NULL, "crash on purpose (test builds only)",
		 cmd_crash, 1, 0);
#endif
#if defined(CONFIG_TEDGE_TELEMETRY)
SHELL_SUBCMD_ADD((tedge), event, NULL, "publish an event: event [text]",
		 cmd_event, 1, 1);
SHELL_SUBCMD_ADD((tedge), alarm, NULL,
		 "raise an alarm: alarm [severity] [text]", cmd_alarm, 1, 2);
SHELL_SUBCMD_ADD((tedge), clear, NULL, "clear an alarm: clear [type]",
		 cmd_clear, 1, 1);
SHELL_SUBCMD_ADD((tedge), flood, NULL, "publish N measurements: flood [N]",
		 cmd_flood, 1, 1);
#endif
#endif /* CONFIG_SHELL */

#if defined(CONFIG_TEDGE_PARAMETERS)
/* ------------------------------------------------------------------------ */
/* Running the pump from the cloud                                           */
/*                                                                           */
/* The same three control points a Modbus master writes (coil 0 running,     */
/* holding register 0 speed_setpoint, holding register 1 mode), as a         */
/* parameter set. They are applied at start-up from what the client stored,  */
/* so the pump comes back in the state the operator last set, and on every   */
/* change; the simulation then ramps and the flow, pressure, rpm and motor   */
/* temperature it serves follow. local_writes decides whether a Modbus       */
/* master may still change them: off, its writes are refused (exception 2)  */
/* and the pump does only what the parameters say.                           */
/*                                                                           */
/* A Modbus write that is allowed changes the pump but not the parameter,    */
/* so the twin shows what the cloud last asked for; the registers show what  */
/* the pump is doing.                                                        */
/* ------------------------------------------------------------------------ */

#define CONTROL_SET "zephyr_modbus_control"

static const char *const mode_names[] = { "off", "auto", "manual" };

static const struct tedge_parameter control_params[] = {
	TEDGE_PARAM_BOOL("running", IS_ENABLED(CONFIG_APP_RUNNING_DEFAULT),
			 "Run the pump"),
	TEDGE_PARAM_ENUM("mode",
			 CONFIG_APP_MODE_DEFAULT == 2 ? "manual" :
			 CONFIG_APP_MODE_DEFAULT == 1 ? "auto" : "off",
			 ("off", "auto", "manual"),
			 "off: stopped; auto: the pump picks its duty; manual: speed_setpoint"),
	TEDGE_PARAM_INT("speed_setpoint", CONFIG_APP_SETPOINT_DEFAULT,
			CONFIG_APP_SETPOINT_MIN, CONFIG_APP_SETPOINT_MAX,
			"Pump speed in manual mode (%)"),
	TEDGE_PARAM_BOOL("local_writes", true,
			 "Let Modbus clients change running, mode and speed_setpoint"),
};

static void control_apply(void)
{
	bool running = IS_ENABLED(CONFIG_APP_RUNNING_DEFAULT);
	bool local = true;
	int32_t setpoint = CONFIG_APP_SETPOINT_DEFAULT;
	int mode = CONFIG_APP_MODE_DEFAULT;
	char name[8];

	(void)tedge_parameter_get_bool(CONTROL_SET, "running", &running);
	(void)tedge_parameter_get_bool(CONTROL_SET, "local_writes", &local);
	(void)tedge_parameter_get_int(CONTROL_SET, "speed_setpoint", &setpoint);
	if (tedge_parameter_get_string(CONTROL_SET, "mode", name,
				       sizeof(name)) == 0) {
		for (int i = 0; i < (int)ARRAY_SIZE(mode_names); i++) {
			if (strcmp(name, mode_names[i]) == 0) {
				mode = i;
			}
		}
	}
	app_control_set_mode(mode);
	app_control_set_setpoint(setpoint);
	app_control_set_running(running);
	app_control_set_local_writes(local);
	LOG_INF("pump control: %s, mode %s, setpoint %d%%, Modbus writes %s",
		running ? "running" : "stopped", mode_names[mode], setpoint,
		local ? "allowed" : "refused");
}

static int control_changed(const char *set, char *reason, size_t reason_len,
			   void *user_data)
{
	ARG_UNUSED(set);
	ARG_UNUSED(reason);
	ARG_UNUSED(reason_len);
	ARG_UNUSED(user_data);
	control_apply();
	return 0;
}
#endif /* CONFIG_TEDGE_PARAMETERS */

#if defined(CONFIG_TEDGE_PARAMETERS) && defined(CONFIG_TEDGE_TELEMETRY)
/* ------------------------------------------------------------------------ */
/* What an operator may change from the cloud                                */
/*                                                                           */
/* The declaration is const, so it costs flash and no RAM, and the defaults  */
/* are this application's existing Kconfig values rather than a second set   */
/* written out beside them: whatever the image was built with is what the    */
/* device starts from, and anything an operator sets afterwards replaces it. */
/*                                                                           */
/* Register the schema in the tenant with "tedge params schema".             */
/* ------------------------------------------------------------------------ */

#define PUMP_SET "zephyr_modbus_telemetry"

static const struct tedge_parameter pump_params[] = {
	TEDGE_PARAM_INT("interval_s", CONFIG_APP_TEDGE_MEASUREMENT_INTERVAL_S,
			5, 3600, "Seconds between measurements"),
	TEDGE_PARAM_BOOL("telemetry", true,
			 "Publish measurements to the cloud"),
	TEDGE_PARAM_STRING("measurement_type",
			   CONFIG_APP_TEDGE_MEASUREMENT_TYPE, 31,
			   "What the cloud files these measurements under"),
};

static int32_t param_interval_s(void)
{
	int32_t seconds;

	if (tedge_parameter_get_int(PUMP_SET, "interval_s", &seconds) == 0) {
		return seconds;
	}
	return CONFIG_APP_TEDGE_MEASUREMENT_INTERVAL_S;
}

static bool param_telemetry_on(void)
{
	bool on;

	if (tedge_parameter_get_bool(PUMP_SET, "telemetry", &on) == 0) {
		return on;
	}
	return true;
}

static const char *param_measurement_type(void)
{
	static char type[32];

	if (tedge_parameter_get_string(PUMP_SET, "measurement_type", type,
				       sizeof(type)) == 0 && type[0] != '\0') {
		return type;
	}
	return CONFIG_APP_TEDGE_MEASUREMENT_TYPE;
}

static void telemetry_fn(struct k_work *work);
static K_WORK_DELAYABLE_DEFINE(telemetry_work, telemetry_fn);

/* The client has already checked every value against the declaration. What
 * is left is the one rule only this application knows: Cumulocity files a
 * measurement under its type, and a type with a space in it is not one. */
static int params_changed(const char *set, char *reason, size_t reason_len,
			  void *user_data)
{
	const char *type = param_measurement_type();

	ARG_UNUSED(set);
	ARG_UNUSED(user_data);

	for (const char *p = type; *p != '\0'; p++) {
		if (*p == ' ' || *p == '\t') {
			snprintf(reason, reason_len,
				 "measurement_type '%s' cannot contain spaces",
				 type);
			return -EINVAL;
		}
	}
	/* Take effect now, rather than after one more of the old interval. */
	(void)k_work_reschedule(&telemetry_work, K_SECONDS(param_interval_s()));
	LOG_INF("parameters applied: interval=%ds telemetry=%s type=%s",
		param_interval_s(), param_telemetry_on() ? "on" : "off", type);
	return 0;
}
#endif /* CONFIG_TEDGE_PARAMETERS && CONFIG_TEDGE_TELEMETRY */

#if defined(CONFIG_TEDGE_TELEMETRY)
/* The application decides what to send and when; the client only carries
 * it. Here that is the pump simulation this firmware already serves over
 * Modbus, so the same values reach an operator who has no Modbus client.
 */
static void telemetry_fn(struct k_work *work)
{
	struct tedge_measurement_value values[8];
	size_t count = MIN(data_source_count(), ARRAY_SIZE(values));

	for (size_t i = 0; i < count; i++) {
		const struct data_measurement *d = data_source_descriptor(i);

		values[i].series = d->name;
		values[i].unit = d->unit;
		values[i].value = data_source_sample(i);
	}
#if defined(CONFIG_TEDGE_PARAMETERS)
	if (count > 0 && param_telemetry_on()) {
		(void)tedge_publish_measurement(param_measurement_type(),
						values, count, 0);
	}
	(void)k_work_reschedule(k_work_delayable_from_work(work),
				K_SECONDS(param_interval_s()));
#else
	if (count > 0) {
		(void)tedge_publish_measurement(CONFIG_APP_TEDGE_MEASUREMENT_TYPE,
						values, count, 0);
	}
	(void)k_work_reschedule(k_work_delayable_from_work(work),
				K_SECONDS(CONFIG_APP_TEDGE_MEASUREMENT_INTERVAL_S));
#endif
}

#if !defined(CONFIG_TEDGE_PARAMETERS)
static K_WORK_DELAYABLE_DEFINE(telemetry_work, telemetry_fn);
#endif
#endif

#if defined(CONFIG_TEDGE_LOG_UPLOAD)
/* The client keeps its own log; this is the application's, and shows what
 * the hook is for: a few lines that only this firmware can answer, produced
 * when the cloud asks rather than stored anywhere. */
static int status_log(const struct tedge_log_request *req,
		      tedge_write_fn write, void *ctx, void *user_data)
{
	char line[128];
	size_t count = data_source_count();
	int rc;

	ARG_UNUSED(req);
	ARG_UNUSED(user_data);

	rc = snprintf(line, sizeof(line), "device %s, firmware %s %s\n",
		      app_identity_device_id(), app_identity_firmware_name(),
		      app_identity_firmware_version());
	rc = write(ctx, line, (size_t)rc);
	if (rc != 0) {
		return rc;
	}
	for (size_t i = 0; i < count; i++) {
		const struct data_measurement *d = data_source_descriptor(i);
		int n = snprintf(line, sizeof(line), "%s = %d.%02d %s\n",
				 d->name, (int)data_source_sample(i),
				 (int)((data_source_sample(i) -
					(int)data_source_sample(i)) * 100),
				 (d->unit != NULL) ? d->unit : "");

		rc = write(ctx, line, (size_t)n);
		if (rc != 0) {
			return rc;
		}
	}
	return 0;
}
#endif

int tedge_glue_start(void)
{
	struct tedge_identity id = {
		.external_id = app_identity_device_id(),
		.name = app_identity_device_id(),
		.type = "thin-edge.io-zephyr-modbus",
		.firmware_name = app_identity_firmware_name(),
		.firmware_version = app_identity_firmware_version(),
	};
	int rc = tedge_init(&id, &hooks);

	if (rc != 0) {
		LOG_ERR("tedge_init failed (%d)", rc);
		return rc;
	}
#if defined(CONFIG_APP_TEDGE_PROVISIONING)
	(void)app_prov_tedge_init();
#endif
#if defined(CONFIG_APP_WIFI_CRED_STORE)
	/* Tenant and one-time password from the ZTP provisioner, if it left
	 * any. The external ID already came through app_identity_device_id(). */
	(void)prov_c8y_handoff();
#endif
#if defined(CONFIG_TEDGE_PARAMETERS) && defined(CONFIG_TEDGE_TELEMETRY)
	/* Before tedge_start(): the client loads the stored values over the
	 * declared defaults and reports the set as soon as it connects. */
	rc = tedge_declare_parameters(PUMP_SET, pump_params,
				      ARRAY_SIZE(pump_params), params_changed,
				      NULL);
	if (rc != 0) {
		LOG_ERR("could not declare the '%s' parameters (%d)", PUMP_SET,
			rc);
		return rc;
	}
#endif
#if defined(CONFIG_TEDGE_PARAMETERS)
	/* Declaring loads the stored values, so this starts the pump in the
	 * state the operator last set. */
	rc = tedge_declare_parameters(CONTROL_SET, control_params,
				      ARRAY_SIZE(control_params),
				      control_changed, NULL);
	if (rc != 0) {
		LOG_ERR("could not declare the '%s' parameters (%d)",
			CONTROL_SET, rc);
		return rc;
	}
	control_apply();
#endif
	rc = tedge_start();
	if (rc != 0) {
		LOG_ERR("tedge_start failed (%d)", rc);
		return rc;
	}
#if defined(CONFIG_TEDGE_TELEMETRY)
	(void)k_work_schedule(&telemetry_work,
#if defined(CONFIG_TEDGE_PARAMETERS)
			      K_SECONDS(param_interval_s()));
#else
			      K_SECONDS(CONFIG_APP_TEDGE_MEASUREMENT_INTERVAL_S));
#endif
#endif
#if defined(CONFIG_TEDGE_LOG_UPLOAD)
	(void)tedge_register_log_type("app-status", status_log, NULL);
#endif
	return rc;
}
```

## src/tedge_glue.h
```c
/* SPDX-License-Identifier: Apache-2.0 */
#ifndef TEDGE_GLUE_H_
#define TEDGE_GLUE_H_

/** Start the thin-edge.io client with this application's identity and hooks. */
int tedge_glue_start(void);

#endif /* TEDGE_GLUE_H_ */
```
