## CMakeLists.txt
```
# SPDX-License-Identifier: Apache-2.0
#
# Smallest application that uses tedge-zephyr. It builds with Zephyr and this
# module only, which proves the module does not depend on the repository that
# hosts it.
cmake_minimum_required(VERSION 3.20.0)

# The module is this sample's grandparent directory. Once tedge-zephyr is a
# west project, west finds it and this line can go.
list(APPEND ZEPHYR_EXTRA_MODULES ${CMAKE_CURRENT_SOURCE_DIR}/../..)

find_package(Zephyr REQUIRED HINTS $ENV{ZEPHYR_BASE})
project(tedge_minimal C)

target_sources(app PRIVATE src/main.c)
```

## Kconfig
```
# SPDX-License-Identifier: Apache-2.0

mainmenu "tedge-zephyr minimal sample"

config TEDGE_SAMPLE_WIFI_SSID
	string "Wi-Fi SSID"
	default ""
	depends on WIFI

config TEDGE_SAMPLE_WIFI_PSK
	string "Wi-Fi password (empty for an open network)"
	default ""
	depends on WIFI

source "Kconfig.zephyr"
```

## sample.yaml
```
sample:
  name: tedge-zephyr minimal
  description: Smallest application that includes the tedge-zephyr module
common:
  tags: tedge
  harness: console
  harness_config:
    type: one_line
    regex:
      - "tedge-zephyr [0-9]+\\.[0-9]+\\.[0-9]+"
tests:
  sample.tedge.minimal:
    integration_platforms:
      - native_sim/native/64
    platform_allow:
      - native_sim/native/64
      - esp32c6_devkitc/esp32c6/hpcore
```

## prj.conf
```kconfig
# SPDX-License-Identifier: Apache-2.0
#
# The smallest application that hosts the client. The client itself only
# needs CONFIG_TEDGE; what the *application* must provide for the Cumulocity
# transport (mbedTLS, a settings backend, socket budget) is in
# overlay-c8y.conf, so build this sample with:
#
#   west build -b <board> samples/minimal -- -DEXTRA_CONF_FILE=overlay-c8y.conf

CONFIG_TEDGE=y
CONFIG_LOG=y
```

## overlay-c8y.conf
```kconfig
# SPDX-License-Identifier: Apache-2.0
#
# What an application must provide for the client's Cumulocity transport.
# The client selects the protocol pieces (MQTT, sockets, TLS sockets,
# credentials, SNTP) itself; these are the application's to size.

# --- TLS: the client's requirements, from tedge-zephyr/README.md ---
CONFIG_MBEDTLS=y
CONFIG_MBEDTLS_ENABLE_HEAP=y
CONFIG_MBEDTLS_HEAP_SIZE=57344
CONFIG_MBEDTLS_SSL_MAX_CONTENT_LEN=16384
CONFIG_MBEDTLS_SSL_PROTO_TLS1_2=y
CONFIG_MBEDTLS_CIPHERSUITE_TLS_ECDHE_RSA_WITH_AES_128_GCM_SHA256=y
CONFIG_MBEDTLS_CIPHERSUITE_TLS_ECDHE_ECDSA_WITH_AES_128_GCM_SHA256=y
CONFIG_PSA_WANT_ECC_SECP_R1_256=y
CONFIG_MBEDTLS_SSL_SERVER_NAME_INDICATION=y
CONFIG_MBEDTLS_HAVE_TIME_DATE=y
CONFIG_MBEDTLS_PEM_PARSE_C=y
CONFIG_MBEDTLS_X509_CRT_PARSE_C=y

# --- Wi-Fi: the application owns the network ---
CONFIG_WIFI=y
CONFIG_WIFI_ESP32=y
CONFIG_NET_L2_ETHERNET=y
CONFIG_NET_DHCPV4=y
CONFIG_NET_CONNECTION_MANAGER=y
CONFIG_TEDGE_SAMPLE_WIFI_SSID=""
CONFIG_TEDGE_SAMPLE_WIFI_PSK=""

# --- Settings: the client stores its identity and credentials here ---
CONFIG_FLASH=y
CONFIG_FLASH_MAP=y
CONFIG_NVS=y
CONFIG_SETTINGS_NVS=y
# The device key lives in PSA ITS, stored through settings.
CONFIG_SECURE_STORAGE_ITS_STORE_IMPLEMENTATION_SETTINGS=y

# --- Sockets and connections the client needs (README) ---
CONFIG_NET_MAX_CONN=6
CONFIG_NET_MAX_CONTEXTS=8
CONFIG_ZVFS_OPEN_MAX=8
```

## src/main.c
```c
/* SPDX-License-Identifier: Apache-2.0
 *
 * The smallest application that hosts the thin-edge.io client: join a Wi-Fi
 * network, then start the client and let it do the rest. Everything here is
 * the *application's* job; the client only reacts to the network being up.
 */

#include <zephyr/kernel.h>
#include <zephyr/logging/log.h>
#include <zephyr/net/net_if.h>
#include <zephyr/net/wifi_mgmt.h>

#include <tedge/tedge.h>

#include <string.h>

LOG_MODULE_REGISTER(tedge_minimal, LOG_LEVEL_INF);

static void on_state(enum tedge_state state, void *user_data)
{
	ARG_UNUSED(user_data);

	if (state == TEDGE_STATE_AWAITING_REGISTRATION) {
		char url[220];

		/* The URL carries a one-time password: show it to the operator
		 * (here the console; a real device might use a display or its
		 * provisioner). */
		if (tedge_registration_url(url, sizeof(url)) > 0) {
			LOG_INF("register this device: %s", url);
		}
	}
}

static const struct tedge_hooks hooks = {
	.on_state = on_state,
};

#if defined(CONFIG_WIFI)
static int wifi_connect(void)
{
	struct net_if *iface = net_if_get_first_wifi();
	struct wifi_connect_req_params p = {
		.ssid = (const uint8_t *)CONFIG_TEDGE_SAMPLE_WIFI_SSID,
		.ssid_length = strlen(CONFIG_TEDGE_SAMPLE_WIFI_SSID),
		.psk = (const uint8_t *)CONFIG_TEDGE_SAMPLE_WIFI_PSK,
		.psk_length = strlen(CONFIG_TEDGE_SAMPLE_WIFI_PSK),
		.security = strlen(CONFIG_TEDGE_SAMPLE_WIFI_PSK)
				    ? WIFI_SECURITY_TYPE_PSK
				    : WIFI_SECURITY_TYPE_NONE,
		.channel = WIFI_CHANNEL_ANY,
		.band = WIFI_FREQ_BAND_2_4_GHZ,
	};

	if (iface == NULL) {
		LOG_ERR("no Wi-Fi interface");
		return -ENODEV;
	}
	LOG_INF("joining \"%s\"", CONFIG_TEDGE_SAMPLE_WIFI_SSID);
	return net_mgmt(NET_REQUEST_WIFI_CONNECT, iface, &p, sizeof(p));
}
#endif

int main(void)
{
	LOG_INF("tedge-zephyr %s", tedge_version());

#if defined(CONFIG_WIFI)
	/* The client waits for an address by itself, so a failure here only
	 * delays it: the application can retry however it likes. */
	(void)wifi_connect();
#endif

	if (tedge_init(NULL, &hooks) == 0) {
		(void)tedge_start();
	}
	return 0;
}
```
