## CMakeLists.txt
```
# SPDX-License-Identifier: Apache-2.0
#
# Unit tests for the module's pure helpers, run on native_sim:
#   west build -b native_sim/native/64 tedge-zephyr/tests/unit -t run
#
# The helpers have no state, no I/O and no Kconfig of their own, so the test
# compiles them directly instead of building the whole client.
cmake_minimum_required(VERSION 3.20.0)

find_package(Zephyr REQUIRED HINTS $ENV{ZEPHYR_BASE})
project(tedge_unit_tests C)

target_sources(app PRIVATE
  src/main.c
  ../../src/tedge_smartrest.c
  ../../src/tedge_backoff.c
  ../../src/tedge_pkcs7.c
  ../../src/tedge_ra_allow_list.c
  ../../src/tedge_ra_target.c
  ../../src/tedge_url.c
  ../../src/tedge_cert_decision.c
  ../../src/tedge_telemetry.c
  ../../src/tedge_json.c
  ../../src/tedge_shell_allow_list.c
  ../../src/tedge_log_ring.c
  ../../src/tedge_op_json.c
  ../../src/tedge_parameters.c
  ../../src/tedge_otp.c
  ../../src/tedge_fw_decision.c
)

# The telemetry API is compiled in for the tests, with a small buffer so the
# "it filled up" cases are quick to reach.
target_compile_definitions(app PRIVATE
  CONFIG_TEDGE_TELEMETRY=1
  CONFIG_TEDGE_TELEMETRY_BUFFER_BYTES=512
  # The module's log level comes from its Kconfig, which is not part of a
  # test build.
  CONFIG_TEDGE_LOG_LEVEL=3
  # A small ring, so "it wrapped" is one test away.
  CONFIG_TEDGE_LOG_RING_BYTES=256
  CONFIG_TEDGE_C8Y_OPERATION_JSON=1
  # Parameters: room for the mixed set the tests declare, and the
  # schema printer, which is what the tenant registration needs.
  CONFIG_TEDGE_PARAMETERS=1
  CONFIG_TEDGE_PARAMETERS_MAX=8
  CONFIG_TEDGE_PARAMETERS_SCHEMA=1
)
target_include_directories(app PRIVATE ../../include ../../src)
```

## prj.conf
```kconfig
# SPDX-License-Identifier: Apache-2.0
CONFIG_ZTEST=y

# tedge_log_ring.c is a log backend, so the test build needs the subsystem
# it plugs into.
CONFIG_LOG=y
CONFIG_LOG_OUTPUT=y

# tedge_pkcs7.c reads the enrollment reply with mbedTLS's base64 and ASN.1.
CONFIG_MBEDTLS=y
CONFIG_MBEDTLS_PSA_CRYPTO_C=y
CONFIG_MBEDTLS_BASE64_C=y
CONFIG_MBEDTLS_ASN1_PARSE_C=y
CONFIG_MBEDTLS_SSL_PROTO_TLS1_2=y
CONFIG_MBEDTLS_CIPHERSUITE_TLS_ECDHE_ECDSA_WITH_AES_128_GCM_SHA256=y
CONFIG_MBEDTLS_X509_CRT_PARSE_C=y
CONFIG_MBEDTLS_PEM_PARSE_C=y
```

## src/pkcs7_fixture.h
```c
/* SPDX-License-Identifier: Apache-2.0
 *
 * A PKCS#7 "certs-only" reply, the shape Cumulocity's EST endpoint
 * returns, made with:
 *   openssl req -x509 -key ec.key -subj /CN=tedge-fixture -out cert.pem
 *   openssl crl2pkcs7 -nocrl -certfile cert.pem
 */

#ifndef PKCS7_FIXTURE_H_
#define PKCS7_FIXTURE_H_

static const char pkcs7_b64[] =
	"MIIBswYJKoZIhvcNAQcCoIIBpDCCAaACAQExADALBgkqhkiG9w0BBwGgggGIMIIB"
	"hDCCASugAwIBAgIUPvMW43vxKLSDaorLhsno7YZANh4wCgYIKoZIzj0EAwIwGDEW"
	"MBQGA1UEAwwNdGVkZ2UtZml4dHVyZTAeFw0yNjA5MTkyMTI0NTBaFw0zNjA5MTYy"
	"MTI0NTBaMBgxFjAUBgNVBAMMDXRlZGdlLWZpeHR1cmUwWTATBgcqhkjOPQIBBggq"
	"hkjOPQMBBwNCAATvPyoIttTV/hfOi3rPRHpZ3k3HbNUE9P3Pt7GV+qPN/ZeTv9H2"
	"bBffhqMKmG/UD7AklaLw+iMA7TnoavuQtR/co1MwUTAdBgNVHQ4EFgQUx1fE7Uu7"
	"aeNQE+APpYSdVFRy4icwHwYDVR0jBBgwFoAUx1fE7Uu7aeNQE+APpYSdVFRy4icw"
	"DwYDVR0TAQH/BAUwAwEB/zAKBggqhkjOPQQDAgNHADBEAiBByeANdK+0O8obbhDj"
	"1CpqJrA/IFFHfn4Z6B/SMrnv7QIgaIPBgABS9R0DTDuBqVayKdwIbwwhRYKc7ml1"
	"udaGeyMxAA==";

#define PKCS7_CERT_DER_LEN 392
/* The first bytes of the certificate: SEQUENCE header. */
static const unsigned char pkcs7_cert_head[] = { 0x30, 0x82, 0x01, 0x84, 0x30, 0x82, 0x01, 0x2b };

#endif /* PKCS7_FIXTURE_H_ */
```
